## CMakeLists.txt
```
cmake_minimum_required(VERSION 3.20.0)

list(APPEND BOARD_ROOT ${CMAKE_CURRENT_SOURCE_DIR}/../../tapestry-scr-hw)
list(APPEND DTS_ROOT   ${CMAKE_CURRENT_SOURCE_DIR}/../../tapestry-os)

# Second overlay reconfigures USART3 to 230400 baud for the lighthouse deck
# FPGA data stream — this also means the wired USART3 console is
# unavailable; use CRTP radio.
set(DTC_OVERLAY_FILE
    "${CMAKE_CURRENT_SOURCE_DIR}/../../tapestry-os/boards/crazyflie21bl/crazyflie21bl.overlay"
    "${CMAKE_CURRENT_SOURCE_DIR}/boards/crazyflie21bl_lh.overlay"
)

find_package(Zephyr REQUIRED HINTS $ENV{ZEPHYR_BASE})
project(tapestry_cf21bl_formation)

set(TAPESTRY_OS_ROOT      ${CMAKE_CURRENT_SOURCE_DIR}/../../tapestry-os)
set(TAPESTRY_OS_CSM       ${TAPESTRY_OS_ROOT}/subsys/csm)
set(TAPESTRY_OS_TRANSPORT ${TAPESTRY_OS_ROOT}/subsys/transport)
set(TAPESTRY_OS_BOARDS    ${TAPESTRY_OS_ROOT}/boards)

# Core gossip stack (L4 CSM, no SCR/L5)
target_sources(app PRIVATE
    src/main.c
    src/formation.c
    ${TAPESTRY_OS_CSM}/world_model.c
    ${TAPESTRY_OS_CSM}/facts.c
    ${TAPESTRY_OS_TRANSPORT}/transport.c
    ${TAPESTRY_OS_TRANSPORT}/gossip.c
    ${TAPESTRY_OS_TRANSPORT}/transceiver_syslink_p2p.c
    ${TAPESTRY_OS_BOARDS}/crazyflie21bl/cf21bl_lighthouse.c
    # IWDG: keep watchdog alive (bootloader arms it before jumping to us)
    ${TAPESTRY_OS_BOARDS}/crazyflie21bl/cf21bl_iwdg.c
    # Shared USART6 TX mutex — required whenever the syslink P2P transport
    # is linked; see cf21bl_syslink_tx.h.
    ${TAPESTRY_OS_BOARDS}/crazyflie21bl/cf21bl_syslink_tx.c
)

# L5 SCR + L6 BSE + L7 Choreographer — the choreo demo mode's target source.
if(CONFIG_DEMO_MODE_CHOREO)
    target_sources(app PRIVATE
        ${TAPESTRY_OS_ROOT}/subsys/scr/scr.c
        ${TAPESTRY_OS_ROOT}/subsys/bse/bse.c
        ${TAPESTRY_OS_ROOT}/subsys/choreo/choreo.c
    )
    target_include_directories(app PRIVATE
        ${CMAKE_CURRENT_SOURCE_DIR}/../../sdk/include   # <tapestry/choreo.h>
    )
endif()

# CRTP radio console — safe to combine with the syslink P2P transport since
# both now serialize USART6 TX through cf21bl_syslink_tx_mutex (previously
# excluded here; see git history).  USART3 is not available as a wired
# console alternative once the lighthouse deck overlay is applied above.
# Build with -DCONFIG_LOG=n for a quieter radio (formation flights with 3
# drones share one nRF51 radio config — no per-drone channel plan exists
# yet, see Phase D notes, so treat concurrent consoles as best-effort).
if(CONFIG_LOG)
    target_sources(app PRIVATE ${TAPESTRY_OS_BOARDS}/crazyflie21bl/cf21bl_crtp_log.c)
endif()

# Battery telemetry + forced landing on critical voltage (independent per
# drone — see cf21bl_stabilizer.c's PM-critical force-land path).
if(CONFIG_CF21BL_PM)
    target_sources(app PRIVATE ${TAPESTRY_OS_BOARDS}/crazyflie21bl/cf21bl_pm.c)
endif()

# Substrate: motor + stabilizer sources only when PWM is enabled.
# Build with -DCONFIG_PWM=n to run gossip-only with no ESC init and no beeping.
if(CONFIG_PWM)
    target_sources(app PRIVATE
        ${TAPESTRY_OS_BOARDS}/crazyflie21bl/substrate_crazyflie21bl.c
        ${TAPESTRY_OS_BOARDS}/crazyflie21bl/crazyflie21bl.c
        ${TAPESTRY_OS_BOARDS}/crazyflie21bl/cf21bl_stabilizer.c
        ${TAPESTRY_OS_BOARDS}/crazyflie21bl/cf21bl_imu.c
    )
else()
    target_sources(app PRIVATE ${TAPESTRY_OS_BOARDS}/substrate_null.c)
endif()

target_include_directories(app PRIVATE
    ${TAPESTRY_OS_ROOT}/include           # <tapestry/...>
    ${TAPESTRY_OS_CSM}                    # world_model internals
    ${TAPESTRY_OS_TRANSPORT}              # gossip.h
    ${TAPESTRY_OS_BOARDS}/crazyflie21bl   # cf21bl_stabilizer.h etc.
    src
)

target_link_libraries(app PRIVATE m)
```

## Kconfig
```
mainmenu "Tapestry cf21bl-formation"

source "Kconfig.zephyr"
rsource "../../tapestry-os/boards/crazyflie21bl/Kconfig"
rsource "../../tapestry-os/subsys/runtime/Kconfig"
rsource "../../tapestry-os/subsys/transport/Kconfig"

choice DEMO_MODE
	prompt "Demo mode"
	default DEMO_MODE_CHOREO

config DEMO_MODE_CHOREO
	bool "Choreo script (L6/L7): hold stations, exchange places, rest"
	help
	  The drones execute a declarative L7 Choreo script through the L6
	  BSE.  The script is authored in choreo.toml (this directory) and
	  compiled to src/choreo_script.h by sdk/tools/choreoc.py — edit the
	  TOML, re-run the tool, rebuild.  Default show: hold stations,
	  exchange places (stations rotate via the BSE's arc maneuver), bow,
	  then rest — script completion maps to landing in place.

	  ONE BINARY for all drones: element IDs are negotiated at boot over
	  the radio (transport_negotiate_id — same auto-ID protocol as
	  cutebot-formation), so no per-drone build flags are needed.

config DEMO_MODE_SHOWCASE
	bool "Legacy showcase (L4 spring field, per-drone builds)"
	help
	  The flight-validated 2026-07 showcase: spring-field formation with
	  phase choreography keyed off fresh-peer count (line → rotating
	  triangle → member departs → line).  Uses per-drone build flags
	  (TAPESTRY_ELEMENT_ID, DEMO_START_DELAY_S, DEMO_MISSION_DURATION_S,
	  DEMO_HOLD_STATION).

endchoice

config DEMO_ALLOW_SOLO
	bool "Choreo: allow arming with no peers heard (n_total=1)"
	depends on DEMO_MODE_CHOREO
	default n
	help
	  By default a drone whose auto-ID window heard NO peers refuses to
	  arm and becomes a grounded radio-diagnostic station (a swap needs
	  two drones, and flying solo after failed negotiation is how
	  duplicate-ID flights happen).  Enable only for deliberate
	  single-drone testing of the choreo stack.

config TAPESTRY_ELEMENT_ID
	int "Element ID [0..4] (showcase mode only)"
	range 0 4
	default 0
	help
	  Unique identity for this drone in showcase mode.  Choreo mode
	  ignores this and negotiates IDs at boot.  Override at build time:
	    west build ... -- -DCONFIG_TAPESTRY_ELEMENT_ID=1

config TAPESTRY_ELEMENT_COUNT
	int "Number of drones in the formation (showcase mode only)"
	range 2 5
	default 3
	help
	  Sets n_total for the showcase demo.  Choreo mode ignores this and
	  takes the count from auto-ID negotiation.  The sync window waits
	  until (n_total - 1) peers are fresh before arming and flying.
	    2 drones: -DCONFIG_TAPESTRY_ELEMENT_COUNT=2
	    3 drones: -DCONFIG_TAPESTRY_ELEMENT_COUNT=3  (default)

config DEMO_MISSION_DURATION_S
	int "Seconds from arming until this drone lands itself"
	depends on DEMO_MODE_SHOWCASE
	range 10 600
	default 60
	help
	  Per-drone mission length.  Give one drone a shorter duration to
	  choreograph an early departure (it lands, goes gossip-silent, and
	  the survivors re-form without it):
	    west build ... -- -DCONFIG_DEMO_MISSION_DURATION_S=30

config DEMO_START_DELAY_S
	int "Ground hold before the arming countdown (staggered join)"
	depends on DEMO_MODE_SHOWCASE
	range 0 300
	default 0
	help
	  Extra seconds this drone waits on the ground (after lighthouse fix,
	  before the arming countdown, not yet gossiping) so it can visibly
	  join an already-flying formation:
	    west build ... -- -DCONFIG_DEMO_START_DELAY_S=15

config DEMO_HOLD_STATION
	bool "Pinned member: hold the seeded position, ignore formation forces"
	depends on DEMO_MODE_SHOWCASE
	default n
	help
	  This drone holds station at its first-fix seed for the whole
	  mission.  It still gossips, so peers keep their spacing from it
	  and the formation forms AROUND it; it still runs the full safety
	  layer (geofence, fix-loss, separation warning).  Useful for a
	  mechanically weak airframe whose trim converges well against a
	  static setpoint but is continuously re-excited by a moving one:
	    west build ... -- -DCONFIG_DEMO_HOLD_STATION=y

config DEMO_MISSION_MARGIN_S
	int "Choreo: backstop margin added to the script's own time bound"
	depends on DEMO_MODE_CHOREO
	range 20 600
	default 90
	help
	  The mission-duration backstop is CHOREO_SCRIPT_TOTAL_TIMEOUT_MS
	  plus this margin, counted from the end of the convergence hold.

	  Sizing it is NOT just ramp + descent.  Script step timers FREEZE
	  while the Choreo is SUSPENDED (quorum lost), so a script's
	  wall-clock runtime exceeds its own time bound by however long the
	  link was down.  On a marginal P2P link that is most of the flight:
	  the 48 s change-partners script has taken >90 s of wall clock at
	  ~15% gossip delivery.  The old 40 s margin left the script racing
	  its own backstop, and a flight that lands on the backstop instead
	  of on script completion looks identical from the ground while
	  meaning something completely different (2026-08-24 flight 16).

	  Raise this when chasing script behavior on a poor link; lower it
	  for a tight safety envelope on a good one.

config CF21BL_END_TRACE
	bool "2 Hz trace of the script's end and of close approaches"
	depends on DEMO_MODE_CHOREO
	default n
	help
	  A short "E" line every 500 ms while on the script's last step,
	  while landing, or while a peer is within 0.8 m: own position,
	  directive target, tracker command, nearest peer (id, last gossiped
	  position, age) and separation.  For diagnosing an end-of-script
	  drift toward the partner (flight 62).  Limited to those windows
	  because the console costs gossip (see DEMO_CONSOLE_VERBOSE).

config DEMO_CONSOLE_VERBOSE
	bool "Verbose console (per-tick tracking, lighthouse + stabilizer info)"
	default n
	help
	  Deep single-drone debugging: formation.c's tracking traces at the
	  full per-tick rate (10 Hz instead of the throttled ~1 Hz), the
	  lighthouse driver's per-fix lines, and the stabilizer's 2 Hz pos/alt
	  streams.  Off, the console is roughly just the 1 Hz status line.

	  THE CONSOLE IS NOT FREE.  It rides the same USART6 syslink link as
	  P2P gossip, and the STM32F4's 1-byte UART FIFO makes every byte an
	  ISR competing with the 1 kHz control loop.  Logging therefore eats
	  the gossip the swarm runs on: with the console active, syslink
	  ck_fail ran ~20-25/s, quorum flapped, EXCHANGE's step timer (frozen
	  while suspended) took 106 s of wall clock to accumulate its 30 s
	  budget, and two drones running one script finished 59.6 s apart
	  (2026-08-26 flight 22).  The same flight with CONFIG_LOG=n landed
	  them under 10 s apart.

	  So there is a real observability/fidelity trade here, and it is not
	  subtle.  Default-off levels are the compromise: enough to read the
	  status timeline, little enough to fly.  CONFIG_LOG=n is the fastest
	  and blindest; this option is the slowest and most detailed.  The
	  proper fix is DMA on USART6 RX, which is not done.

	  (Splicing is a separate, now-fixed problem: every drone shipped on
	  one CRTP address, so two drones' output interleaved mid-line with no
	  source id.  See CF21BL_RADIO_ADDR_OVERRIDE.)

config CF21BL_LH2_LOG_LEVEL
	int
	default 3 if DEMO_CONSOLE_VERBOSE
	default 2

config CF21BL_STABILIZER_LOG_LEVEL
	int
	default 3 if DEMO_CONSOLE_VERBOSE
	default 2

config TAPESTRY_QUORUM_MIN
	int "Minimum fresh peers for DEGRADED state"
	range 0 4
	default 1

config TAPESTRY_QUORUM_TARGET
	int "Minimum fresh peers for HEALTHY state"
	range 0 4
	default 1
```

## prj.conf
```kconfig
CONFIG_MAIN_STACK_SIZE=8192

CONFIG_LOG=y
CONFIG_LOG_DEFAULT_LEVEL=3
CONFIG_PRINTK=y

CONFIG_FPU=y
CONFIG_FPU_SHARING=y

# Motor ESCs
CONFIG_PWM=y

# IMU (BMI088 over I2C3, required by CF21BL_STABILIZER)
CONFIG_SENSOR=y
CONFIG_I2C=y
CONFIG_BMI08X=y
CONFIG_BMI08X_GYRO_TRIGGER_OWN_THREAD=y
CONFIG_SENSOR_ASYNC_API=y

# Barometer (BMP390 at I2C3 0x77; CONFIG_BMP388 covers both chips) — Z control
CONFIG_BMP388=y

# Stabilizer layers
CONFIG_CF21BL_STABILIZER=y
CONFIG_CF21BL_ANGLE_MODE=y
CONFIG_CF21BL_ALTITUDE_HOLD=y

# Heading lock — world-frame XY corrections below assume boot-orientation
# yaw stays fixed (Mahony yaw is boot-relative with no absolute reference,
# so every drone must be placed nose along lighthouse world +X at power-on).
CONFIG_CF21BL_YAW_HOLD=y

# Lighthouse: X/Y position hold (replaces dead-reckoning odometry).  Each
# drone's real absolute position is gossiped instead of an integrated
# estimate — see formation.h for the shared-calibration requirement.
# POS_MAX_M=3 is the flight-validated setting for this room.
CONFIG_CF21BL_LIGHTHOUSE=y
CONFIG_CF21BL_LIGHTHOUSE_POS_HOLD=y
CONFIG_CF21BL_POS_MAX_M=3
CONFIG_SERIAL=y

# Battery telemetry + forced landing on critical voltage — independent per
# drone (cf21bl_stabilizer.c's PM-critical path), does not depend on peers.
CONFIG_CF21BL_PM=y

# Syslink P2P transceiver (requires interrupt-driven UART for RX ISR on
# USART6; also drives the lighthouse deck's USART3 and, if CONFIG_LOG=y,
# the CRTP console — all interrupt-driven UARTs share this one option).
CONFIG_UART_INTERRUPT_DRIVEN=y
CONFIG_TAPESTRY_TRANSCEIVER_SYSLINK=y
CONFIG_TAPESTRY_P2P_CHANNEL=80

# Identity: choreo mode (default) negotiates IDs at boot over syslink P2P —
# one binary for all drones, no per-drone flags.  The nonce comes from the
# STM32's unique device ID (CONFIG_HWINFO).  TAPESTRY_ELEMENT_ID is only
# used by the legacy showcase mode (-DCONFIG_DEMO_MODE_SHOWCASE=y ...
# -DCONFIG_TAPESTRY_ELEMENT_ID=1).
CONFIG_HWINFO=y
CONFIG_TAPESTRY_ELEMENT_ID=0
# 6 s window (vs 4 s cutebot default): the drones' boot times differ by
# gyro-cal duration on top of power-on skew.
CONFIG_TAPESTRY_AUTO_ID_WINDOW_MS=6000

# ESC protocol: OneShot125 (validated on tether 2026-07-03; delete to fall back to RC PWM 400 Hz)
CONFIG_CF21BL_ESC_ONESHOT125=y
```

## boards/crazyflie21bl.conf
```kconfig
# USART3 taken by the lighthouse deck at 230400 baud (see the
# crazyflie21bl_lh.overlay fragment) — no wired console available.
# USART6 is shared by the syslink P2P transceiver, the CRTP console backend,
# and (if CONFIG_CF21BL_PM=y) battery telemetry, serialized by
# cf21bl_syslink_tx_mutex.
# Read: python3 tapestry/tapestry-os/tools/crazyflie_console.py
# Disable motors: west build ... -- -DCONFIG_PWM=n
CONFIG_UART_CONSOLE=n
CONFIG_LOG_BACKEND_UART=n
CONFIG_LOG_OUTPUT=y
CONFIG_LOG_BACKEND_SHOW_COLOR=n
CONFIG_I2C_LOG_LEVEL_WRN=y
CONFIG_UART_LOG_LEVEL_WRN=y
```

## boards/crazyflie21bl_lh.overlay
```dts
/* Reconfigure USART3 to 230400 baud for lighthouse deck FPGA data stream */
&usart3 {
	current-speed = <230400>;
	status = "okay";
};
```

## src/choreo_script.h
```c
/*
 * choreo_script.h — GENERATED from change-partners.choreo.toml — DO NOT EDIT.
 *
 * Choreo: "change-partners"
 * Regenerate after editing the script file:
 *   python3 tapestry/sdk/tools/choreoc.py tapestry/examples/cf21bl-formation/change-partners.choreo.toml -o tapestry/examples/cf21bl-formation/src/choreo_script.h
 *
 * Every step is time-bounded by construction (choreoc requires it): the
 * script cannot stall in flight, and CHOREO_SCRIPT_TOTAL_TIMEOUT_MS is a
 * hard upper bound on script runtime for mission-backstop math.
 */

#ifndef TAPESTRY_CHOREO_SCRIPT_H
#define TAPESTRY_CHOREO_SCRIPT_H

#include <tapestry/choreo.h>

#define CHOREO_NAME                    "change-partners"
#define CHOREO_SCRIPT_LEN              3u
#define CHOREO_SCRIPT_TOTAL_TIMEOUT_MS 48000u

/* Element departure policy — call choreo_set_departure_policy() (and,
 * for CHOREO_DEPARTURE_RECALL, choreo_set_departure_recall_point_fn())
 * before choreo_submit_script(). */
#define CHOREO_DEPARTURE_POLICY           CHOREO_DEPARTURE_CONTINUE
#define CHOREO_DEPARTURE_REASONS          CHOREO_DEPARTURE_REASONS_ALL
#define CHOREO_DEPARTURE_MIN_PARTICIPANTS 0u

static const choreo_step_t k_choreo_script[CHOREO_SCRIPT_LEN] = {
    { .goal = { .type = CHOREO_GOAL_HOLD,
                .required_caps = CHOREO_CAP_LOCOMOTION },
      .max_duration_ms = 10000u,
      .advance_on_achieved = false },

    { .goal = { .type = CHOREO_GOAL_EXCHANGE,
                .required_caps = CHOREO_CAP_LOCOMOTION,
                .achieve_eps = 0.25f,
                .achieve_hold_ms = 3000u },
      .max_duration_ms = 30000u,
      .advance_on_achieved = true, .scope = CHOREO_SCOPE_ALL },

    { .goal = { .type = CHOREO_GOAL_HOLD,
                .required_caps = CHOREO_CAP_LOCOMOTION },
      .max_duration_ms = 8000u,
      .advance_on_achieved = false },
};

#endif /* TAPESTRY_CHOREO_SCRIPT_H */
```

## src/formation.c
```c
/*
 * formation.c — CF21BL holonomic spring-field formation control
 *
 * See formation.h for the meters-based unit convention and why this
 * differs from examples/cutebot-formation's dead-reckoning approach.
 */

#include "formation.h"

#include <math.h>
#include <stddef.h>
#include <zephyr/logging/log.h>

LOG_MODULE_REGISTER(formation, LOG_LEVEL_DBG);

/* Per-tick trace throttle.  The tracking traces below fire once per
 * control tick (10 Hz per drone, 20 Hz for a pair) — at full rate they
 * were the single largest source of console splicing on a shared CRTP
 * address, and they destroyed the 1 Hz status timeline in flights 15/16.
 * Dropping the whole module to INF fixed the splicing but took min_d with
 * it, which is a safety number; throttling instead keeps the trace and
 * its min_d while cutting the volume tenfold.  DEMO_CONSOLE_VERBOSE
 * restores the full per-tick rate for single-drone debugging. */
#ifdef CONFIG_DEMO_CONSOLE_VERBOSE
#define DEMO_TRACE_DIV 1
#else
#define DEMO_TRACE_DIV 10      /* ~1 Hz at WM_CYCLE_MS = 100 */
#endif

static float clampf(float v, float lo, float hi)
{
    return v < lo ? lo : (v > hi ? hi : v);
}

void demo_setpoint_init(demo_setpoint_t *sp, float x, float y)
{
    sp->x      = x;
    sp->y      = y;
    sp->moving = false;
}

/* A peer worth measuring against or steering by: active, not ourselves,
 * and actually localized.  ELEMENT_HEALTH_NO_POSITION means the element is
 * gossiping its zero-init placeholder because it has no fix yet — see the
 * flag's comment in csm.h for the flight-41 phantom-at-the-origin this
 * excludes.  Applied to the distance scan and to both force loops: a
 * position nobody has measured is not something to warn about OR steer by. */
static bool peer_has_position(const wm_entry_t *e)
{
    return e->is_active && !e->is_self &&
           (e->state.health_flags & ELEMENT_HEALTH_NO_POSITION) == 0;
}

/* See formation.h.  This is deliberately the ONLY place the two drive
 * functions get their min_dist from: their force loops still skip stale
 * peers, so leaving the bookkeeping inside those loops is exactly what
 * made the check inert.
 *
 * 3D distance, matching the force loops' metric — see the block comment in
 * demo_compute_drive for why z is folded in here too. */
float demo_min_separation(const world_model_t *wm,
                          const position_t *own_pos_m,
                          demo_sep_t *sep)
{
    float      min_dist_m = -1.0f;
    demo_sep_t s          = { .stale = false, .age_ms = 0 };

    for (int i = 0; i < MAX_ELEMENTS; i++) {
        const wm_entry_t *e = &wm->entries[i];
        if (!peer_has_position(e)) {
            continue;
        }

        float dx   = e->state.position.x - own_pos_m->x;
        float dy   = e->state.position.y - own_pos_m->y;
        float dz   = e->state.position.z - own_pos_m->z;
        float dist = sqrtf(dx * dx + dy * dy + dz * dz);

        if (min_dist_m < 0.0f || dist < min_dist_m) {
            min_dist_m = dist;
            s.stale    = e->is_stale;
            s.age_ms   = e->age_ms;
        }
    }

    if (sep != NULL) {
        *sep = s;
    }
    return min_dist_m;
}

float demo_compute_drive(const world_model_t *wm,
                          const position_t *own_pos_m,
                          demo_setpoint_t *target,
                          uint32_t dt_ms,
                          element_id_t own_id,
                          demo_sep_t *sep_out)
{
    float dt = (float)dt_ms * 0.001f;

    /* Measured FIRST, ahead of the hold-on-stale return below: freezing the
     * drive is the right response to a stale peer, but riding that freeze
     * out with no idea how close the peer was is the blind spot this
     * measurement exists to close (the old code returned -1.0f here). */
    float min_dist_m = demo_min_separation(wm, own_pos_m, sep_out);

    /* Hold in place if any active peer is stale — the spring field would
     * otherwise be computed against a peer position we no longer trust. */
    for (int i = 0; i < MAX_ELEMENTS; i++) {
        const wm_entry_t *e = &wm->entries[i];
        if (e->is_active && !e->is_self && e->is_stale) {
            target->moving = false;
            return min_dist_m;
        }
    }

    float fx          = 0.0f;
    float fy          = 0.0f;
    int   peer_count  = 0;
    float peer_sum_x  = 0.0f;   /* for the formation centroid */
    float peer_sum_y  = 0.0f;
    float pair_dx     = 0.0f;   /* bearing to the (single) fresh peer — only
                                 * meaningful when peer_count ends up 1 */
    float pair_dy     = 0.0f;

    for (int i = 0; i < MAX_ELEMENTS; i++) {
        const wm_entry_t *e = &wm->entries[i];
        if (!peer_has_position(e) || e->is_stale) {
            continue;
        }

        peer_sum_x += e->state.position.x;
        peer_sum_y += e->state.position.y;

        /* 3D peer distance — see position_distance()'s comment in csm.h
         * for why this now folds in z, including for this safety-adjacent
         * threshold (DEMO_MIN_SEP_M/EMERGENCY_K below), and why that is an
         * explicit, requested choice rather than an incidental one.
         *
         * The force VECTOR (fx/fy) stays 2D: altitude is a separate,
         * independently-held control loop (CONFIG_CF21BL_ALTITUDE_HOLD)
         * that this change does not touch. That means the force MAGNITUDE
         * (spring + repulsion, below) is computed from the 3D dist, but
         * the direction it gets applied in must be normalized by the 2D
         * (horizontal-only) magnitude, dist_xy — normalizing by the 3D
         * dist instead would silently shrink the horizontal push whenever
         * dz != 0 (dx/dist is not a unit vector once z is in dist), which
         * is not what "fold z into the distance metric" was asked for. */
        float dx      = e->state.position.x - own_pos_m->x;
        float dy      = e->state.position.y - own_pos_m->y;
        float dz      = e->state.position.z - own_pos_m->z;
        float dist    = sqrtf(dx * dx + dy * dy + dz * dz);
        float dist_xy = sqrtf(dx * dx + dy * dy);

        pair_dx = dx;
        pair_dy = dy;

        if (dist_xy < 0.01f) {
            continue;   /* coincident horizontally — push direction undefined */
        }

        /* Smooth spring toward DEMO_TARGET_SPACING_M. */
        float force = (dist - DEMO_TARGET_SPACING_M) * SPRING_K;

        /* Extra repulsion once inside the hard-floor separation — reacts
         * faster than the smooth spring term alone. */
        if (dist < DEMO_MIN_SEP_M) {
            force -= (DEMO_MIN_SEP_M - dist) * EMERGENCY_K;
        }

        fx += force * (dx / dist_xy);
        fy += force * (dy / dist_xy);
        peer_count++;
    }

    if (peer_count == 0) {
        /* No fresh peers: glide the target back over our own position and
         * hover (see DEMO_SOLO_GLIDE_MPS — a frozen far-away target made
         * the last drone standing chase it indefinitely). */
        float gx = own_pos_m->x - target->x;
        float gy = own_pos_m->y - target->y;
        float gd = sqrtf(gx * gx + gy * gy);
        if (gd > 0.01f) {
            float step = DEMO_SOLO_GLIDE_MPS * dt;
            if (step > gd) { step = gd; }
            target->x += gx / gd * step;
            target->y += gy / gd * step;
        }
        target->moving = false;
        return min_dist_m;
    }

    float force_mag = sqrtf(fx * fx + fy * fy);

    if (!target->moving && force_mag >= FORCE_START) {
        target->moving = true;
    } else if (target->moving && force_mag < FORCE_STOP) {
        target->moving = false;
    }

    /* Velocity assembled from up to three terms.  The spring term keeps
     * its start/stop hysteresis; the choreography terms below (rotation,
     * alignment — see formation.h) are deliberately NOT gated by it, since
     * they must act precisely when the springs are at equilibrium. */
    float vx = 0.0f;
    float vy = 0.0f;

    if (target->moving && force_mag >= 1e-6f) {
        float speed = clampf(force_mag * FORCE_TO_SPEED, 0.0f, DEMO_MAX_SPEED_MPS);
        vx += (fx / force_mag) * speed;
        vy += (fy / force_mag) * speed;
    }

    /* Formation centroid over self + fresh peers (real positions). */
    float cx = (peer_sum_x + own_pos_m->x) / (float)(peer_count + 1);
    float cy = (peer_sum_y + own_pos_m->y) / (float)(peer_count + 1);

    if (peer_count >= 2) {
        /* Triangle phase: orbit the centroid (v = ω ⟂ r, CCW). */
        vx += -DEMO_ROT_OMEGA_RADPS * (target->y - cy);
        vy +=  DEMO_ROT_OMEGA_RADPS * (target->x - cx);
    } else if (peer_count == 1) {
        /* Pair phase: rotate the pair about its centroid until its axis
         * lies along world X.  A torque, never a translation — see the
         * DEMO_ALIGN_ROT_RADPS block comment for why the earlier y-pull
         * version drove a north–south pair into a spring standoff. */
        float phi   = atan2f(pair_dy, pair_dx);
        float omega = -DEMO_ALIGN_ROT_RADPS * sinf(2.0f * phi);
        vx += -omega * (target->y - cy);
        vy +=  omega * (target->x - cx);
    }

    /* Centroid anchor (see DEMO_ANCHOR_* block comment): identical for
     * every drone → pure translation of the whole formation toward the
     * anchor point, no shape distortion. */
    vx += DEMO_ANCHOR_K * (DEMO_ANCHOR_X_M - cx);
    vy += DEMO_ANCHOR_K * (DEMO_ANCHOR_Y_M - cy);

    float v_mag = sqrtf(vx * vx + vy * vy);
    if (v_mag < 1e-6f) {
        return min_dist_m;
    }
    if (v_mag > DEMO_MAX_SPEED_MPS) {
        vx *= DEMO_MAX_SPEED_MPS / v_mag;
        vy *= DEMO_MAX_SPEED_MPS / v_mag;
    }

    target->x = clampf(target->x + vx * dt, -DEMO_ARENA_LIMIT_M, DEMO_ARENA_LIMIT_M);
    target->y = clampf(target->y + vy * dt, -DEMO_ARENA_LIMIT_M, DEMO_ARENA_LIMIT_M);

    /* Leash the target to the drone's real position (see
     * DEMO_TARGET_LEASH_M): every term above moves the TARGET, but the
     * forces are computed from REAL positions — once the body can't
     * follow, an unleashed target's relationship to the field is
     * fiction. */
    {
        float lx = target->x - own_pos_m->x;
        float ly = target->y - own_pos_m->y;
        float ld = sqrtf(lx * lx + ly * ly);
        if (ld > DEMO_TARGET_LEASH_M) {
            target->x = own_pos_m->x + lx / ld * DEMO_TARGET_LEASH_M;
            target->y = own_pos_m->y + ly / ld * DEMO_TARGET_LEASH_M;
        }
    }

    static int drive_trace_div;
    if (++drive_trace_div >= DEMO_TRACE_DIV) {
        drive_trace_div = 0;
        LOG_DBG("id=%u fx=%.2f fy=%.2f |f|=%.2f v=(%.2f,%.2f) tgt=(%.2f,%.2f) peers=%d min_d=%.2f",
                (unsigned)own_id,
                (double)fx, (double)fy, (double)force_mag,
                (double)vx, (double)vy,
                (double)target->x, (double)target->y,
                peer_count, (double)min_dist_m);
    }

    return min_dist_m;
}

bool demo_deconflict_point(const world_model_t *wm, float *x, float *y)
{
    bool moved = false;

    /* Horizontal-only, deliberately: this places a LANDING/return point on
     * the floor, and z is a separately-held loop that a landed peer is not
     * on anyway.  (The in-flight separation metric folds in z; see
     * demo_min_separation.  Different question, different geometry.)
     *
     * A bounded relaxation, not iterated to convergence: clearing one peer
     * can push the point inside another's floor, but in a crowded arena
     * there may be no clear point at all, and returning a spot 0.4 m from a
     * peer beats spinning here.  Four passes settles the 2-3 element case. */
    for (int pass = 0; pass < 4; pass++) {
        bool clear = true;

        for (int i = 0; i < MAX_ELEMENTS; i++) {
            const wm_entry_t *e = &wm->entries[i];
            if (!peer_has_position(e)) {
                continue;
            }

            float dx = *x - e->state.position.x;
            float dy = *y - e->state.position.y;
            float d  = sqrtf(dx * dx + dy * dy);
            if (d >= DEMO_MIN_SEP_M) {
                continue;
            }

            /* Point sits on top of the peer: every direction is equally
             * good, so pick a deterministic one rather than dividing by
             * ~zero. */
            if (d < 0.01f) {
                dx = 1.0f;
                dy = 0.0f;
                d  = 1.0f;
            }

            *x    = e->state.position.x + dx / d * DEMO_MIN_SEP_M;
            *y    = e->state.position.y + dy / d * DEMO_MIN_SEP_M;
            clear = false;
            moved = true;
        }

        if (clear) {
            break;
        }
    }

    if (moved) {
        *x = clampf(*x, -DEMO_ARENA_LIMIT_M, DEMO_ARENA_LIMIT_M);
        *y = clampf(*y, -DEMO_ARENA_LIMIT_M, DEMO_ARENA_LIMIT_M);
    }
    return moved;
}

/* ── Choreo tracking (see formation.h) ───────────────────────────────────── */

float demo_choreo_track(const world_model_t *wm,
                        const position_t *own_pos_m,
                        demo_setpoint_t *target,
                        float cmd_x, float cmd_y,
                        uint32_t dt_ms,
                        element_id_t own_id,
                        demo_sep_t *sep_out)
{
    float dt = (float)dt_ms * 0.001f;

    /* Separation is measured over every ACTIVE peer (stale included);
     * emergency repulsion below is applied for FRESH peers only.  That
     * split is the whole point of this function's share of the fix: unlike
     * demo_compute_drive there is no hold-on-stale freeze here, so a peer
     * sitting in the stale-but-not-expired band used to mean flying with
     * the DEMO_MIN_SEP_M check switched off entirely. */
    float min_dist_m = demo_min_separation(wm, own_pos_m, sep_out);

    /* Emergency repulsion over fresh peers.  Same constants and force
     * convention as the spring field, but no attraction term — the L6
     * directive owns where we are going. */
    float fx = 0.0f;
    float fy = 0.0f;

    for (int i = 0; i < MAX_ELEMENTS; i++) {
        const wm_entry_t *e = &wm->entries[i];
        if (!peer_has_position(e) || e->is_stale) {
            continue;
        }

        /* Same 3D-distance / 2D-force-direction split as demo_compute_drive
         * above — see that function's comment for the full rationale. */
        float dx      = e->state.position.x - own_pos_m->x;
        float dy      = e->state.position.y - own_pos_m->y;
        float dz      = e->state.position.z - own_pos_m->z;
        float dist    = sqrtf(dx * dx + dy * dy + dz * dz);
        float dist_xy = sqrtf(dx * dx + dy * dy);

        if (dist_xy < 0.01f) {
            continue;   /* coincident horizontally — push direction undefined */
        }
        if (dist < DEMO_MIN_SEP_M) {
            float force = (DEMO_MIN_SEP_M - dist) * EMERGENCY_K;
            fx -= force * (dx / dist_xy);
            fy -= force * (dy / dist_xy);
        }
    }

    /* Approach velocity toward the directive point.  ad/dt (not just the
     * speed clamp) lets the target land exactly on cmd once close. */
    float vx = fx * FORCE_TO_SPEED;
    float vy = fy * FORCE_TO_SPEED;

    float ax = cmd_x - target->x;
    float ay = cmd_y - target->y;
    float ad = sqrtf(ax * ax + ay * ay);
    if (ad > 1e-6f) {
        float speed = ad / dt;
        if (speed > DEMO_MAX_SPEED_MPS) {
            speed = DEMO_MAX_SPEED_MPS;
        }
        vx += (ax / ad) * speed;
        vy += (ay / ad) * speed;
    }

    float v_mag = sqrtf(vx * vx + vy * vy);
    if (v_mag > DEMO_MAX_SPEED_MPS) {
        vx *= DEMO_MAX_SPEED_MPS / v_mag;
        vy *= DEMO_MAX_SPEED_MPS / v_mag;
    }

    target->x = clampf(target->x + vx * dt, -DEMO_ARENA_LIMIT_M, DEMO_ARENA_LIMIT_M);
    target->y = clampf(target->y + vy * dt, -DEMO_ARENA_LIMIT_M, DEMO_ARENA_LIMIT_M);

    /* Same leash rationale as the spring field: never command further than
     * the body can meaningfully chase. */
    {
        float lx = target->x - own_pos_m->x;
        float ly = target->y - own_pos_m->y;
        float ld = sqrtf(lx * lx + ly * ly);
        if (ld > DEMO_TARGET_LEASH_M) {
            target->x = own_pos_m->x + lx / ld * DEMO_TARGET_LEASH_M;
            target->y = own_pos_m->y + ly / ld * DEMO_TARGET_LEASH_M;
        }
    }

    static int choreo_trace_div;
    if (++choreo_trace_div >= DEMO_TRACE_DIV) {
        choreo_trace_div = 0;
        LOG_DBG("id=%u choreo cmd=(%.2f,%.2f) tgt=(%.2f,%.2f) min_d=%.2f",
                (unsigned)own_id,
                (double)cmd_x, (double)cmd_y,
                (double)target->x, (double)target->y,
                (double)min_dist_m);
    }

    return min_dist_m;
}

/* ── Signal feedback (LED) ────────────────────────────────────────────────── */

void demo_set_leds(const world_model_t *wm, substrate_signal_t step_indicator)
{
    if (step_indicator != SUBSTRATE_SIGNAL_NONE) {
        substrate_set_signal(step_indicator);
        return;
    }

    int fresh  = 0;
    int active = 0;

    for (int i = 0; i < MAX_ELEMENTS; i++) {
        const wm_entry_t *e = &wm->entries[i];
        if (!e->is_active || e->is_self) {
            continue;
        }
        active++;
        if (!e->is_stale) {
            fresh++;
        }
    }

    substrate_signal_t sig;
    if      (active == 0)      sig = SUBSTRATE_SIGNAL_FAILED;
    else if (fresh  <  active) sig = SUBSTRATE_SIGNAL_DEGRADED;
    else                       sig = SUBSTRATE_SIGNAL_ACTIVE;
    substrate_set_signal(sig);
}
```

## src/formation.h
```c
/*
 * formation.h — CF21BL collective formation (L4 only, no SCR)
 *
 * Holonomic spring-field formation control driven by real lighthouse
 * position, not dead reckoning.
 *
 * Units: element_state_t.position (and everything in this file) is in
 * METERS, home-relative in the shared lighthouse world frame — NOT the
 * abstract [0,100] WORLD_SIZE convention csm.h's other constants
 * (MIN_SEPARATION, REPULSION_RADIUS, GOSSIP_RADIUS) assume.  Those CSM
 * constants are unused by this example for exactly that reason; formation.c
 * and main.c define their own meter-scale thresholds instead.
 *
 * REQUIRES all drones to share the SAME lighthouse base-station poses and
 * OOTX calibration (main.c) — gossiped positions are only comparable if
 * every drone's "home" is the same physical point in the same physical
 * frame.  Flash all drones from the same build of this example.
 *
 * Key differences from the old dead-reckoning version:
 *   - No heading/odometry integration: cf21bl_stabilizer's
 *     CF21BL_LIGHTHOUSE_POS_HOLD loop is holonomic (absolute X/Y setpoint,
 *     rotated into body frame internally by Mahony yaw), so formation
 *     control just outputs a target XY point, no forward/turn decomposition.
 *   - Peer distances and separation math use REAL measured position
 *     (broadcast by main.c from cf21bl_lighthouse_get_position()), not an
 *     integrated estimate — no drift accumulation.
 *   - demo_setpoint_t is a virtual, slowly-moving target the stabilizer's
 *     position PID chases; it is deliberately NOT the same as the drone's
 *     real position, so peers always gossip ground truth.
 */

#ifndef TAPESTRY_CF21BL_FORMATION_H
#define TAPESTRY_CF21BL_FORMATION_H

#include <stdint.h>
#include <stdbool.h>
#include <tapestry/csm.h>
#include <tapestry/substrate.h>

/* Desired peer spacing at equilibrium, meters. */
#ifndef DEMO_TARGET_SPACING_M
#define DEMO_TARGET_SPACING_M  1.0f
#endif

/* Max commanded approach speed, m/s — conservative for a first campaign. */
#ifndef DEMO_MAX_SPEED_MPS
#define DEMO_MAX_SPEED_MPS     0.3f
#endif

/* Spring constant — force per meter of spacing error. */
#define SPRING_K            1.0f

/* Hard-floor separation, meters — below this an extra repulsion term (on
 * top of the smooth spring) reacts faster than SPRING_K alone would.
 * 0.5 m is a props-clearance margin, not a contact distance. */
#define DEMO_MIN_SEP_M      0.5f
#define EMERGENCY_K         4.0f

/* Maps net spring force magnitude to a commanded speed fraction of
 * DEMO_MAX_SPEED_MPS. */
#define FORCE_TO_SPEED      0.15f

/* Hysteresis thresholds on net spring force magnitude (avoids dithering
 * right at equilibrium). */
#define FORCE_STOP          0.15f
#define FORCE_START         0.30f

/* Arena clamp for the commanded target — keeps formation.c's output well
 * inside the stabilizer's CF21BL_POS_MAX_M range (main.c enforces the
 * tighter, landing-triggering geofence on the drone's REAL position). */
#define DEMO_ARENA_LIMIT_M  ((float)CONFIG_CF21BL_POS_MAX_M - 0.3f)

/* ── Choreography terms (phase = pure function of fresh-peer count) ───────
 *
 * Rotation: with exactly TWO fresh peers (full triangle), each drone's
 * target orbits the formation centroid (self + fresh peers, real gossiped
 * positions — every drone computes ≈ the same point, no leader) at this
 * angular rate.  0.12 rad/s ≈ 6.9°/s → just over half a revolution across
 * a 30 s triangle phase; tangential speed at the 1 m-triangle circumradius
 * (0.58 m) is ~0.07 m/s, well inside DEMO_MAX_SPEED_MPS.  0.0f disables. */
#define DEMO_ROT_OMEGA_RADPS  0.12f

/* Alignment: with exactly ONE fresh peer (pair phase), the pair ROTATES
 * about its centroid until the pair axis lies along world X (mod π):
 * ω = −K·sin(2φ), where φ is the bearing to the peer.  sin(2φ) is
 * identical from both ends of the pair (φ vs φ+π), so both drones agree
 * on the rotation direction with no communication, and a pure rotation
 * preserves separation by construction.
 *
 * HISTORY (2026-07-11 rehearsal): the first version instead pulled each
 * target's y toward the pair centroid's y.  For a pair left oriented
 * north–south by the preceding rotation phase, "converge in y" means
 * "fly at each other" — the y-pull fought the springs to a standoff at
 * min_d≈0.34 m, |f|≈1.31 (= spring −0.66 + emergency 0.64 exactly), with
 * only the altitude stagger as real margin.  Alignment must be a torque,
 * never a translation.
 *
 * Peak rate 0.25 rad/s at φ=45°; tangential speed ≤ ~0.13 m/s at 0.5 m
 * radius.  φ=90° (exactly N–S) is the unstable equilibrium — sensor noise
 * seeds the rotation in either direction, both of which are correct.
 * Transient radio-contention staleness blips cannot falsely trigger the
 * pair phase: any active-but-stale peer freezes the whole drive
 * (hold-in-place check near the top of demo_compute_drive — it now sits
 * just after the separation scan, which must run first so the frozen
 * drive still reports how close the stale peer was), so peer_count
 * only drops to 1 after a peer is fully expired
 * (WM_EXPIRE_THRESHOLD_MS = genuinely gone). */
#define DEMO_ALIGN_ROT_RADPS  0.25f

/* Centroid anchor: every drone adds v = K·(anchor − formation_centroid).
 * The springs/rotation/alignment terms control SHAPE and ORIENTATION only
 * — the field is otherwise translation-invariant, so the formation lives
 * wherever accumulated drift leaves it (2026-07-11 full run: the pair
 * re-formed a clean X-parallel line, but displaced ~(+0.2,+0.3) from the
 * ground marks; an earlier rehearsal drifted ~0.5 m west when one biased
 * member dragged the rest through the springs).  The anchor is identical
 * for every drone, so it is a pure translation — zero shape distortion,
 * still leaderless.  K=0.08 /s (τ≈12 s, ≤0.04 m/s at 0.5 m offset) —
 * deliberately the weakest term in the field: it parks the show over the
 * marks without visibly fighting the choreography.  Set K to 0 for
 * pure-emergence mode (no world-frame preference at all).  Anchor point
 * chosen between the marks-layout pair centroid (0.5, 0) and triangle
 * centroid (0.5, 0.29). */
#define DEMO_ANCHOR_X_M       0.5f
#define DEMO_ANCHOR_Y_M       0.15f
#define DEMO_ANCHOR_K         0.08f

/* Target leash: the virtual target may never be further than this from the
 * drone's REAL position.  Without it the target can detach unboundedly
 * (2026-07-11 flight: an emergency-repulsion episode pushed targets away
 * at the 0.3 m/s clamp for seconds, then the alignment torque — whose
 * tangential speed is ω·|target−centroid|, unbounded in radius — kept a
 * target orbiting 2.7 m from its drone at max speed; the drone chased a
 * point it could never reach).  0.75 m matches the stabilizer's own
 * error-saturation radius: commanding further is meaningless anyway. */
#define DEMO_TARGET_LEASH_M   0.75f

/* With ZERO fresh peers the target glides back over the drone's own
 * position at this rate (→ hover in place).  Previously it froze wherever
 * the field last left it — fine when the target had never moved, but
 * after a chaotic episode the last survivor chased a stranded far-away
 * target indefinitely (2026-07-11: id=0 "ran away" toward a target
 * abandoned at (−0.7,−0.8) after both peers landed). */
#define DEMO_SOLO_GLIDE_MPS   0.15f

/* ── Formation target state ──────────────────────────────────────────────── */

typedef struct {
    float x;   /* commanded X setpoint, meters, home-relative */
    float y;   /* commanded Y setpoint, meters, home-relative */
    bool  moving;
} demo_setpoint_t;

void demo_setpoint_init(demo_setpoint_t *sp, float x, float y);

/* ── Separation provenance ───────────────────────────────────────────────────
 *
 * Both drive functions below measure their minimum peer distance over every
 * ACTIVE peer, stale entries included.  is_stale only means "no gossip for
 * WM_STALE_THRESHOLD_MS (3000 ms)" — it does NOT mean "no data": the entry
 * keeps its last-known position until WM_EXPIRE_THRESHOLD_MS (5000 ms)
 * retires it.  Throwing that 3–5 s band away (1.5–5 s when flight 25
 * flew) left the DEMO_MIN_SEP_M check completely inert for ~57% of flight
 * 25's status samples (27/45 and 24/45), and a 2 s-old position is a far
 * better answer to "are we about to collide" than no answer at all.
 *
 * The FORCES still act on fresh peers only — a stale position is fine to
 * warn about, not fine to steer by — so a returned distance can no longer
 * be assumed to be a live measurement.  Rather than overload the float
 * (whose -1.0f already means "no data at all"), that distinction is carried
 * out here: callers that treat a violation as actionable need to know
 * whether they are looking at a measurement or at a memory.
 */
typedef struct {
    bool     stale;    /* nearest contributor was stale-but-active         */
    uint32_t age_ms;   /* that contributor's wm_entry_t.age_ms (0 if none) */
} demo_sep_t;

/* Distance (meters, 3D) to the nearest ACTIVE peer, stale entries included
 * — the measurement both drive functions below report, exposed on its own
 * for callers that need the separation number on a tick where no drive
 * ran (main.c's choreo SUSPENDED / HOLD-directive path freezes the target
 * but the airframe is still flying, and a peer can still close on it).
 * Returns -1.0f only when no peer is active at all.  *sep (may be NULL)
 * receives the nearest contributor's provenance. */
float demo_min_separation(const world_model_t *wm,
                          const position_t *own_pos_m,
                          demo_sep_t *sep);

/* Push (*x, *y) — a point this drone intends to fly to and LAND on — out
 * to DEMO_MIN_SEP_M from every active, localized peer.  Returns true if the
 * point had to move.  Horizontal-only: it is a floor placement.
 *
 * The case this exists for is return-to-home.  RTH aims at a stored takeoff
 * point with no knowledge of what has happened in the arena since, and
 * after an EXCHANGE that point is exactly where the partner now is
 * (2026-08-31 flight 42: a battery-preempted RTH flew to within 0.24 m of a
 * partner already sitting on the floor there, logging min_d 0.39 m against
 * a 0.50 m floor).  This is a one-shot correction taken when the goal is
 * submitted, not a tracking loop — the in-flight repulsion in
 * demo_choreo_track remains the continuous defense. */
bool demo_deconflict_point(const world_model_t *wm, float *x, float *y);

/* Advance *target toward the spring-field equilibrium by dt_ms, using
 * REAL peer positions from wm and this drone's REAL position (own_pos_m,
 * meters) for the force calculation.  Also returns the minimum distance
 * observed to any ACTIVE peer this call (for main.c's separation warning),
 * or -1.0f only when no peer is active at all; *sep_out (may be NULL)
 * says whether that nearest peer was stale and how old its position is —
 * see demo_sep_t.  The measurement is taken BEFORE the hold-on-stale early
 * return below, so a frozen drive still reports how close its stale peer
 * was.  own_id is only used to tag the LOG_DBG line — with multiple drones
 * sharing one radio channel (no per-drone channel plan yet), interleaved
 * console output is otherwise impossible to attribute to a specific
 * drone. */
float demo_compute_drive(const world_model_t *wm,
                          const position_t *own_pos_m,
                          demo_setpoint_t *target,
                          uint32_t dt_ms,
                          element_id_t own_id,
                          demo_sep_t *sep_out);

/* Choreo tracking (CONFIG_DEMO_MODE_CHOREO): advance *target toward the L6
 * directive point (cmd_x, cmd_y) at up to DEMO_MAX_SPEED_MPS, keeping the
 * spring field's defense-in-depth terms — emergency repulsion inside
 * DEMO_MIN_SEP_M of any FRESH peer, the target leash, and the arena clamp.
 * The BSE's exchange arc already deconflicts by construction; the repulsion
 * here is a backstop, not the primary separation mechanism.  Unlike
 * demo_compute_drive there is no hold-on-stale check: staleness handling
 * belongs to the caller's quorum mapping (stale peers → choreo SUSPENDED →
 * target frozen).  Returns the minimum ACTIVE-peer distance seen (-1 only
 * when no peer is active at all), with *sep_out (may be NULL) reporting
 * whether that nearest peer was stale — see demo_sep_t.  This mode is the
 * reason that split exists: demo_choreo_track never freezes, so before it
 * measured stale peers it could fly fully blind on separation for as long
 * as a peer sat in the stale-but-not-expired band. */
float demo_choreo_track(const world_model_t *wm,
                        const position_t *own_pos_m,
                        demo_setpoint_t *target,
                        float cmd_x, float cmd_y,
                        uint32_t dt_ms,
                        element_id_t own_id,
                        demo_sep_t *sep_out);

/* ── Signal feedback (LED) ────────────────────────────────────────────────── */

/* step_indicator: the active script step's declared indicator effect
 * (choreo_current_indicator(), §12 Stage 5) — SUBSTRATE_SIGNAL_NONE means
 * no override, the default and the behavior of every script written
 * before this feature existed.  Non-NONE takes priority over this
 * function's own quorum/freshness heuristic below. */
void demo_set_leds(const world_model_t *wm, substrate_signal_t step_indicator);

#endif /* TAPESTRY_CF21BL_FORMATION_H */
```
