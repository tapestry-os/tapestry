## CMakeLists.txt
```
cmake_minimum_required(VERSION 3.20.0)

find_package(Zephyr REQUIRED HINTS $ENV{ZEPHYR_BASE})
project(tapestry_leak_sensor)

set(TAPESTRY_OS_ROOT      ${CMAKE_CURRENT_SOURCE_DIR}/../../tapestry-os)
set(TAPESTRY_OS_CSM       ${TAPESTRY_OS_ROOT}/subsys/csm)
set(TAPESTRY_OS_TRANSPORT ${TAPESTRY_OS_ROOT}/subsys/transport)

# L4 world model + shared facts, transport, and L5/L6/L7: the sensor runs
# the same Choreo as the robots (it lands on the script's catch-all track).
target_sources(app PRIVATE
    src/main.c
    ${TAPESTRY_OS_CSM}/world_model.c
    ${TAPESTRY_OS_CSM}/facts.c
    ${TAPESTRY_OS_TRANSPORT}/transport.c
    ${TAPESTRY_OS_TRANSPORT}/gossip.c
    ${TAPESTRY_OS_ROOT}/subsys/scr/scr.c
    ${TAPESTRY_OS_ROOT}/subsys/bse/bse.c
    ${TAPESTRY_OS_ROOT}/subsys/choreo/choreo.c
)

if(CONFIG_BT)
    target_sources(app PRIVATE ${TAPESTRY_OS_TRANSPORT}/transceiver_ble.c)
endif()

# Must match cutebot-formation's override (its CMakeLists.txt explains the
# value): the membership debounce is part of how the script behaves.
target_compile_definitions(app PRIVATE
    CHOREO_MEMBERSHIP_HOLD_MS=3000u
    CHOREO_REMOTE_ADOPT_HOLD_MS=3000u
)

target_include_directories(app PRIVATE
    ${TAPESTRY_OS_ROOT}/include                    # <tapestry/csm.h>, <tapestry/transport.h>
    ${CMAKE_CURRENT_SOURCE_DIR}/../../sdk/include  # <tapestry/choreo.h>
    ${TAPESTRY_OS_CSM}
    ${TAPESTRY_OS_TRANSPORT}                       # gossip.h, transceiver_ble.h
    src
)

target_link_libraries(app PRIVATE m)
```

## Kconfig
```
mainmenu "Tapestry leak-sensor"

source "Kconfig.zephyr"
rsource "../../tapestry-os/subsys/transport/Kconfig"

config TAPESTRY_ELEMENT_ID
	int "Element ID (fixed, not negotiated)"
	range 0 31
	default 31
	help
	  A stationary element takes a fixed ID instead of joining auto-ID
	  negotiation. Keep it at the top of [0, MAX_ELEMENTS) so it can never
	  collide with a robot's negotiated ID, which counts up from 0. Give
	  each sensor in the same deployment its own (31, 30, ...).

config LEAK_SENSOR_X
	int "Position X, world units"
	range 0 100
	default 70
	help
	  Where the sensor sits on the board, in the robots' [0, 100] world
	  (examples/cutebot-formation: one chessboard square = 10 units,
	  centre (50, 50)). The robots learn it from this element's gossip and
	  ring this point, so place the board where this says.

config LEAK_SENSOR_Y
	int "Position Y, world units"
	range 0 100
	default 70
```

## prj.conf
```kconfig
# ── Stack / heap ──────────────────────────────────────────────────────────────
CONFIG_MAIN_STACK_SIZE=8192

# ── Floating point ────────────────────────────────────────────────────────────
CONFIG_FPU=y

# ── Logging ───────────────────────────────────────────────────────────────────
CONFIG_LOG=y
CONFIG_LOG_DEFAULT_LEVEL=3
CONFIG_PRINTK=y

# ── Buttons and LEDs (devicetree aliases sw0/sw1, led0..led2) ─────────────────
CONFIG_GPIO=y

# Board-specific configs (BLE) live in boards/<board>.conf.
```

## boards/apollo330mP_evb.conf
```kconfig
# Ambiq Apollo330M Plus EVB (Apollo330P / Cortex-M55) — BLE only.
#
# The on-die BLE controller is reached over HCI IPC (zephyr,bt-hci in the
# board DTS). Same BLE settings as tapestry-scr-hw/boards/apollo330mP_evb.conf,
# without the wired serial bus. Builds in the Ambiq workspace — see
# tapestry-os/boards/apollo330mP_evb/README.md.

CONFIG_FPU_SHARING=y

# ── Gossip transport: BLE ─────────────────────────────────────────────────────
CONFIG_BT=y
CONFIG_BT_OBSERVER=y
CONFIG_BT_BROADCASTER=y
# The robots advertise the gossip frame with extended advertising; the
# scanner only receives those reports with this on.
CONFIG_BT_EXT_ADV=y
# Two advertising sets: state gossip and shared facts (transceiver_ble.c).
CONFIG_BT_EXT_ADV_MAX_ADV_SET=2
CONFIG_BT_DEVICE_NAME="tapestry-leak-sensor"
CONFIG_BT_RX_STACK_SIZE=4096
CONFIG_SYSTEM_WORKQUEUE_STACK_SIZE=4096
```

## src/main.c
```c
/*
 * main.c — stationary leak sensor (examples/leak-sensor)
 *
 * A Tapestry element that never moves: a dev board placed on the robots'
 * board at a configured position (CONFIG_LEAK_SENSOR_X/Y), standing in for
 * a fixed leak detector.  Pressing sw0 reports a leak; the robots running
 * ../cutebot-formation/leak-sensor.choreo.toml then ring it.
 *
 * What makes it an element the robots understand:
 *
 *   - It gossips its state like any element, with ELEMENT_HEALTH_STATIONARY
 *     set (csm.h): the robots keep a smaller keep-out around it than around
 *     each other, and their auto-ID leaves it out of n_total.  It takes a
 *     fixed ID (CONFIG_TAPESTRY_ELEMENT_ID, default 31) and never runs
 *     auto-ID itself.
 *
 *   - It runs the robots' own Choreo.  Lacking locomotion, it lands on the
 *     script's catch-all track and gossips that, so FORM and membership
 *     events on the robots' track never count it.
 *
 *   - The leak is a TARGET shared fact at its own position.  The state
 *     lives in the fact table every element holds, not in this program: a
 *     sensor that reboots relearns the fact from the robots, and LED2
 *     follows the table, not the button.
 *
 * Buttons and LEDs (devicetree aliases, so any board with them works):
 *
 *   sw0   report a leak — publishes the TARGET fact (retried each cycle
 *         until the table has synced with a peer, ~1-2 s after boot)
 *   sw1   clear — retracts it (a tombstone).  The robots' script answers
 *         "landmark_retracted" by forming a ring about the board centre and
 *         waiting for the next leak: the reset between runs.
 *   led0  on: running
 *   led1  on: at least one robot heard (fresh); off: alone
 *   led2  on: a leak is held in the fact table; blinking: publish pending
 */

#include <zephyr/kernel.h>
#include <zephyr/devicetree.h>
#include <zephyr/drivers/gpio.h>
#include <zephyr/logging/log.h>

#include <tapestry/csm.h>
#include <tapestry/scr.h>
#include <tapestry/transport.h>
#include <tapestry/choreo.h>

#include "choreo_script.h"

LOG_MODULE_REGISTER(leak_sensor, LOG_LEVEL_INF);

#ifndef CHOREO_N_TRACKS
#error "leak-sensor needs a [[tracks]] Choreo (see choreo_script.h)"
#endif

static const struct gpio_dt_spec btn_leak  = GPIO_DT_SPEC_GET_OR(DT_ALIAS(sw0), gpios, {0});
static const struct gpio_dt_spec btn_clear = GPIO_DT_SPEC_GET_OR(DT_ALIAS(sw1), gpios, {0});
static const struct gpio_dt_spec led_up    = GPIO_DT_SPEC_GET_OR(DT_ALIAS(led0), gpios, {0});
static const struct gpio_dt_spec led_peers = GPIO_DT_SPEC_GET_OR(DT_ALIAS(led1), gpios, {0});
static const struct gpio_dt_spec led_leak  = GPIO_DT_SPEC_GET_OR(DT_ALIAS(led2), gpios, {0});

/* A missing button or LED is not fatal — the element still gossips, and a
 * leak can still be held (and shown) from a peer. */
static bool pin_setup(const struct gpio_dt_spec *spec, gpio_flags_t flags,
                      const char *what)
{
    if (spec->port == NULL || !gpio_is_ready_dt(spec) ||
        gpio_pin_configure_dt(spec, flags) != 0) {
        LOG_WRN("%s not available", what);
        return false;
    }
    return true;
}

static void led_set(const struct gpio_dt_spec *spec, bool ok, bool on)
{
    if (ok) {
        gpio_pin_set_dt(spec, on ? 1 : 0);
    }
}

/* Rising edge of a button sampled once per cycle.  WM_CYCLE_MS is longer
 * than contact bounce, so one sample per cycle is its own debounce. */
static bool pressed_edge(const struct gpio_dt_spec *spec, bool ok, bool *was)
{
    bool now = ok && gpio_pin_get_dt(spec) > 0;
    bool edge = now && !*was;
    *was = now;
    return edge;
}

static int fresh_robots(const world_model_t *wm)
{
    int n = 0;
    for (int i = 0; i < MAX_ELEMENTS; i++) {
        const wm_entry_t *e = &wm->entries[i];
        if (e->is_active && !e->is_self && !e->is_stale &&
            !element_is_stationary(e)) {
            n++;
        }
    }
    return n;
}

int main(void)
{
    const element_id_t id = (element_id_t)CONFIG_TAPESTRY_ELEMENT_ID;
    const position_t   at = { (float)CONFIG_LEAK_SENSOR_X,
                              (float)CONFIG_LEAK_SENSOR_Y, 0.0f };

    bool leak_ok  = pin_setup(&btn_leak,  GPIO_INPUT, "sw0 (leak)");
    bool clear_ok = pin_setup(&btn_clear, GPIO_INPUT, "sw1 (clear)");
    bool up_ok    = pin_setup(&led_up,    GPIO_OUTPUT_INACTIVE, "led0");
    bool peers_ok = pin_setup(&led_peers, GPIO_OUTPUT_INACTIVE, "led1");
    bool lk_ok    = pin_setup(&led_leak,  GPIO_OUTPUT_INACTIVE, "led2");

    LOG_INF("leak sensor id=%u at (%.1f, %.1f) — stationary, fixed id",
            (unsigned)id, (double)at.x, (double)at.y);
    /* Board silkscreens number buttons and LEDs their own way; the pin
     * finds the part on the schematic. */
    const struct { const struct gpio_dt_spec *s; bool ok; const char *what; } pins[] = {
        { &btn_leak, leak_ok, "sw0  LEAK " }, { &btn_clear, clear_ok, "sw1  CLEAR" },
        { &led_up, up_ok, "led0 up   " }, { &led_peers, peers_ok, "led1 peers" },
        { &led_leak, lk_ok, "led2 leak " },
    };
    for (size_t i = 0; i < ARRAY_SIZE(pins); i++) {
        if (pins[i].ok) {
            LOG_INF("  %s = %s pin %u", pins[i].what, pins[i].s->port->name,
                    (unsigned)pins[i].s->pin);
        }
    }

    if (transport_init() != 0) {
        LOG_ERR("no transport — this sensor cannot be heard");
        return -1;
    }
    led_set(&led_up, up_ok, true);

    element_state_t own_state = {0};
    own_state.id           = id;
    own_state.position     = at;
    own_state.orientation  = orientation_identity();
    own_state.energy_level = 100u;
    own_state.health_flags = ELEMENT_HEALTH_STATIONARY;

    world_model_t wm;
    wm_init(&wm, id, &own_state, 0.0f);   /* pure AP, like the robots */

    /* Sensing, and an absolute position by construction (configured).  No
     * actuator: the script's "responders" track requires locomotion, so
     * this element takes the catch-all. */
    scr_state_t scr;
    scr_init(&scr, id, 1u, 1u, SCR_CAP_SENSOR | SCR_CAP_ABS_POSITION);

    choreo_init(id);
    choreo_register_scr(&scr);
    if (choreo_submit_tracks(&wm, k_choreo_tracks, CHOREO_N_TRACKS) != 0) {
        LOG_ERR("choreo \"%s\" rejected", CHOREO_NAME);
        return -1;
    }
    /* Gossip the track from the first frame on, not track 0 by default. */
    choreo_publish_state(&own_state);
    LOG_INF("choreo \"%s\" loaded — track %u", CHOREO_NAME,
            (unsigned)choreo_current_track());

    bool       leak_was = false, clear_was = false;
    bool       pending  = false;
    uint32_t   gossip_accum = GOSSIP_INTERVAL_MS;   /* send on the first tick */
    uint32_t   blink        = 0;
    int        last_robots  = -1;
    fact_key_t logged_key   = {0};
    bool       logged_held  = false;

    while (true) {
        transport_drain(&wm, id);   /* also runs the shared-fact duties */
        wm_tick(&wm, WM_CYCLE_MS);
        wm_update_self(&wm, &own_state);
        scr_tick(&scr, &wm);
        choreo_tick(&wm, &scr);
        choreo_publish_state(&own_state);

        if (pressed_edge(&btn_leak, leak_ok, &leak_was)) {
            LOG_INF("LEAK reported (sw0)");
            pending = true;
        }
        if (pending) {
            fact_key_t key;
            int rc = wm_fact_publish(&wm, FACT_TYPE_TARGET, &at, 0u,
                                     FACT_IMMUTABLE | FACT_PRIO(3), &key);
            if (rc == WM_FACT_CREATED || rc == WM_FACT_REUSED) {
                pending = false;
                LOG_INF("%s target %u/%04x/%u at (%.1f, %.1f)",
                        rc == WM_FACT_CREATED ? "PUBLISHED" : "already held:",
                        (unsigned)key.origin, (unsigned)key.epoch,
                        (unsigned)key.seq, (double)at.x, (double)at.y);
            } else if (rc != WM_FACT_ERR_UNSYNCED && rc != WM_FACT_ERR_NOEPOCH) {
                pending = false;
                LOG_ERR("target fact NOT published (%d)", rc);
            }
        }

        fact_t target;
        bool held = wm_fact_find(&wm, FACT_TYPE_TARGET, 0, &target);
        if (pressed_edge(&btn_clear, clear_ok, &clear_was)) {
            pending = false;
            if (held && wm_fact_retract(&wm, &target.key) == 0) {
                LOG_INF("leak CLEARED (sw1): target %u/%04x/%u retracted",
                        (unsigned)target.key.origin,
                        (unsigned)target.key.epoch,
                        (unsigned)target.key.seq);
                held = wm_fact_find(&wm, FACT_TYPE_TARGET, 0, &target);
            } else {
                LOG_INF("clear (sw1): no leak held");
            }
        }
        if (held && (!logged_held || !fact_key_equal(&logged_key, &target.key))) {
            LOG_INF("leak held: target %u/%04x/%u at (%.1f, %.1f)",
                    (unsigned)target.key.origin, (unsigned)target.key.epoch,
                    (unsigned)target.key.seq,
                    (double)target.pos.x, (double)target.pos.y);
            logged_key = target.key;
        } else if (!held && logged_held) {
            LOG_INF("no leak held");
        }
        logged_held = held;

        int robots = fresh_robots(&wm);
        if (robots != last_robots) {
            LOG_INF("robots heard: %d -> %d", last_robots, robots);
            last_robots = robots;
        }

        blink++;
        led_set(&led_peers, peers_ok, robots > 0);
        led_set(&led_leak, lk_ok, held || (pending && (blink & 2u)));

        gossip_accum += WM_CYCLE_MS;
        if (gossip_accum >= GOSSIP_INTERVAL_MS) {
            own_state.update_seq++;
            transport_send(&own_state, TAPESTRY_QOS_SOFT_RT);
            gossip_accum = 0;
        }

        k_msleep(WM_CYCLE_MS);
    }

    return 0;
}
```

## src/choreo_script.h
```c
/*
 * choreo_script.h — GENERATED from leak-sensor.choreo.toml — DO NOT EDIT.
 *
 * Choreo: "leak-sensor" (2 tracks, §7)
 * Regenerate after editing the script file:
 *   python3 tapestry/sdk/tools/choreoc.py tapestry/examples/cutebot-formation/leak-sensor.choreo.toml -o tapestry/examples/leak-sensor/src/choreo_script.h
 *
 * Every step is time-bounded by construction (choreoc requires it).  An
 * element runs exactly one track at a time, chosen by the first filter it
 * matches (choreo_submit_tracks()); CHOREO_SCRIPT_TOTAL_TIMEOUT_MS is the
 * worst case across every track — a hard upper bound on any single
 * element's runtime for mission-backstop math.
 */

#ifndef TAPESTRY_CHOREO_SCRIPT_H
#define TAPESTRY_CHOREO_SCRIPT_H

#include <tapestry/choreo.h>

#define CHOREO_NAME                    "leak-sensor"
#define CHOREO_N_TRACKS                2u
#define CHOREO_SCRIPT_TOTAL_TIMEOUT_MS 5400000u
#define CHOREO_USES_DISCOVERY           1u   /* arms the application's find detection */
#define CHOREO_USES_LANDMARKS           1u   /* reads finds as shared facts */

/* Element departure policy — call choreo_set_departure_policy() (and,
 * for CHOREO_DEPARTURE_RECALL, choreo_set_departure_recall_point_fn())
 * before choreo_submit_tracks(). */
#define CHOREO_DEPARTURE_POLICY           CHOREO_DEPARTURE_CONTINUE
#define CHOREO_DEPARTURE_REASONS          CHOREO_DEPARTURE_REASONS_ALL
#define CHOREO_DEPARTURE_MIN_PARTICIPANTS 0u

static const choreo_step_t k_choreo_track0_steps[4] = {
    { .goal = { .type = CHOREO_GOAL_FORM,
                .target = { 50.0f, 50.0f, 0.0f },
                .radius = 20.0f,
                .shape = TAPESTRY_BSE_SHAPE_CIRCLE,
                .required_caps = CHOREO_CAP_LOCOMOTION | CHOREO_CAP_ABS_POSITION,
                .achieve_eps = 3.0f,
                .achieve_hold_ms = 2000u },
      .max_duration_ms = 90000u,
      .advance_on_achieved = true, .on = { { .event = CHOREO_EVENT_ACHIEVED, .goto_step_idx = 1u }, { .event = CHOREO_EVENT_LANDMARK_ADDED, .goto_step_idx = 2u, .fact_type = FACT_TYPE_TARGET } }, .n_transitions = 2u, .indicator = SUBSTRATE_SIGNAL_IDLE },

    { .goal = { .type = CHOREO_GOAL_HOLD,
                .required_caps = CHOREO_CAP_LOCOMOTION },
      .max_duration_ms = 4500000u,
      .advance_on_achieved = false, .on = { { .event = CHOREO_EVENT_LANDMARK_ADDED, .goto_step_idx = 2u, .fact_type = FACT_TYPE_TARGET }, { .event = CHOREO_EVENT_ELEMENT_JOINED, .goto_step_idx = 0u }, { .event = CHOREO_EVENT_ELEMENT_LOST, .goto_step_idx = 0u } }, .n_transitions = 3u, .indicator = SUBSTRATE_SIGNAL_IDLE },

    { .goal = { .type = CHOREO_GOAL_FORM,
                .radius = 20.0f,
                .shape = TAPESTRY_BSE_SHAPE_CIRCLE,
                .frame = TAPESTRY_BSE_FRAME_ELEMENT,
                .anchor = TAPESTRY_BSE_ANCHOR_LANDMARK,
                .landmark_type = FACT_TYPE_TARGET,
                .landmark_rank = 0u,
                .required_caps = CHOREO_CAP_LOCOMOTION,
                .achieve_eps = 3.0f,
                .achieve_hold_ms = 2000u },
      .max_duration_ms = 90000u,
      .advance_on_achieved = true, .on = { { .event = CHOREO_EVENT_ACHIEVED, .goto_step_idx = 3u }, { .event = CHOREO_EVENT_LANDMARK_RETRACTED, .goto_step_idx = 0u, .fact_type = FACT_TYPE_TARGET } }, .n_transitions = 2u, .indicator = SUBSTRATE_SIGNAL_ACTIVE, .telemetry_tag = "leak" },

    { .goal = { .type = CHOREO_GOAL_HOLD,
                .required_caps = CHOREO_CAP_LOCOMOTION },
      .max_duration_ms = 4500000u,
      .advance_on_achieved = false, .on = { { .event = CHOREO_EVENT_ELEMENT_LOST, .goto_step_idx = 2u }, { .event = CHOREO_EVENT_ELEMENT_JOINED, .goto_step_idx = 2u }, { .event = CHOREO_EVENT_LANDMARK_RETRACTED, .goto_step_idx = 0u, .fact_type = FACT_TYPE_TARGET } }, .n_transitions = 3u, .indicator = SUBSTRATE_SIGNAL_ACTIVE },
};

static const choreo_step_t k_choreo_track1_steps[1] = {
    { .goal = { .type = CHOREO_GOAL_HOLD },
      .max_duration_ms = 5400000u,
      .advance_on_achieved = false },
};

static const choreo_track_t k_choreo_tracks[CHOREO_N_TRACKS] = {
    { .filter = { .required_caps = CHOREO_CAP_LOCOMOTION },
      .steps = k_choreo_track0_steps, .n_steps = 4u },
    { .filter = { 0 },
      .steps = k_choreo_track1_steps, .n_steps = 1u },
};

#endif /* TAPESTRY_CHOREO_SCRIPT_H */
```
