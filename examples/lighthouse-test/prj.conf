## CMakeLists.txt
```
cmake_minimum_required(VERSION 3.20.0)

list(APPEND BOARD_ROOT ${CMAKE_CURRENT_SOURCE_DIR}/../../tapestry-scr-hw)
list(APPEND DTS_ROOT   ${CMAKE_CURRENT_SOURCE_DIR}/../../tapestry-os)

find_package(Zephyr REQUIRED HINTS $ENV{ZEPHYR_BASE})
project(tapestry_lh2_test)

set(TAPESTRY_OS_BOARDS ${CMAKE_CURRENT_SOURCE_DIR}/../../tapestry-os/boards)

target_sources(app PRIVATE
    src/main.c
    ${TAPESTRY_OS_BOARDS}/crazyflie21bl/cf21bl_iwdg.c
    ${TAPESTRY_OS_BOARDS}/crazyflie21bl/cf21bl_crtp_log.c
    ${TAPESTRY_OS_BOARDS}/crazyflie21bl/cf21bl_syslink_tx.c
    ${TAPESTRY_OS_BOARDS}/crazyflie21bl/cf21bl_lighthouse.c
)
target_include_directories(app PRIVATE ${TAPESTRY_OS_BOARDS}/crazyflie21bl)
```

## Kconfig
```
mainmenu "Tapestry lighthouse-test"

source "Kconfig.zephyr"
rsource "../../tapestry-os/boards/crazyflie21bl/Kconfig"
```

## prj.conf
```kconfig
CONFIG_LOG=y
CONFIG_LOG_DEFAULT_LEVEL=3
CONFIG_LOG_BUFFER_SIZE=4096
CONFIG_LOG_OUTPUT=y
CONFIG_LOG_BACKEND_SHOW_COLOR=n
# Suppress driver init noise (I2C, UART) that would otherwise flood the buffer
CONFIG_I2C_LOG_LEVEL_WRN=y
CONFIG_UART_LOG_LEVEL_WRN=y
CONFIG_PRINTK=y

CONFIG_FPU=y
CONFIG_FPU_SHARING=y

# Lighthouse UART data (USART3 PC10/PC11)
# I2C boot removed: green LED on deck confirms FPGA auto-boots from SPI flash
CONFIG_SERIAL=y
CONFIG_UART_INTERRUPT_DRIVEN=y
CONFIG_CF21BL_LIGHTHOUSE=y

# Console: USART3 is taken by the lighthouse deck at 230400 baud.
# Use the CRTP radio console (crazyflie_console.py via crazyradio2).
# The nRF51 CRTP log backend (cf21bl_crtp_log.c) routes LOG_* over radio.
CONFIG_UART_CONSOLE=n
CONFIG_LOG_BACKEND_UART=n
```

## boards/crazyflie21bl.overlay
```dts
/*
 * lighthouse-test board overlay for crazyflie21bl.
 *
 * The lighthouse deck streams 12-byte UART frames on USART3 PC10/PC11 at
 * 230400 baud (verified from Bitcraze crazyflie-firmware uart1.h).
 * This overlay overrides the default 115200 baud console setting.
 *
 * WIRED CONSOLE IS UNAVAILABLE while the lighthouse deck is attached.
 * Use: python3 tapestry/tapestry-os/tools/crazyflie_console.py  (CRTP radio via crazyradio2)
 */

/* Reconfigure USART3 to 230400 baud for lighthouse data */
&usart3 {
	current-speed = <230400>;
	status = "okay";
};

/*
 * I2C1 removed: the lighthouse deck FPGA appears to auto-boot from its SPI
 * flash (confirmed by green LED at power-on without any BOOT_TO_FW command).
 * If a deck is encountered that does NOT auto-boot, re-add the i2c1 node and
 * CONFIG_I2C=y — but note that the STM32 I2C1 driver's SYS_INIT bus-recovery
 * on PB6/PB7 wedges USART6 logging; investigate before re-enabling.
 */
```

## src/main.c
```c
/*
 * lighthouse-test — LH2 position readout, no motors.
 *
 * Reads position from two SteamVR 2.0 base stations and logs at 5 Hz.
 * Move the drone by hand; verify X/Y/Z track correctly.
 *
 * CONSOLE: USART3 is taken by the lighthouse deck (230400 baud).
 * Read log output via CRTP radio:
 *   python3 tapestry/tapestry-os/tools/crazyflie_console.py
 *
 * Build:  west build -p always -b crazyflie21bl tapestry/examples/lighthouse-test
 * Flash:  cfloader flash build/zephyr/zephyr.bin stm32-dfu  (activate .venv)
 *
 * Before running:
 *   1. Attach the Lighthouse deck to the CF21BL expansion connector.
 *   2. Power on two SteamVR 2.0 base stations; wait ~30 s for spin-up.
 *   3. Get calibrated BS poses from cfclient (Lighthouse → Manage Geometry
 *      → Estimate geometry), then paste the JSON values into BS0/BS1 below.
 *   4. Confirm the channel numbers match your SteamVR channel assignments.
 *      The channel in the frame is 0-indexed (SteamVR channel − 1).
 */

#include <zephyr/kernel.h>
#include <zephyr/logging/log.h>
#include "cf21bl_lighthouse.h"

LOG_MODULE_REGISTER(lh2_test, LOG_LEVEL_INF);

/* ── Calibration — paste from cfclient geometry estimator ─────────────────── */

/*
 * JSON from cfclient "Manage geometry → Estimate":
 *   "rotation_matrix": [[r00,r01,r02],[r10,r11,r12],[r20,r21,r22]]
 *   "origin": [ox, oy, oz]
 *
 * Paste as:  .origin = {ox, oy, oz}
 *            .rot    = {r00,r01,r02, r10,r11,r12, r20,r21,r22}
 *
 * For initial SPI-link testing with no geometry estimated yet, leave as
 * identity / placeholder — position will be wrong but the log will show
 * whether frames are arriving (fix status changes from "no fix" to numbers).
 */
/* Single shared copy of poses + OOTX calibration + channel assignments —
 * see that header's comment for the recalibration procedure.  This example
 * is the verification tool for it: after any recalibration, a drone on the
 * floor at the calibration spot must read ≈ (0, 0, 0). */
#include "../lighthouse_cal.h"

/* ── Main ─────────────────────────────────────────────────────────────────── */

int main(void)
{
    LOG_INF("=== LH2 lighthouse-test (no motors) ===");
    LOG_INF("Console: CRTP radio (wired USART3 taken by lighthouse deck)");

    /* Load calibration */
    cf21bl_lighthouse_set_bs_pose(0, &BS0);
    cf21bl_lighthouse_set_bs_pose(1, &BS1);
    cf21bl_lighthouse_set_bs_calib(0, &BS0_CALIB);
    cf21bl_lighthouse_set_bs_calib(1, &BS1_CALIB);
    cf21bl_lighthouse_set_bs_channel(0, BS0_CHANNEL);
    cf21bl_lighthouse_set_bs_channel(1, BS1_CHANNEL);

    /* Start UART reader thread (blocks until synchronization on 0xFF frame) */
    int ret = cf21bl_lighthouse_init();
    if (ret) {
        LOG_ERR("cf21bl_lighthouse_init failed: %d", ret);
        return ret;
    }

    LOG_INF("Waiting for UART sync + fix from both base stations...");

    int no_fix_count = 0;
    while (true) {
        lh2_position_t pos;
        if (cf21bl_lighthouse_get_position(&pos) == 0) {
            no_fix_count = 0;
            LOG_INF("pos  x=%+.3f  y=%+.3f  z=%+.3f  m",
                    (double)pos.x, (double)pos.y, (double)pos.z);
        } else {
            no_fix_count++;
            if (no_fix_count % 10 == 1) {
                LOG_INF("no fix (check base stations, deck connection, channel config)");
            }
        }
        k_msleep(200);   /* 5 Hz */
    }

    return 0;
}
```
