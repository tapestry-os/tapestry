## CMakeLists.txt
```
cmake_minimum_required(VERSION 3.20.0)

if("${BOARD}" STREQUAL "bbc_microbit_v2")
    list(APPEND EXTRA_DTC_OVERLAY_FILE
        ${CMAKE_CURRENT_SOURCE_DIR}/../../tapestry-os/boards/bbc_microbit_v2/bbc_microbit_v2.overlay)
endif()

find_package(Zephyr REQUIRED HINTS $ENV{ZEPHYR_BASE})
project(tapestry_collective_formation)

set(TAPESTRY_OS_ROOT      ${CMAKE_CURRENT_SOURCE_DIR}/../../tapestry-os)
set(TAPESTRY_OS_CSM       ${TAPESTRY_OS_ROOT}/subsys/csm)
set(TAPESTRY_OS_TRANSPORT ${TAPESTRY_OS_ROOT}/subsys/transport)
set(TAPESTRY_OS_BOARDS    ${TAPESTRY_OS_ROOT}/boards)

# Core L4 stack + transport.
target_sources(app PRIVATE
    src/main.c
    src/formation.c
    ${TAPESTRY_OS_CSM}/world_model.c
    ${TAPESTRY_OS_TRANSPORT}/transport.c
    ${TAPESTRY_OS_TRANSPORT}/gossip.c
)

# BLE transceiver — micro:bit only (CONFIG_BT=y in board overlay).
if(CONFIG_BT)
    target_sources(app PRIVATE ${TAPESTRY_OS_TRANSPORT}/transceiver_ble.c)
endif()

# Substrate: Cutebot on micro:bit, null stub everywhere else.
if(CONFIG_I2C)
    target_sources(app PRIVATE
        ${TAPESTRY_OS_BOARDS}/bbc_microbit_v2/substrate_cutebot.c
        ${TAPESTRY_OS_BOARDS}/bbc_microbit_v2/cutebot.c
    )
else()
    target_sources(app PRIVATE ${TAPESTRY_OS_BOARDS}/substrate_null.c)
endif()

target_include_directories(app PRIVATE
    ${TAPESTRY_OS_ROOT}/include                    # <tapestry/csm.h>, <tapestry/transport.h>, <tapestry/substrate.h>
    ${TAPESTRY_OS_CSM}                             # world_model.c; types via <tapestry/csm.h>
    ${TAPESTRY_OS_TRANSPORT}                       # gossip.h, transceiver_ble.h, net_init.h
    ${TAPESTRY_OS_BOARDS}/bbc_microbit_v2          # cutebot.h
    src
)

target_link_libraries(app PRIVATE m)

# Demo tuning — override transport.c #ifndef defaults without touching Kconfig.
target_compile_definitions(app PRIVATE CONFIG_TAPESTRY_AUTO_ID_WINDOW_MS=8000)
```

## Kconfig
```
source "Kconfig.zephyr"

config TAPESTRY_ELEMENT_ID
	int "Element ID [0..3]"
	range 0 3
	default 0
	help
	  Unique identity for this robot. Determines starting position in the
	  logical world and leader election priority (lowest ID wins if L5 is
	  ever added). Override at build time with -DCONFIG_TAPESTRY_ELEMENT_ID=N.
```

## prj.conf
```kconfig
# ── Stack / heap ──────────────────────────────────────────────────────────────
CONFIG_MAIN_STACK_SIZE=8192

# ── Hardware info (FICR device ID — used for auto element-ID assignment) ──────
CONFIG_HWINFO=y

# ── Floating point ────────────────────────────────────────────────────────────
CONFIG_FPU=y

# ── Logging ───────────────────────────────────────────────────────────────────
CONFIG_LOG=y
CONFIG_LOG_DEFAULT_LEVEL=3
CONFIG_PRINTK=y

# Board-specific configs (BLE, I2C) live in boards/bbc_microbit_v2.conf.
```

## boards/bbc_microbit_v2.conf
```kconfig
# Board overlay for BBC micro:bit V2 (nRF52833 / Cortex-M4F)
# BLE gossip transport + Cutebot Mini motor and LED output.

# ── Floating point ────────────────────────────────────────────────────────────
CONFIG_FPU=y
CONFIG_FPU_SHARING=y

# ── Bluetooth ─────────────────────────────────────────────────────────────────
CONFIG_BT=y
CONFIG_BT_OBSERVER=y
CONFIG_BT_BROADCASTER=y
CONFIG_BT_DEVICE_NAME="tapestry-collective-formation"
CONFIG_BT_RX_STACK_SIZE=4096
CONFIG_SYSTEM_WORKQUEUE_STACK_SIZE=4096

# ── I2C (Cutebot) ─────────────────────────────────────────────────────────────
CONFIG_I2C=y
CONFIG_I2C_GPIO=y

# ── micro:bit LED matrix ───────────────────────────────────────────────────────
# MICROBIT_DISPLAY (mb_display_get / mb_display_image) depends on DISPLAY.
CONFIG_DISPLAY=y
CONFIG_MICROBIT_DISPLAY=y
```

## src/main.c
```c
/*
 * main.c — Tapestry Demo: Collective Formation (L4 only)
 *
 * Any number of robots running L4 CSM.  Each robot:
 *   1. Negotiates a unique element ID over transport during a 4-second boot window.
 *   2. Advertises its own dead-reckoning position via gossip.
 *   3. Receives peer positions into its local L4 world model.
 *   4. Computes a spring-field drive command (repulsion/attraction).
 *   5. Drives toward the formation equilibrium.
 *   6. Sets LEDs to reflect how many fresh peers are currently visible.
 *
 * No L5 SCR — formation is a pure L4 behavior.
 *
 * ID assignment is handled by transport_negotiate_id() — see transport.h and
 * CONFIG_TAPESTRY_AUTO_ID_WINDOW_MS for the auto-ID protocol details.
 *
 * One binary for all robots — no per-robot build flags needed.
 *
 * See formation.h for physical calibration constants.
 */

#include <zephyr/kernel.h>
#include <zephyr/logging/log.h>
#include <math.h>
#include <tapestry/csm.h>
#include <tapestry/transport.h>
#include <tapestry/substrate.h>

#include "formation.h"

LOG_MODULE_REGISTER(demo, LOG_LEVEL_INF);

#define M_PI_F       3.14159265f

/* ── Helpers ─────────────────────────────────────────────────────────────── */

/*
 * Seed each robot near the arena center on a tiny 3-unit circle, and
 * return the outward-facing heading angle.
 *
 * The 3-unit radius keeps all robots visually clustered at start while
 * placing adjacent robots ~4 units apart — far below DEMO_TARGET_SPACING —
 * so spring repulsion immediately drives them outward.
 *
 * The heading is set to the outward angle so every robot's spring force
 * projects fully forward on tick 1.  Without this, robots whose force
 * points opposite to heading 0 drive backward and collide with neighbors.
 *
 * Physical placement: orient each robot so its physical forward direction
 * matches its assigned heading (see README for per-ID compass directions).
 */
static void compute_start_pos(element_id_t id, int n_total,
                               float *x, float *y, float *heading)
{
    float a = 2.0f * M_PI_F * (float)id / (float)(n_total > 1 ? n_total : 1);
    *x       = 50.0f + 3.0f * cosf(a);
    *y       = 50.0f + 3.0f * sinf(a);
    *heading = a;
}

/* ── Main ─────────────────────────────────────────────────────────────────── */

int main(void)
{
    if (substrate_init() != 0) {
        LOG_WRN("substrate init failed — movement and signal disabled");
    }

    if (transport_init() != 0) {
        LOG_WRN("transport init failed — no peer awareness");
    }

    int n_total;
    const element_id_t element_id = transport_negotiate_id(&n_total);

    float sx, sy, shead;
    compute_start_pos(element_id, n_total, &sx, &sy, &shead);

    LOG_INF("Demo — element %u  start (%.1f, %.1f)  heading=%.2f rad  target_spacing=%.1f",
            (unsigned)element_id, (double)sx, (double)sy,
            (double)shead, (double)DEMO_TARGET_SPACING);

    element_state_t own_state = {0};
    own_state.id          = element_id;
    own_state.position.x  = sx;
    own_state.position.y  = sy;

    transport_send(&own_state, TAPESTRY_QOS_SOFT_RT);

    world_model_t wm;
    wm_init(&wm, element_id, &own_state, 0.0f);   /* pure AP — never freeze */

    demo_odometry_t odo;
    demo_odometry_init(&odo, sx, sy);
    odo.heading = shead;

    float    speed_cmd    = 0.0f;
    float    rate_cmd     = 0.0f;
    uint32_t gossip_accum = GOSSIP_INTERVAL_MS;   /* send immediately on first tick */

    /*
     * Convergence hold: wait until all n_total-1 expected peers are visible
     * and fresh in the world model before starting movement.  Prevents robots
     * that finished the ID window early from driving into a partial formation
     * while later robots are still exiting their own windows.
     *
     * Caps at DEMO_SYNC_GRACE_MS so a missing robot doesn't stall the demo.
     */
#define DEMO_SYNC_GRACE_MS 4000
    for (uint32_t waited = 0; waited < DEMO_SYNC_GRACE_MS; waited += WM_CYCLE_MS) {
        transport_drain(&wm, element_id);
        wm_tick(&wm, WM_CYCLE_MS);
        demo_set_leds(&wm);

        int fresh = 0;
        for (int i = 0; i < MAX_ELEMENTS; i++) {
            const wm_entry_t *e = &wm.entries[i];
            if (e->is_active && !e->is_self && !e->is_stale) {
                fresh++;
            }
        }
        if (fresh >= n_total - 1) {
            break;
        }

        gossip_accum += WM_CYCLE_MS;
        if (gossip_accum >= GOSSIP_INTERVAL_MS) {
            own_state.update_seq++;
            transport_send(&own_state, TAPESTRY_QOS_SOFT_RT);
            gossip_accum = 0;
        }
        k_msleep(WM_CYCLE_MS);
    }

    LOG_INF("Demo ready — entering main loop");

    while (true) {
        transport_drain(&wm, element_id);
        wm_tick(&wm, WM_CYCLE_MS);

        demo_odometry_update(&odo, speed_cmd, rate_cmd, WM_CYCLE_MS);
        own_state.position.x = odo.x;
        own_state.position.y = odo.y;
        wm_update_self(&wm, &own_state);

        demo_compute_drive(&wm, &odo, &speed_cmd, &rate_cmd);
        substrate_twist_t twist = {
            .linear  = { .x = speed_cmd },
            .angular = { .z = rate_cmd  },
        };
        substrate_move(&twist);
        demo_set_leds(&wm);
        demo_display_position(&odo);

        gossip_accum += WM_CYCLE_MS;
        if (gossip_accum >= GOSSIP_INTERVAL_MS) {
            own_state.update_seq++;
            transport_send(&own_state, TAPESTRY_QOS_SOFT_RT);
            gossip_accum = 0;
        }

        k_msleep(WM_CYCLE_MS);
    }

    return 0;
}
```

## src/formation.c
```c
/*
 * formation.c — Demo: spring-field formation control + dead-reckoning
 */

#include "formation.h"

#include <math.h>
#include <zephyr/display/mb_display.h>
#include <zephyr/logging/log.h>

LOG_MODULE_REGISTER(formation, LOG_LEVEL_DBG);

#define M_PI_F      3.14159265f

/* Spring constant — force per logical unit of spacing error.
 * Must be large enough that typical displacements (5–10 units) produce
 * a net force that exceeds FORCE_DEADBAND and commands above stiction. */
#define SPRING_K        8.0f

/* Maps resultant force magnitude to motor speed percent. */
#define FORCE_TO_SPEED  0.6f

/* Steering gain: scales lateral force to differential turn. */
#define TURN_GAIN       12.0f

/* Motor speed when wandering with no peers visible.
 * Must be above stiction threshold (~20% measured). */
#define BASE_WANDER     22

/* Minimum motor % that overcomes stiction (measured). Any non-zero
 * speed command is snapped up to this so the motors actually turn. */
#define MIN_STICTION    22

/* Hysteresis thresholds on net spring force magnitude.
 * A stopped robot only starts moving when force exceeds FORCE_START.
 * A moving robot stops when force drops below FORCE_STOP.
 * The gap between them prevents oscillation near equilibrium: a small
 * correction that slightly overshoots does not immediately trigger a
 * counter-correction, and gossip-propagated micro-adjustments from
 * neighbors do not restart a robot that has just settled. */
#define FORCE_STOP   25.0f   /* ~2 units / 6 mm from equilibrium  */
#define FORCE_START  90.0f   /* > one-cycle overshoot force (~81 units) */

/* ── Helpers ─────────────────────────────────────────────────────────────── */

static float clampf(float v, float lo, float hi)
{
    return v < lo ? lo : (v > hi ? hi : v);
}

/* ── Odometry ─────────────────────────────────────────────────────────────── */

void demo_odometry_init(demo_odometry_t *odo, float x, float y)
{
    odo->x       = x;
    odo->y       = y;
    odo->heading = 0.0f;
}

void demo_odometry_update(demo_odometry_t *odo,
                           float speed_norm, float rate_norm,
                           uint32_t dt_ms)
{
    float dt       = (float)dt_ms * 0.001f;
    float v_center = speed_norm * DEMO_MAX_SPEED;   /* logical units/s */
    float omega    = rate_norm  * DEMO_MAX_OMEGA;   /* rad/s           */

    odo->heading += omega * dt;

    /* Normalize to (-π, π] */
    while (odo->heading >  M_PI_F) { odo->heading -= 2.0f * M_PI_F; }
    while (odo->heading < -M_PI_F) { odo->heading += 2.0f * M_PI_F; }

    odo->x += v_center * cosf(odo->heading) * dt;
    odo->y += v_center * sinf(odo->heading) * dt;

    /* Clamp to world bounds */
    if (odo->x < 0.0f)      { odo->x = 0.0f; }
    if (odo->x > WORLD_SIZE) { odo->x = WORLD_SIZE; }
    if (odo->y < 0.0f)      { odo->y = 0.0f; }
    if (odo->y > WORLD_SIZE) { odo->y = WORLD_SIZE; }
}

/* ── Formation control ────────────────────────────────────────────────────── */

void demo_compute_drive(const world_model_t *wm,
                         const demo_odometry_t *odo,
                         float *speed_out, float *rate_out)
{
    float fx         = 0.0f;
    float fy         = 0.0f;
    int   peer_count = 0;

    for (int i = 0; i < MAX_ELEMENTS; i++) {
        const wm_entry_t *e = &wm->entries[i];

        if (!e->is_active || e->is_self || e->is_stale) {
            continue;
        }

        float dx   = e->state.position.x - odo->x;
        float dy   = e->state.position.y - odo->y;
        float dist = sqrtf(dx * dx + dy * dy);

        if (dist < 0.01f) {
            continue;
        }

        /*
         * Spring force along the line between self and peer.
         * Positive force  = toward peer (attraction, dist > target).
         * Negative force = away from peer (repulsion, dist < target).
         */
        float force = (dist - DEMO_TARGET_SPACING) * SPRING_K;

        fx += force * (dx / dist);
        fy += force * (dy / dist);
        peer_count++;
    }

    if (peer_count == 0) {
        /* No peers visible: hold position and wait for BLE gossip.
         * BLE scanning is passive — physical movement does not help
         * discovery, and wandering corrupts the dead-reckoning origin. */
        *speed_out = 0.0f;
        *rate_out  = 0.0f;
        return;
    }

    /* Hysteresis: require a larger force to start moving than to stop.
     * Prevents oscillation and gossip-cascade near equilibrium. */
    static bool moving = false;
    float force_mag = sqrtf(fx * fx + fy * fy);

    if (!moving && force_mag >= FORCE_START) {
        moving = true;
    } else if (moving && force_mag < FORCE_STOP) {
        moving = false;
    }

    if (!moving) {
        *speed_out = 0.0f;
        *rate_out  = 0.0f;
        return;
    }

    /*
     * Project world-frame force (fx, fy) onto the robot frame.
     *
     * Robot forward axis in world frame: (cos h, sin h)
     * Robot left    axis in world frame: (-sin h, cos h)
     *
     * f_fwd > 0 → move forward
     * f_lat > 0 → force is to the robot's left → turn left
     */
    float cos_h = cosf(odo->heading);
    float sin_h = sinf(odo->heading);
    float f_fwd = fx *  cos_h + fy * sin_h;
    float f_lat = fx * -sin_h + fy * cos_h;

    float speed = clampf(f_fwd * FORCE_TO_SPEED, -22.0f, 22.0f);
    float turn  = clampf(f_lat * TURN_GAIN / DEMO_TARGET_SPACING,
                         -15.0f, 15.0f);

    /* Snap: any non-zero speed command must reach the stiction threshold
     * or the motors will not turn.  The force_mag check above already
     * guards the zero case so anything reaching here should move. */
    if (speed > 0.0f && speed < (float)MIN_STICTION) {
        speed = (float)MIN_STICTION;
    } else if (speed < 0.0f && speed > -(float)MIN_STICTION) {
        speed = -(float)MIN_STICTION;
    }

    *speed_out = speed / 100.0f;
    *rate_out  = turn  / 100.0f;

    LOG_DBG("fx=%.2f fy=%.2f fwd=%.2f lat=%.2f spd=%.2f rate=%.2f peers=%d",
            (double)fx, (double)fy,
            (double)f_fwd, (double)f_lat,
            (double)*speed_out, (double)*rate_out, peer_count);
}

/* ── Position display (micro:bit 5×5 matrix) ─────────────────────────────── */

void demo_display_position(const demo_odometry_t *odo)
{
    /* 100-unit world → 5 cells of 20 units each. */
    int col     = 4 - (int)(odo->x / 20.0f);
    int led_row = 4 - (int)(odo->y / 20.0f);

    if (col     < 0) { col     = 0; } else if (col     > 4) { col     = 4; }
    if (led_row < 0) { led_row = 0; } else if (led_row > 4) { led_row = 4; }

    static int last_col = -1;
    static int last_row = -1;
    if (col == last_col && led_row == last_row) {
        return;
    }
    last_col = col;
    last_row = led_row;

    struct mb_image img = {0};
    img.row[led_row] = (uint8_t)(0x10u >> col);  /* bit4=col0 … bit0=col4 */

    struct mb_display *disp = mb_display_get();
    mb_display_image(disp, MB_DISPLAY_MODE_SINGLE, SYS_FOREVER_MS, &img, 1);
}

/* ── LED feedback ─────────────────────────────────────────────────────────── */

void demo_set_leds(const world_model_t *wm)
{
    int fresh = 0;

    for (int i = 0; i < MAX_ELEMENTS; i++) {
        const wm_entry_t *e = &wm->entries[i];
        if (e->is_active && !e->is_self && !e->is_stale) {
            fresh++;
        }
    }

    static int last_fresh = -1;
    if (fresh != last_fresh) {
        static const char *const labels[] = { "failed", "degraded", "active" };
        int idx = fresh >= 2 ? 2 : fresh;
        LOG_INF("peers=%d  signal=%s", fresh, labels[idx]);
        last_fresh = fresh;
    }

    substrate_signal_t sig;
    if      (fresh >= 2) sig = SUBSTRATE_SIGNAL_ACTIVE;
    else if (fresh == 1) sig = SUBSTRATE_SIGNAL_DEGRADED;
    else                 sig = SUBSTRATE_SIGNAL_FAILED;
    substrate_set_signal(sig);
}
```

## src/formation.h
```c
/*
 * formation.h — Demo: Collective Formation (L4 only)
 *
 * Spring-field repulsion/attraction over the L4 world model, with
 * dead-reckoning odometry to keep own_state.position current.
 *
 * Physical calibration:
 *   DEMO_MAX_SPEED — effective linearisation constant, NOT true 100% speed.
 *     The motor curve is non-linear: at 22% commanded speed Cutebots already
 *     do ~32% of max velocity.  Calibrate at the actual commanded speed (22%)
 *     so dead-reckoning is correct in practice:
 *       DEMO_MAX_SPEED = speed_mm_per_s_at_22pct / 0.22 * 100 / arena_mm
 *     Measured fleet average 238 mm/s at 22%, 800 mm arena (1 unit = 8 mm):
 *       238 / 0.22 * 100 / 800 = 135.0
 *     Per-robot values (compile with -DDEMO_MAX_SPEED=N):
 *       Bot 0: 120  Bot 1: 137  Bot 2: 145  Bot 3: 139
 *
 *   DEMO_WHEEL_TRACK — wheel-center-to-wheel-center in logical units.
 *     Cutebot Mini track ≈ 85 mm. In an 800 mm arena: 85/8 = 10.6.
 *
 * Formation tuning:
 *   DEMO_TARGET_SPACING — desired peer-to-peer spacing in logical units.
 *     25 units ≈ 200 mm in an 800 mm arena. Starting point — tune up to
 *     spread robots further or down to tighten the cluster.
 *
 * Override any constant at compile time:
 *   west build ... -- -DDEMO_TARGET_SPACING=40.0f
 */

#ifndef TAPESTRY_DEMO_FORMATION_H
#define TAPESTRY_DEMO_FORMATION_H

#include <stdint.h>
#include <tapestry/csm.h>
#include <tapestry/substrate.h>

/* ── Calibration defaults ───────────────────────────────────────────────── */

#ifndef DEMO_WHEEL_TRACK
#define DEMO_WHEEL_TRACK   10.6f   /* logical units, wheel-to-wheel (800 mm arena) */
#endif

#ifndef DEMO_MAX_SPEED
#define DEMO_MAX_SPEED    135.0f   /* linearisation constant at 22% commanded speed
                                     * Formula: speed_mm_per_s_at_22pct / 0.22 * 100 / arena_mm
                                     * 800 mm arena, fleet avg 238 mm/s at 22%: 238/0.22*100/800 = 135 */
#endif

/* Maximum yaw rate (rad/s) at rate_norm=1.0.
 * Although DEMO_MAX_SPEED is a low-speed linearisation constant (not true 100%
 * speed), using it here works because the motor non-linearity at 22% raises
 * effective speed by the same factor (~1.43×), so DEMO_MAX_OMEGA correctly
 * predicts physical omega for both in-place and arc turns at stiction speed.
 * Not overridable: change DEMO_MAX_SPEED or DEMO_WHEEL_TRACK instead. */
#define DEMO_MAX_OMEGA    (2.0f * DEMO_MAX_SPEED / DEMO_WHEEL_TRACK)

#ifndef DEMO_TARGET_SPACING
#define DEMO_TARGET_SPACING 50.0f  /* desired peer spacing, logical units →
                                     * equilibrium side = T × 0.854 (4-robot square geometry)
                                     * 50 units → equilibrium ≈ 43 units = 341 mm in 800 mm arena */
#endif

/* ── Dead-reckoning state ───────────────────────────────────────────────── */

typedef struct {
    float x;        /* Current position in logical world coords [0, WORLD_SIZE] */
    float y;
    float heading;  /* Radians, 0 = +x direction */
    bool  moving;   /* Hysteresis state for demo_compute_drive */
} demo_odometry_t;

/* Initialize odometry at (x, y) with heading 0 (+x direction). */
void demo_odometry_init(demo_odometry_t *odo, float x, float y);

/*
 * Update dead-reckoning estimate from the last motion command.
 *   speed_norm: forward velocity [-1.0, 1.0], passed to substrate_move().
 *   rate_norm:  yaw rate         [-1.0, 1.0], positive = CCW (turn left).
 *   Also resets odo->moving when peer count transitions from 0 → non-zero.
 *   dt_ms: elapsed milliseconds since last call (typically WM_CYCLE_MS).
 */
void demo_odometry_update(demo_odometry_t *odo,
                           float speed_norm, float rate_norm,
                           uint32_t dt_ms);

/* ── Formation control ──────────────────────────────────────────────────── */

/*
 * Compute motion command from the L4 world model.
 *
 * For each active, non-stale, non-self peer in wm, a spring force is applied:
 *   force = (distance - TARGET_SPACING) * SPRING_K
 *   direction = unit vector from own position toward peer
 *
 * The summed force vector is projected onto the robot frame and written to
 * *speed_out (forward velocity) and *rate_out (yaw rate), both normalized
 * [-1.0, 1.0].  Pass these directly to substrate_move() via substrate_twist_t.
 * When no peers are visible, the robot holds position (both outputs zero).
 */
void demo_compute_drive(const world_model_t *wm,
                         demo_odometry_t *odo,
                         float *speed_out,
                         float *rate_out);

/* ── Signal feedback ────────────────────────────────────────────────────── */

/*
 * Set substrate signal to reflect L4 world model peer visibility.
 *   >=2 fresh peers → SUBSTRATE_SIGNAL_ACTIVE   (formation viable)
 *    1 fresh peer   → SUBSTRATE_SIGNAL_DEGRADED (partial)
 *    0 fresh peers  → SUBSTRATE_SIGNAL_FAILED   (isolated / starting up)
 */
void demo_set_leds(const world_model_t *wm);

/*
 * Display dead-reckoning position on the micro:bit 5×5 LED matrix.
 * Maps the 100×100 logical world onto the 5×5 grid (20 units per cell).
 * One lit pixel shows where this robot thinks it is.  Only redraws when
 * the pixel cell changes, so it is safe to call every main-loop cycle.
 *
 * Orientation (connector at bottom, as held during demo):
 *   col 0 = right  col 4 = left   (x-axis flipped)
 *   row 0 = top    row 4 = bottom  (y-axis flipped: large-y → top)
 */
void demo_display_position(const demo_odometry_t *odo);

#endif /* TAPESTRY_DEMO_FORMATION_H */
```
