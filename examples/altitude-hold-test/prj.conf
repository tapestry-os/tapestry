## CMakeLists.txt
```
cmake_minimum_required(VERSION 3.20.0)

list(APPEND BOARD_ROOT ${CMAKE_CURRENT_SOURCE_DIR}/../../tapestry-scr-hw)
list(APPEND DTS_ROOT   ${CMAKE_CURRENT_SOURCE_DIR}/../../tapestry-os)

set(DTC_OVERLAY_FILE
    "${CMAKE_CURRENT_SOURCE_DIR}/../../tapestry-os/boards/crazyflie21bl/crazyflie21bl.overlay"
    "${CMAKE_CURRENT_SOURCE_DIR}/boards/crazyflie21bl_lh.overlay")

find_package(Zephyr REQUIRED HINTS $ENV{ZEPHYR_BASE})
project(tapestry_altitude_hold_test)

set(TAPESTRY_OS_ROOT   ${CMAKE_CURRENT_SOURCE_DIR}/../../tapestry-os)
set(TAPESTRY_OS_BOARDS ${TAPESTRY_OS_ROOT}/boards)

if(CONFIG_CF21BL_LIGHTHOUSE)
  target_sources(app PRIVATE
    ${TAPESTRY_OS_BOARDS}/crazyflie21bl/cf21bl_lighthouse.c)
endif()

target_sources(app PRIVATE
    src/main.c
    ${TAPESTRY_OS_BOARDS}/crazyflie21bl/substrate_crazyflie21bl.c
    ${TAPESTRY_OS_BOARDS}/crazyflie21bl/crazyflie21bl.c
    ${TAPESTRY_OS_BOARDS}/crazyflie21bl/cf21bl_stabilizer.c
    ${TAPESTRY_OS_BOARDS}/crazyflie21bl/cf21bl_imu.c
    ${TAPESTRY_OS_BOARDS}/crazyflie21bl/cf21bl_iwdg.c
    ${TAPESTRY_OS_BOARDS}/crazyflie21bl/cf21bl_crtp_log.c
    ${TAPESTRY_OS_BOARDS}/crazyflie21bl/cf21bl_syslink_tx.c
)

target_include_directories(app PRIVATE
    ${TAPESTRY_OS_ROOT}/include           # <tapestry/substrate.h>
    ${TAPESTRY_OS_BOARDS}/crazyflie21bl   # cf21bl_stabilizer.h, crazyflie21bl.h
)
```

## Kconfig
```
mainmenu "Tapestry altitude-hold-test"

source "Kconfig.zephyr"
rsource "../../tapestry-os/boards/crazyflie21bl/Kconfig"
```

## prj.conf
```kconfig
CONFIG_LOG=y
CONFIG_LOG_DEFAULT_LEVEL=3
CONFIG_LOG_BUFFER_SIZE=4096
CONFIG_PRINTK=y

CONFIG_FPU=y
CONFIG_FPU_SHARING=y

# Motor ESCs
CONFIG_PWM=y

# IMU (required by CF21BL_STABILIZER)
CONFIG_SENSOR=y
CONFIG_I2C=y
CONFIG_BMI08X=y
CONFIG_BMI08X_GYRO_TRIGGER_OWN_THREAD=y
CONFIG_SENSOR_ASYNC_API=y

# Barometer (BMP390 at 0x77; CONFIG_BMP388 covers both BMP388 and BMP390)
CONFIG_BMP388=y

# Stabilizer layers
CONFIG_CF21BL_STABILIZER=y
CONFIG_CF21BL_ANGLE_MODE=y
CONFIG_CF21BL_ALTITUDE_HOLD=y

# Lighthouse positioning (observation only — no position hold)
CONFIG_CF21BL_LIGHTHOUSE=y
CONFIG_SERIAL=y
CONFIG_UART_INTERRUPT_DRIVEN=y
```

## boards/crazyflie21bl.conf
```kconfig
CONFIG_LOG_OUTPUT=y
CONFIG_LOG_BACKEND_SHOW_COLOR=n
# USART3 is taken by the lighthouse deck at 230400 baud; use CRTP radio console
CONFIG_UART_CONSOLE=n
CONFIG_LOG_BACKEND_UART=n
CONFIG_I2C_LOG_LEVEL_WRN=y
CONFIG_UART_LOG_LEVEL_WRN=y
```

## boards/crazyflie21bl_lh.overlay
```dts
/*
 * Lighthouse deck overlay for altitude-hold-test.
 * Reconfigures USART3 to 230400 baud for the lighthouse deck FPGA data stream.
 * The wired serial console is unavailable while the deck is attached;
 * use read_console.py (CRTP radio via crazyradio2) instead.
 */
&usart3 {
	current-speed = <230400>;
	status = "okay";
};
```

## src/main.c
```c
/*
 * altitude-hold-test — Explicit, timed altitude hold test sequence
 *
 * Does NOT use the tapestry runtime (no quorum, no auto-arming).
 * Runs a fixed sequence so you can observe each stage safely:
 *
 *   Stage 0  boot + ESC arming + baro calibration  (≈ 5 s, motors silent)
 *   Stage 1  PLACE ON GROUND AND STAND CLEAR — 5 s countdown
 *   Stage 2  arm ESCs (idle speed), hold 3 s
 *   Stage 3  altitude hold at 0.5 m, hold 15 s
 *   Stage 4  idle (altitude PID off), hold 3 s
 *   Stage 5  disarm — motors off
 *
 * Console output during stage 3: "alt=X.XXX m  target=0.500 m  T=0.XX"
 * (logged every 0.5 s from inside cf21bl_stabilizer.c).
 *
 * Build:  west build -p always -b crazyflie21bl tapestry/tapestry/examples/altitude-hold-test
 * Flash:  cfloader flash build/zephyr/zephyr.bin stm32-dfu
 * Read:   minicom -D /dev/ttyUSB0 -b 115200
 *   or:   python3 ~/code/tapestry/read_console.py
 */

#include <zephyr/kernel.h>
#include <zephyr/logging/log.h>
#include <tapestry/substrate.h>

LOG_MODULE_REGISTER(alt_hold_test, LOG_LEVEL_INF);

/* Altitude setpoint: linear.z in [-1, +1], altitude = linear.z + 1.0 m.
 * linear.z < -0.9  → idle (altitude PID disarmed, motors at minimum)
 * linear.z = -0.7  → 0.3 m above boot altitude  (conservative first test)
 * linear.z = -0.5  → 0.5 m above boot altitude
 * linear.z =  0.0  → 1.0 m above boot altitude  */
#define ALT_TARGET_LZ   (-0.7f)   /* → 0.3 m: low, catchable, survivable drop */

static const substrate_twist_t IDLE  = { .linear = { .z = -1.0f } };
static const substrate_twist_t HOVER = { .linear = { .z = ALT_TARGET_LZ } };

int main(void)
{
    LOG_INF("=== Altitude hold test (no tapestry runtime) ===");

    /* substrate_init() → cf21bl_init(): ESC reset + 3 s arming melody,
     * then starts the stabilizer thread (which spends ~1 s averaging
     * the baro home baseline before its main loop begins). */
    LOG_INF("Stage 0: ESC arming + baro calibration (~5 s) ...");
    if (substrate_init() != 0) {
        LOG_ERR("substrate_init failed — aborting");
        return -1;
    }

    /* Wait for the stabilizer thread's baro home averaging to finish.
     * cf21bl_init() returns immediately after launching the thread;
     * give it 2 s on top of the 1 s calibration loop. */
    k_msleep(2000);
    LOG_INF("Stage 0 complete — baro home established");

    /* ── Stage 1: tether window ─────────────────────────────────────── */
    LOG_INF("Stage 1: PLACE ON GROUND AND STAND CLEAR — arming in 5 s ...");
    for (int i = 5; i > 0; i--) {
        LOG_INF("  %d ...", i);
        k_msleep(1000);
    }

    /* ── Stage 2: arm at idle ────────────────────────────────────────── */
    LOG_INF("Stage 2: arming ESCs (idle speed for 3 s)");
    substrate_set_power(SUBSTRATE_POWER_ACTIVE);
    substrate_move(&IDLE);   /* linear.z = -1.0 → altitude PID disarmed */
    k_msleep(3000);

    /* ── Stage 3: altitude hold ──────────────────────────────────────── */
    LOG_INF("Stage 3: altitude hold at %.1f m for 15 s",
            (double)(ALT_TARGET_LZ + 1.0f));
    substrate_move(&HOVER);
    k_msleep(15000);

    /* ── Stage 4: return to idle ─────────────────────────────────────── */
    LOG_INF("Stage 4: idle (altitude PID off) for 3 s — land the drone");
    substrate_move(&IDLE);
    k_msleep(3000);

    /* ── Stage 5: disarm ─────────────────────────────────────────────── */
    substrate_set_power(SUBSTRATE_POWER_SLEEP);
    LOG_INF("Stage 5: disarmed — test complete");
    return 0;
}
```
