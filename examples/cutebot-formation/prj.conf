## CMakeLists.txt
```
cmake_minimum_required(VERSION 3.20.0)

if("${BOARD}" STREQUAL "bbc_microbit_v2")
    list(APPEND EXTRA_DTC_OVERLAY_FILE
        ${CMAKE_CURRENT_SOURCE_DIR}/../../tapestry-os/boards/bbc_microbit_v2/bbc_microbit_v2.overlay)
endif()

find_package(Zephyr REQUIRED HINTS $ENV{ZEPHYR_BASE})
project(tapestry_cutebot_formation)

set(TAPESTRY_OS_ROOT      ${CMAKE_CURRENT_SOURCE_DIR}/../../tapestry-os)
set(TAPESTRY_OS_CSM       ${TAPESTRY_OS_ROOT}/subsys/csm)
set(TAPESTRY_OS_TRANSPORT ${TAPESTRY_OS_ROOT}/subsys/transport)
set(TAPESTRY_OS_BOARDS    ${TAPESTRY_OS_ROOT}/boards)

# Core L4 stack + transport.
target_sources(app PRIVATE
    src/main.c
    src/formation.c
    ${TAPESTRY_OS_CSM}/world_model.c
    ${TAPESTRY_OS_CSM}/facts.c
    ${TAPESTRY_OS_TRANSPORT}/transport.c
    ${TAPESTRY_OS_TRANSPORT}/gossip.c
)

# L5 SCR + L6 BSE + L7 Choreographer — the choreo demo mode's target source.
if(CONFIG_DEMO_MODE_CHOREO)
    target_sources(app PRIVATE
        ${TAPESTRY_OS_ROOT}/subsys/scr/scr.c
        ${TAPESTRY_OS_ROOT}/subsys/bse/bse.c
        ${TAPESTRY_OS_ROOT}/subsys/choreo/choreo.c
    )
    target_include_directories(app PRIVATE
        ${CMAKE_CURRENT_SOURCE_DIR}/../../sdk/include   # <tapestry/choreo.h>
    )
    # Both #ifndef-guarded in core choreo.c/choreo.h with a documented
    # "must stay equal" invariant between them — overridden here (app-
    # scoped, cf21bl-formation/webots-formation keep the flight-tested
    # 2000ms default) because real BLE gossip jitter on this hardware
    # needs a bit more margin before element_lost/element_joined fires:
    # 2026-09-11 hardware run showed the ring settle, pause ~3s, then
    # keep re-adjusting — traced to bse.c recomputing each element's FORM
    # vertex from live rank/count every tick, with a single dropped/
    # delayed gossip frame enough to shift it. 2000ms wasn't quite long
    # enough margin above that jitter; 3000ms is the first bump to try.
    target_compile_definitions(app PRIVATE
        CHOREO_MEMBERSHIP_HOLD_MS=3000u
        CHOREO_REMOTE_ADOPT_HOLD_MS=3000u
    )
endif()

# Both leak scripts, picked at boot (Kconfig DEMO_LEAK_DUAL, leak_scripts.h).
if(CONFIG_DEMO_LEAK_DUAL)
    target_sources(app PRIVATE
        src/leak_script_search.c
        src/leak_script_sensor.c
    )
endif()

# BLE transceiver — micro:bit only (CONFIG_BT=y in board overlay).
if(CONFIG_BT)
    target_sources(app PRIVATE ${TAPESTRY_OS_TRANSPORT}/transceiver_ble.c)
endif()

# Wireless debug telemetry (Kconfig DEMO_BLE_DEBUG, via ble_debug.conf).
if(CONFIG_DEMO_BLE_DEBUG)
    target_sources(app PRIVATE src/ble_debug.c)
endif()

# Substrate: Cutebot on micro:bit, null stub everywhere else. CUTEBOT_VARIANT
# (Kconfig) picks which physical Cutebot — Mini and Pro are genuinely
# different I2C protocols/hardware (see cutebot_pro.h), not just a
# parameter difference, hence two full driver+substrate file sets rather
# than one parameterized set.
if(CONFIG_CUTEBOT_VARIANT_PRO)
    target_sources(app PRIVATE
        ${TAPESTRY_OS_BOARDS}/bbc_microbit_v2/substrate_cutebot_pro.c
        ${TAPESTRY_OS_BOARDS}/bbc_microbit_v2/cutebot_pro.c
    )
elseif(CONFIG_I2C)
    target_sources(app PRIVATE
        ${TAPESTRY_OS_BOARDS}/bbc_microbit_v2/substrate_cutebot.c
        ${TAPESTRY_OS_BOARDS}/bbc_microbit_v2/cutebot.c
        ${TAPESTRY_OS_BOARDS}/bbc_microbit_v2/cutebot_line.c
        ${TAPESTRY_OS_BOARDS}/bbc_microbit_v2/cutebot_line_bench.c
    )
else()
    target_sources(app PRIVATE ${TAPESTRY_OS_BOARDS}/substrate_null.c)
endif()

target_include_directories(app PRIVATE
    ${TAPESTRY_OS_ROOT}/include                    # <tapestry/csm.h>, <tapestry/transport.h>, <tapestry/substrate.h>
    ${TAPESTRY_OS_CSM}                             # world_model.c; types via <tapestry/csm.h>
    ${TAPESTRY_OS_TRANSPORT}                       # gossip.h, transceiver_ble.h, net_init.h
    ${TAPESTRY_OS_BOARDS}/bbc_microbit_v2          # cutebot.h
    src
)

target_link_libraries(app PRIVATE m)
```

## Kconfig
```
mainmenu "Tapestry cutebot-formation"

source "Kconfig.zephyr"
rsource "../../tapestry-os/subsys/transport/Kconfig"

choice DEMO_MODE
	prompt "Demo mode"
	default DEMO_MODE_CHOREO

config DEMO_MODE_CHOREO
	bool "Choreo script (L5/L6/L7): hold, form a ring, hold"
	help
	  The robots execute a declarative L7 Choreo script through a real L5
	  SCR and the L6 BSE. The currently compiled script is
	  ../ring.choreo.toml ("choreo-1"): hold the boot-time station, FORM
	  an equidistant ring (shape=circle, frame=absolute), then a named
	  HOLD ("settled") that only re-forms on a debounced element_lost/
	  element_joined — not on ordinary gossip jitter. See that file's own
	  comments for the full design rationale.

	  A second script, form-grid.choreo.toml (the earlier near-square
	  grid), also lives in this directory; src/choreo_script.h is
	  generated from whichever one you compile, so switching scripts means
	  re-running the tool and rebuilding:

	    python3 sdk/tools/choreoc.py \
	        examples/cutebot-formation/ring.choreo.toml \
	        -o examples/cutebot-formation/src/choreo_script.h

	  ONE BINARY for all robots — element IDs are negotiated at boot over
	  BLE (transport_negotiate_id).

	  This is now the only "normal" build mode — the original L4-only
	  spring-field showcase (no SCR/L6/L7) was removed 2026-09-13 once
	  choreo-1 (ring.choreo.toml) matched and then surpassed it on real
	  hardware: ran end-to-end on four physical robots on 2026-08-24
	  (hold -> form(grid) -> hold), then again on 2026-09-12 with the
	  ring script after the FORM/HOLD-debounce and sync-barrier fixes
	  (see git history) — settled cleanly with no jitter, no fallback
	  needed. See the README's "Known limitations" for the FORM/
	  abs_position caveat (dead-reckoning drift).

config DEMO_MODE_STRAIGHT_LINE
	bool "Straight-line drive test (single robot, no swarm/Choreo/SCR)"
	depends on CUTEBOT_VARIANT_MINI
	help
	  CUTEBOT_VARIANT_MINI only: built around cutebot_line.h's edge-timing
	  data (demo_grid_heading_correct()'s sign-verification flash below),
	  which Cutebot Pro's I2C-polled 4-way sensor doesn't provide the same
	  way — DEMO_MODE_ENCODER_BENCH is Pro's equivalent bring-up
	  diagnostic instead.

	  Isolated motion-primitive test — skips transport_init(), auto-ID,
	  SCR, and Choreo entirely. There is no peer repulsion here, not
	  because it's disabled but because it structurally cannot fire:
	  demo_track_target()'s emergency backstop (DEMO_TRACK_MIN_SEP) only
	  triggers against a fresh peer in the world model, and this mode
	  never builds one (no gossip, no wm at all).

	  main() does: substrate_init(), cutebot_line_init(), seed odometry
	  at a fixed position/heading (DEMO_TEST_START_X/Y/HEADING,
	  formation.h — default matches id=0's normal seed: one square east
	  of board center, heading 0), then loop forever calling
	  demo_drive_straight() (formation.c) — constant forward force
	  through the SAME arena fence demo_track_target() uses — plus grid
	  correction on detected crossings, logging position and sensor
	  state every cycle.

	  For validating ONE thing at a time before trusting the full
	  swarm/Choreo stack: does the estimate track straight, does grid
	  correction fire the expected number of times for a known number of
	  gridlines, does the fence actually stop it near the true board
	  edge. Flash exactly ONE robot, physically placed at the position/
	  heading this config assumes.

	  No heading correction from the line sensors: an axis-relative
	  "one sensor changed alone = drifted" signal only means what it
	  looks like when travel is parallel to a gridline. A later diagonal
	  Choreo move crosses both row and column lines as a matter of
	  course, where that same signal doesn't distinguish drift from
	  correct diagonal progress — deliberately not generalized to that
	  case; heading is uncorrected here, same as the swarm demo.

config DEMO_MODE_CONVERGE_TEST
	bool "Two-robot converge/swap test (real gossip, no SCR/Choreo)"
	depends on CUTEBOT_VARIANT_MINI
	help
	  CUTEBOT_VARIANT_MINI only, same reason as DEMO_MODE_STRAIGHT_LINE
	  above — not yet ported to Cutebot Pro's I2C line sensor.

	  The next motion primitive after DEMO_MODE_STRAIGHT_LINE: two
	  robots swap positions via demo_track_target() — real transport +
	  gossip for live peer-position awareness (the repulsion backstop
	  below needs an ACTUAL peer position, not a hardcoded guess), but
	  no SCR and no Choreo — a fixed target computed once at boot, not a
	  FORM-derived one.

	  Collision avoidance is exactly demo_track_target()'s existing
	  emergency repulsion backstop (DEMO_TRACK_MIN_SEP, formation.h) —
	  the same close-range-only mechanism the 2026-08-24 four-robot
	  form-grid run already exercised, unmodified: zero effect beyond
	  160 mm, repels only inside it. Nothing here adds long-range
	  repulsion — attraction toward the fixed target is unopposed until
	  the peer is genuinely close.

	  Requires EXACTLY two robots powered together: transport_negotiate_
	  id() needs a peer to resolve at all (same requirement the swarm
	  demo already has), and "swap with whom" is only unambiguous for
	  precisely two — a third or more grounds with an error rather than
	  guessing. With two, compute_start_pos() (unchanged, main.c) already
	  places them exactly opposite each other: (60,50) and (40,50), 253mm
	  apart on the same line through center — no new placement scheme.

	  Watch this run closely and be ready to pick a robot up: a perfectly
	  head-on, perfectly symmetric approach is a real edge case for a
	  velocity-based repulsion force (both sides pushing back exactly
	  along the same line they're attracted along has no built-in lateral
	  escape direction) — real-world asymmetry likely breaks the tie, but
	  that is a hypothesis this test exists to check, not a guarantee.

config DEMO_MODE_WHEEL_CHARACTERIZE
	bool "Per-wheel actuator characterization (single robot, no fence)"
	help
	  Diagnostic for "which robot's wheels are miscalibrated" — built
	  after choreo-1's ring test failed on real hardware a second time
	  (some robots curving instead of driving straight) despite a clean
	  Webots simulation, to get real numbers on each wheel's actual
	  response instead of guessing from the emergent failure.

	  Bypasses formation.c's whole force model: no odometry, no grid
	  correction, no arena fence. A scripted sequence of raw left/right
	  wheel percentages runs once, each step held briefly then stopped
	  with a pause before the next:

	    1. Per-wheel stiction ramp — left wheel alone (right=0) at
	       8/12/16/20/24/28/30/32/34%, then the same for right alone. Watch for
	       the exact percentage at which THAT wheel visibly starts to
	       turn — if the two wheels' thresholds differ, that alone can
	       explain curving at any commanded speed near either threshold.
	    2. Straight-line sweep — both wheels equal, at 22/35/50%. Judge
	       by eye/ruler whether it actually goes straight at each speed,
	       not just the one ~22% level DEMO_MODE_STRAIGHT_LINE is
	       mathematically locked to (that mode's commanded turn is always
	       exactly 0 by construction, so it already isolates real
	       mechanical asymmetry from the estimator — but only at that one
	       operating point).
	    3. In-place rotation, both directions — does turning speed match
	       between CW and CCW for the same equal-and-opposite command?

	  NOT run through the arena fence: run this on a long clear stretch
	  of floor, not the chessboard, especially for the straight-line
	  sweep at the higher percentages. Flash and run ONE robot at a time
	  — there is nothing here to identify which robot is which, and
	  nothing to distinguish results across robots except which one is
	  physically on the floor.

config DEMO_MODE_LINE_SENSOR_BENCH
	bool "Line sensor bring-up: log raw sensor state every 500 ms"
	help
	  Diagnostic for "are the line sensors even connected/responding at
	  all" — built after a DEMO_MODE_STRAIGHT_LINE run that stayed
	  entirely on the printed chessboard's checkered area but logged
	  ZERO line-sensor edges the whole way, an unexplained hardware-level
	  gap (cutebot_line_init() reported success — the GPIO/interrupt
	  config itself is fine) uncovered while bench-verifying the new
	  grid-based heading correction.

	  CUTEBOT_VARIANT_MINI: no motors, no odometry, no interrupts — just
	  cutebot_line_bench.c configuring the two edge-connector pins (P13,
	  P14) as plain inputs and logging their RAW levels (no "true means
	  line" inversion — see cutebot_line_bench.h for why) once every
	  500 ms, forever:

	    P13: 1  P14: 1

	  Originally also logged P11/P12, on a report that a physical unit
	  might have four IR modules wired instead of the documented two —
	  confirmed on the bench that P11/P12 never toggle, so this now
	  covers only the two real pins.

	  Hold different materials/colors under the sensors and vary the
	  angle/height while watching the log — this isolates the sensor
	  response itself from any question of driving speed or crossing
	  timing, so a real answer (does anything ever toggle) doesn't
	  depend on catching a brief transition while physically dragging a
	  robot around.

	  CUTEBOT_VARIANT_PRO: no GPIO pins at all — the 4-way sensor lives
	  entirely behind the same I2C bus as the motor/encoder controller
	  (cutebot_pro_read_line_state(), cmd 0x60/0x00). Logs the raw 4-bit
	  state (bit0..bit3 = channel 1..4) every 500 ms instead:

	    state=0000 (no line)   state=0110 (on line)   state=1111 (crossroads)

config DEMO_MODE_DISCOVERY_BENCH
	bool "Discovery detection bench: drive straight over the real target marker"
	depends on CUTEBOT_VARIANT_MINI
	help
	  Diagnostic for the leak/spill discovery demos — bench-confirms
	  demo_discovery_detect() (formation.c) against the real printed
	  target marker before trusting it in any multi-robot run. Modeled
	  directly on DEMO_MODE_STRAIGHT_LINE: single robot, no transport/
	  auto-ID/SCR/Choreo at all, demo_drive_straight() (constant forward
	  force through the arena fence) seeded at a fixed position/heading
	  (DEMO_TEST_START_X/Y/HEADING, formation.h — same knobs
	  DEMO_MODE_STRAIGHT_LINE uses).

	  Unlike STRAIGHT_LINE, this does NOT run grid correction (no
	  gridline-vs-target disambiguation is needed at all here — see
	  demo_discovery_detect()'s own doc for why) — it only runs
	  demo_discovery_detect() against the raw line-sensor reading every
	  poll, and logs a line every time either sensor reads dark (not
	  just a periodic trace, so a single confirming pass over the
	  marker is never lost between 1 Hz status lines) plus one clear
	  line the moment DEMO_DISCOVERY_CONFIRM_POLLS is reached. The
	  signal LED goes solid ACTIVE (green) the instant discovery is
	  confirmed and stays there — a bench-visible confirmation with no
	  serial cable needed while positioning the robot over the marker.

	  Drive the robot in a straight line across the marker (placed
	  anywhere along that line, off any gridline — see the marker's own
	  doc) and confirm: no dark reading anywhere else on the clear
	  board, a confirmed hit only when crossing the marker itself, and
	  the LED/log firing on the very pass that crosses it.

	  CUTEBOT_VARIANT_MINI only — built on cutebot_line.h's GPIO sensor,
	  same as DEMO_MODE_STRAIGHT_LINE; not ported to Cutebot Pro's I2C
	  sensor (DEMO_MODE_ENCODER_BENCH covers Pro's own bring-up needs
	  instead). leak/spill discovery itself does run on Pro, via
	  cutebot_pro_line_watch_*() in the choreo loop — see main.c.

config DEMO_MODE_ENCODER_BENCH
	bool "Encoder bring-up (Cutebot Pro only): log measured wheel speed/distance"
	depends on CUTEBOT_VARIANT_PRO
	help
	  Diagnostic for "what does the encoder actually report" — Cutebot
	  Pro is the first hardware in this repo with real closed-loop wheel
	  feedback, and cutebot_pro_read_encoders()'s distance units are
	  UNVERIFIED (ELECFREAKS' own firmware source calls it "rotation
	  degrees" but returns a 4-byte value — never bench-checked). Same
	  "characterize before trusting" role DEMO_MODE_WHEEL_CHARACTERIZE
	  plays for Mini's open-loop wheels.

	  Drives both wheels forward at a fixed cutebot_pro_drive_cms()
	  target (comfortably inside the firmware's 20-50 cm/s legal range),
	  clears both encoder counters via cutebot_pro_clear_encoders(), then
	  logs measured left/right speed and cumulative distance every
	  500 ms. Compare the logged distance against a physically measured
	  travel distance to pin down the real unit and scale factor before
	  any odometry code trusts this value. Not run through the arena
	  fence or any force model — a long clear stretch of floor, not the
	  chessboard, same caveat DEMO_MODE_WHEEL_CHARACTERIZE gives.

config DEMO_MODE_CIRCLE_BENCH
	bool "Actuation bench (Cutebot Pro only): straight, then an arc turn, then straight"
	depends on CUTEBOT_VARIANT_PRO
	help
	  Diagnostic for a real 2026-09-22 hardware bug: a 4-robot ring
	  re-form (triangle after one robot powered off) needed real turns
	  and got none — robots only rocked back and forth in a straight
	  line. Root cause: cutebot_pro_drive_cms() floored each wheel's
	  magnitude into the firmware's [20,50] cm/s range INDEPENDENTLY,
	  which silently erases any turn whose natural differential is
	  smaller than the floor (nearly every real arc turn, since
	  formation.c's angular.z is inherently much smaller than linear.x
	  — see substrate_cutebot_pro.c's doc) by snapping both wheels to
	  the same floored speed. Fixed by scaling both wheels together to
	  preserve their ratio instead of flooring separately — see
	  cutebot_pro_drive_cms()'s own doc for the exact fix.

	  Bypasses formation.c's whole control law — direct
	  cutebot_pro_drive_cms() calls, same "isolate the actuation
	  primitive" philosophy as DEMO_MODE_WHEEL_CHARACTERIZE — so a
	  passing run here confirms the fix at the driver level before
	  trusting it through the full choreo/force-model stack again:

	    1. straight for 2s  (both wheels equal, 30 cm/s)
	    2. an arc turn for 8s (left=20 cm/s, right=50 cm/s — the
	       firmware's maximum representable 2.5:1 ratio, the sharpest
	       turn this hardware can do at all) — should visibly curve,
	       not travel in a straight line
	    3. straight for 2s again (both wheels equal, 30 cm/s)

	  8s is a starting guess, not a calibrated "exactly 360 degrees"
	  duration (no real wheel-track measurement exists yet for this
	  chassis — see DEMO_WHEEL_TRACK's doc, formation.h). Time/count how
	  much it actually turns and report back so the duration (or the
	  wheel-track constant, for anything that needs a real angle) can be
	  calibrated from a real number instead of a guess. NOT run through
	  the arena fence — long clear floor, not the chessboard.

config DEMO_MODE_TURN_CALIBRATE
	bool "Turn-scale calibration (Cutebot Pro only): measured spins"
	depends on CUTEBOT_VARIANT_PRO
	help
	  Measures this robot's CCW and CW turn-scale error, by hand. Line
	  the robot up with a reference (a board line along the chassis
	  edge, a tape mark on the floor) and press button A for CCW or B
	  for CW: after a short pause it spins DEMO_TURN_CAL_TURNS full
	  turns by its encoders, at the speed the demo turns, and reports
	  the encoder's total rotation, coast included. Measure how far the
	  robot ended past (+) or short of (-) its starting heading; then

	    scale = (360 x turns + offset) / encoder total

	  for that direction. Repeat as often as needed; each press is an
	  independent run from wherever the robot is re-aligned.

	  Results go over serial and, in a ble_debug.conf build, over BLE
	  to the observer, keyed by this micro:bit's hardware id. The scales
	  go into src/turn_calibration.h (compiled in, because flashing a
	  micro:bit erases its whole flash) and are applied to every turn
	  the demo's odometry measures.

endchoice

config DEMO_TURN_CAL_TURNS
	int "Turns per calibration spin"
	depends on DEMO_MODE_TURN_CALIBRATE
	default 5
	help
	  More turns spread the same reading error over more rotation: at
	  5 turns a 5-degree misread is a 0.3% scale error.

choice CUTEBOT_VARIANT
	prompt "Cutebot hardware variant"
	default CUTEBOT_VARIANT_MINI

config CUTEBOT_VARIANT_MINI
	bool "Cutebot Mini (open-loop drive, 2-sensor GPIO line following)"
	help
	  The original hardware every mode in this example was built and
	  hardware-validated against: cutebot.c's raw-percentage I2C drive,
	  cutebot_line.c's interrupt-driven GPIO line sensors. Stays default
	  until Cutebot Pro hardware (below) is in hand and validated —
	  see project history for why.

config CUTEBOT_VARIANT_PRO
	bool "Cutebot Pro V2.1 (closed-loop encoder motors, I2C 4-way IR)"
	help
	  ELECFREAKS Cutebot Pro, V2-generation firmware protocol (verified
	  against elecfreaks/pxt-Cutebot-Pro's own v2.ts/main.ts source, not
	  guessed) — NOT the same I2C protocol as CUTEBOT_VARIANT_MINI despite
	  sharing the same address (0x10) and bus:
	    - Motor: cmd 0x80, a continuous non-blocking closed-loop cm/s
	      target per wheel (firmware PID, 20-50 cm/s legal nonzero range)
	      — NOT the open-loop raw percentage Mini uses.
	    - Encoders: cmd 0xA0, real measured per-wheel speed + cumulative
	      distance — Mini has no equivalent; formation.c's odometry is
	      open-loop dead reckoning only.
	    - 4-way line sensor: cmd 0x60, one I2C-polled byte (bit0..bit3 =
	      channel 1..4) — a genuinely different sensor arrangement from
	      Mini's 2 interrupt-driven GPIO pins, and rich enough to detect
	      crossroads (all 4 bits) and T-junctions (any 3 bits) directly,
	      not just a line-present/absent edge.

	  Untested on real hardware as of this Kconfig entry — hardware has
	  not arrived yet. Calibration constants (CUTEBOT_PRO_MAX_SPEED_CMS,
	  CUTEBOT_PRO_WHEEL_TRACK_CM, see substrate_cutebot_pro.c) are
	  UNVERIFIED PLACEHOLDERS pending bench measurement, same as Mini's
	  own DEMO_MAX_SPEED/DEMO_WHEEL_TRACK were before their 2026-09
	  bench sessions. Run DEMO_MODE_ENCODER_BENCH and the Pro branch of
	  DEMO_MODE_LINE_SENSOR_BENCH first, on real hardware, before
	  trusting anything built on top of them.

	  This board revision (V2.1.0) added an onboard gyroscope over
	  V2.0.2 ("improved turning accuracy" per ELECFREAKS' own version
	  comparison table) — no host-readable I2C register for it is
	  documented anywhere (not in the official firmware source, not in
	  an independent V2.0.2/V2.1.0-specific community driver, not in the
	  vendor wiki), so it is not read here; the working assumption is
	  that it feeds the firmware's own PID angle/steering loop
	  internally, meaning cmd 0x80's closed-loop turning already
	  benefits from it with no code on our side. Revisit if a real
	  register ever turns up.

endchoice

config DEMO_GRID_CORRECTION
	bool "Enable grid-based position/heading drift correction"
	default n
	help
	  Gates demo_grid_correct()/demo_grid_heading_correct() (formation.c)
	  in every mode with real odometry (STRAIGHT_LINE, CONVERGE_TEST, the
	  swarm/CHOREO loop) — both depend entirely on the ground-facing line
	  sensors actually detecting a real dark/light transition on the
	  physical board.

	  Default y is the intended long-term behavior once the board
	  reliably registers as IR-dark (see DEMO_LINE_SENSOR_SEPARATION_MM's
	  doc, formation.h, for the 2026-09-10 bench finding that this
	  printed chessboard's black ink does NOT read as dark to these IR
	  sensors, and needs real IR-absorptive tape along the gridlines —
	  not full squares, see that same doc — before either correction can
	  fire at all). Until that tape is in place, both corrections are
	  already silently no-ops (zero real crossings ever detected) — this
	  flag exists to make that explicit and deliberate rather than
	  incidental, e.g. for a run that wants pure dead-reckoning behavior
	  guaranteed even if the board is later partially retaped. Override
	  for a no-correction run:
	    west build ... -- -DCONFIG_DEMO_GRID_CORRECTION=n

	  On Cutebot Pro this gates demo_junction_correct() instead.

	  Default n since 2026-10-05: this printed board does not read as a
	  usable grid to either robot's line sensors (Pro: black and white
	  squares only 4-14 counts apart per channel out of 255), and the
	  Pro's junction snap fires on black squares. Enable only on a board
	  with IR-dark lines.

config TAPESTRY_QUORUM_MIN
	int "Minimum fresh peers for DEGRADED state"
	depends on DEMO_MODE_CHOREO
	range 0 4
	default 1
	help
	  Fed to scr_init() (main.c). 1: this script only ever needs one fresh
	  peer to leave SCR_QUORUM_LOST — same default cf21bl-formation and
	  webots-formation use for the same reason.

config TAPESTRY_QUORUM_TARGET
	int "Minimum fresh peers for HEALTHY state"
	depends on DEMO_MODE_CHOREO
	range 0 4
	default 1

config DEMO_LEAK_DUAL
	bool "Both leak demos, picked at boot by whether the leak sensor is on"
	depends on DEMO_MODE_CHOREO
	help
	  Builds leak.choreo.toml AND leak-sensor.choreo.toml into the robots
	  instead of src/choreo_script.h. At boot the start barrier also
	  listens for a stationary element (examples/leak-sensor) for at least
	  DEMO_LEAK_LISTEN_MS: heard -> leak-sensor (wait for its button),
	  not heard -> leak (search the board for the printed marker). Switch
	  demos by powering the sensor on or off and power-cycling the robots;
	  no reflash. The leak-sensor script is the header examples/leak-sensor
	  ships; the leak one is src/choreo_leak.h (see leak_scripts.h).

config DEMO_LEAK_LISTEN_MS
	int "How long the start barrier listens for the leak sensor (ms)"
	depends on DEMO_LEAK_DUAL
	default 3000
	help
	  Counted from the end of auto-ID. The sensor gossips every 500 ms, so
	  3 s is six chances to hear it; every robot must reach the same
	  answer or they would run different scripts.

config DEMO_BLE_DEBUG
	bool "Broadcast debug telemetry over BLE (legacy advertising)"
	depends on (DEMO_MODE_CHOREO || DEMO_MODE_TURN_CALIBRATE || \
		    DEMO_MODE_ENCODER_BENCH) && BT
	help
	  Adds a third, legacy-format BLE advertising set (after state gossip
	  and shared facts) carrying a status packet (~2 Hz: step, quorum,
	  estimate, target, the target landmark) and the demo's key log events
	  as text, for untethered runs.  Enable with
	  -DEXTRA_CONF_FILE=ble_debug.conf, which also raises
	  BT_EXT_ADV_MAX_ADV_SET to 3 — this app's Kconfig sources Zephyr's
	  first, so it cannot raise that default itself.  See src/ble_debug.h.
```

## prj.conf
```kconfig
# ── Stack / heap ──────────────────────────────────────────────────────────────
CONFIG_MAIN_STACK_SIZE=8192

# ── Hardware info (FICR device ID — used for auto element-ID assignment) ──────
CONFIG_HWINFO=y

# ── Floating point ────────────────────────────────────────────────────────────
CONFIG_FPU=y

# ── Logging ───────────────────────────────────────────────────────────────────
CONFIG_LOG=y
CONFIG_LOG_DEFAULT_LEVEL=3
CONFIG_PRINTK=y

# ── Identity ──────────────────────────────────────────────────────────────────
# One binary for all robots — IDs negotiated at boot over BLE. 8 s window
# (vs the 4 s transport.c default): was previously set via a CMakeLists.txt
# target_compile_definitions override "without touching Kconfig" — moved
# here now that this app's own Kconfig (added alongside L5/L6/L7 wiring)
# rsources tapestry-os/subsys/transport/Kconfig, which already declares
# this option; setting both would double-define the macro.
CONFIG_TAPESTRY_AUTO_ID_WINDOW_MS=8000

# Board-specific configs (BLE, I2C) live in boards/bbc_microbit_v2.conf.
```

## ble_debug.conf
```kconfig
# Wireless debug telemetry for untethered runs — see Kconfig's
# DEMO_BLE_DEBUG and src/ble_debug.h.  Build with:
#   west build ... -- -DEXTRA_CONF_FILE=ble_debug.conf
CONFIG_DEMO_BLE_DEBUG=y
# Gossip's extended set + the debug set's legacy one.
CONFIG_BT_EXT_ADV_MAX_ADV_SET=2
```

## boards/bbc_microbit_v2.conf
```kconfig
# Board overlay for BBC micro:bit V2 (nRF52833 / Cortex-M4F)
# BLE gossip transport + Cutebot Mini motor and LED output.

# ── Floating point ────────────────────────────────────────────────────────────
CONFIG_FPU=y
CONFIG_FPU_SHARING=y

# ── Bluetooth ─────────────────────────────────────────────────────────────────
# CONFIG_BT_EXT_ADV: required since the gossip frame (wire.h v3, 42 bytes)
# no longer fits legacy advertising's 31-byte payload — see
# transceiver_ble.c's header comment.
CONFIG_BT=y
CONFIG_BT_OBSERVER=y
CONFIG_BT_BROADCASTER=y
CONFIG_BT_EXT_ADV=y

# CONFIG_BT_EXT_ADV (host) and CONFIG_BT_CTLR_ADV_EXT (controller, which it
# pulls in by default) only enable the extended-advertising FEATURE — the
# controller's advertising/scan BUFFERS are separate knobs and both default
# to 31, the legacy payload size.  Left at the default the controller answers
# LE Read Max Adv Data Len with 31, the host enforces that, and every
# bt_le_ext_adv_set_data() fails -EDOM: the advertiser starts cleanly and then
# never transmits a frame, so every element sees zero peers (red headlights,
# no motion — 2026-08-24 first hardware run).  64 covers the 48 bytes the
# wire.h v3 frame needs (42-byte frame + company ID + msg type + AD headers)
# with headroom for another wire-format growth.  SCAN_DATA_LEN_MAX must rise
# with it or elements can send what they cannot receive.
CONFIG_BT_CTLR_ADV_DATA_LEN_MAX=64
CONFIG_BT_CTLR_SCAN_DATA_LEN_MAX=64
# Two advertising sets: state gossip, and the shared-fact set that bursts a
# few events per Trickle send (wire.h v7, transceiver_ble.c).  The fact
# AD record is 62 bytes (57-byte frame + auth tag, company id, type, AD
# header) — inside the 64 above.  ble_debug.conf raises this to 3.
CONFIG_BT_EXT_ADV_MAX_ADV_SET=2
CONFIG_BT_DEVICE_NAME="tapestry-cutebot-formation"
CONFIG_BT_RX_STACK_SIZE=4096
CONFIG_SYSTEM_WORKQUEUE_STACK_SIZE=4096

# ── I2C (Cutebot) ─────────────────────────────────────────────────────────────
CONFIG_I2C=y
CONFIG_I2C_GPIO=y

# ── micro:bit LED matrix ───────────────────────────────────────────────────────
# MICROBIT_DISPLAY (mb_display_get / mb_display_image) depends on DISPLAY.
CONFIG_DISPLAY=y
CONFIG_MICROBIT_DISPLAY=y
```

## src/ble_debug.c
```c
/*
 * ble_debug.c — see ble_debug.h for the packet format and why it is a
 * separate legacy advertising set.
 */
#include "ble_debug.h"

#include <stdarg.h>
#include <string.h>
#include <math.h>
#include <zephyr/kernel.h>
#include <zephyr/bluetooth/bluetooth.h>
#include <zephyr/logging/log.h>
#include <zephyr/sys/byteorder.h>
#include <zephyr/sys/printk.h>
#include <zephyr/sys/ring_buffer.h>
#include <zephyr/sys/atomic.h>

#include "transceiver_ble.h"   /* ble_transceiver_other_tapestry_ad() */

LOG_MODULE_REGISTER(ble_debug, LOG_LEVEL_INF);

#define KIND_STATUS   0x10u
#define KIND_TEXT     0x11u
#define PAYLOAD_LEN   27u   /* 31-byte legacy PDU - AD len/type (2) - company (2) */
#define TEXT_LEN      22u   /* PAYLOAD_LEN - kind/id/seq (4) - tseq (1) */

/* A new packet every 120 ms, from the system workqueue — NOT the main
 * loop, which a lone robot never reaches (it sits in transport_negotiate_
 * id_retry() until a peer appears).  Status every 4th packet (~2 Hz), or
 * whenever no text is queued. */
#define PACKET_PERIOD_MS   120
#define STATUS_EVERY_TICKS 4u

/* Advertise every 50 ms: each 120 ms packet goes out two or three times
 * before the next replaces it, which is what gives the receiver a second
 * chance at a lost one. */
#define ADV_INTERVAL_MIN BT_GAP_MS_TO_ADV_INTERVAL(50)
#define ADV_INTERVAL_MAX BT_GAP_MS_TO_ADV_INTERVAL(60)

static uint8_t s_mfr[2 + PAYLOAD_LEN] = { 0xD7, 0x08 };   /* TAPESTRY_BLE_COMPANY_ID */
static const struct bt_data s_ad[] = {
    BT_DATA(BT_DATA_MANUFACTURER_DATA, s_mfr, sizeof(s_mfr)),
};

static struct bt_le_ext_adv *s_adv;
static uint16_t s_seq;
static uint8_t  s_tseq;
static uint32_t s_ticks;

/* Every text chunk goes out in TWO packets (same seq, so the receiver
 * de-duplicates): at the ~16% packet loss measured on hardware, a
 * 5-chunk line sent once arrived intact only ~40% of the time. */
static uint8_t  s_last_text[PAYLOAD_LEN];
static bool     s_text_resend;

/* Shared between the main thread (writers) and the work item (reader). */
static struct k_spinlock s_lock;
static uint8_t  s_id = 0xFFu;
static uint8_t  s_drops;
/* Until the main loop publishes one: "alive, not negotiated yet". */
static ble_debug_status_t s_status = { .step = -1 };

RING_BUF_DECLARE(s_text, 2048);

/*
 * Airtime diagnostics, logged over serial every DIAG_PERIOD_MS: is this
 * robot getting its debug packets out, and does it hear its peers' debug
 * packets?  They tell a congested robot radio apart from a receiver
 * that is missing packets.
 */
#define DIAG_PERIOD_MS 5000u
#define DIAG_MAX_IDS   8u
static uint32_t s_diag_runs;
static uint32_t s_diag_fail;
static int      s_diag_last_err;
static uint32_t s_diag_max_set_ms;
static uint32_t s_diag_start_ms;
static atomic_t s_heard[DIAG_MAX_IDS];   /* peer debug packets heard, by id */
static atomic_t s_heard_other;           /* id >= DIAG_MAX_IDS (e.g. 0xFF)  */

/* Scan-callback hook (BT RX thread): another element's debug packet. */
void ble_transceiver_other_tapestry_ad(const uint8_t *data, uint8_t len,
                                       int8_t rssi)
{
    ARG_UNUSED(rssi);
    if (len != 2u + PAYLOAD_LEN ||
        (data[2] != KIND_STATUS && data[2] != KIND_TEXT)) {
        return;
    }
    uint8_t id = data[3];
    atomic_inc(id < DIAG_MAX_IDS ? &s_heard[id] : &s_heard_other);
}

static void diag_tick(uint32_t set_ms, int ret)
{
    s_diag_runs++;
    s_diag_max_set_ms = MAX(s_diag_max_set_ms, set_ms);
    if (ret != 0) {
        s_diag_fail++;
        s_diag_last_err = ret;
    }

    uint32_t now = k_uptime_get_32();
    if (now - s_diag_start_ms < DIAG_PERIOD_MS) {
        return;
    }
    uint32_t span = now - s_diag_start_ms;
    uint32_t h[DIAG_MAX_IDS];
    for (unsigned i = 0; i < DIAG_MAX_IDS; i++) {
        h[i] = (uint32_t)atomic_set(&s_heard[i], 0);
    }
    uint32_t other = (uint32_t)atomic_set(&s_heard_other, 0);

    LOG_INF("dbg tx: %u pkts in %u ms (%u/s), set_data fail %u (last %d), "
            "max %u ms | heard peers' dbg: id0=%u id1=%u id2=%u id3=%u "
            "other=%u", s_diag_runs, span, s_diag_runs * 1000u / span,
            s_diag_fail, s_diag_last_err, s_diag_max_set_ms,
            h[0], h[1], h[2], h[3], other);
    s_diag_runs = s_diag_fail = s_diag_max_set_ms = 0;
    s_diag_last_err = 0;
    s_diag_start_ms = now;
}

static void packet_work_fn(struct k_work *work);
static K_WORK_DELAYABLE_DEFINE(s_packet_work, packet_work_fn);

int ble_debug_init(void)
{
    /* No options: legacy, non-connectable, non-scannable (ADV_NONCONN_IND). */
    struct bt_le_adv_param param =
        BT_LE_ADV_PARAM_INIT(BT_LE_ADV_OPT_NONE, ADV_INTERVAL_MIN,
                             ADV_INTERVAL_MAX, NULL);

    int ret = bt_le_ext_adv_create(&param, NULL, &s_adv);
    if (ret != 0) {
        LOG_ERR("debug adv set create failed: %d "
                "(built without ble_debug.conf?)", ret);
        s_adv = NULL;
        return ret;
    }
    ret = bt_le_ext_adv_set_data(s_adv, s_ad, ARRAY_SIZE(s_ad), NULL, 0);
    if (ret == 0) {
        ret = bt_le_ext_adv_start(s_adv, BT_LE_EXT_ADV_START_DEFAULT);
    }
    if (ret != 0) {
        LOG_ERR("debug adv set start failed: %d", ret);
        bt_le_ext_adv_delete(s_adv);
        s_adv = NULL;
        return ret;
    }
    k_work_schedule(&s_packet_work, K_NO_WAIT);
    LOG_INF("BLE debug telemetry on (legacy adv, 50 ms)");
    return 0;
}

void ble_debug_set_id(uint8_t id)
{
    k_spinlock_key_t key = k_spin_lock(&s_lock);
    s_id = id;
    k_spin_unlock(&s_lock, key);
}

void ble_debug_printf(const char *fmt, ...)
{
    char line[128];
    va_list ap;

    va_start(ap, fmt);
    int n = vsnprintk(line, sizeof(line) - 1, fmt, ap);
    va_end(ap);
    if (n < 0) {
        return;
    }
    if (n > (int)sizeof(line) - 2) {
        n = (int)sizeof(line) - 2;   /* truncated */
    }
    line[n++] = '\n';

    k_spinlock_key_t key = k_spin_lock(&s_lock);
    if (ring_buf_space_get(&s_text) < (uint32_t)n) {
        if (s_drops < UINT8_MAX) {
            s_drops++;
        }
    } else {
        ring_buf_put(&s_text, (const uint8_t *)line, (uint32_t)n);
    }
    k_spin_unlock(&s_lock, key);
}

void ble_debug_set_status(const ble_debug_status_t *st)
{
    k_spinlock_key_t key = k_spin_lock(&s_lock);
    s_status = *st;
    k_spin_unlock(&s_lock, key);
}

/* World units / radians -> int16 hundredths / milliradians. */
static int16_t q16(float v, float scale)
{
    float s = v * scale;
    if (!isfinite(s)) {
        return INT16_MIN;
    }
    if (s > (float)INT16_MAX) {
        return INT16_MAX;
    }
    if (s < (float)(INT16_MIN + 1)) {
        return INT16_MIN + 1;   /* INT16_MIN is reserved for "not valid" */
    }
    return (int16_t)lrintf(s);
}

/*
 * Status body, 23 bytes, all little-endian:
 *   [0-3]  uptime ms (u32)
 *   [4]    step (i8)
 *   [5]    flags: b0-1 quorum, b2 suspended, b3 discovered,
 *                 b4 point_valid, b5 target_valid
 *   [6]    fresh peers (low nibble, saturates at 15) | track << 4
 *   [7-8]  x    [9-10] y      (i16, units * 100)
 *   [11-12] heading            (i16, milliradians)
 *   [13-14] tx  [15-16] ty     (i16, units * 100; INT16_MIN = none)
 *   [17-18] px  [19-20] py     (i16, units * 100; INT16_MIN = none)
 *   [21]   gray_max (u8)
 *   [22]   text lines dropped so far (u8, saturating)
 */
static void pack_status(uint8_t *b, const ble_debug_status_t *st,
                        uint8_t drops)
{
    sys_put_le32(k_uptime_get_32(), &b[0]);
    b[4] = (uint8_t)st->step;
    b[5] = (uint8_t)((st->quorum & 0x3u) |
                     (st->suspended    ? BIT(2) : 0u) |
                     (st->discovered   ? BIT(3) : 0u) |
                     (st->point_valid  ? BIT(4) : 0u) |
                     (st->target_valid ? BIT(5) : 0u));
    b[6] = (uint8_t)(MIN(st->fresh_peers, 15u) | ((st->track & 0xFu) << 4));
    sys_put_le16((uint16_t)q16(st->x, 100.0f), &b[7]);
    sys_put_le16((uint16_t)q16(st->y, 100.0f), &b[9]);
    sys_put_le16((uint16_t)q16(st->heading, 1000.0f), &b[11]);
    sys_put_le16((uint16_t)(st->target_valid ? q16(st->tx, 100.0f) : INT16_MIN), &b[13]);
    sys_put_le16((uint16_t)(st->target_valid ? q16(st->ty, 100.0f) : INT16_MIN), &b[15]);
    sys_put_le16((uint16_t)(st->point_valid  ? q16(st->px, 100.0f) : INT16_MIN), &b[17]);
    sys_put_le16((uint16_t)(st->point_valid  ? q16(st->py, 100.0f) : INT16_MIN), &b[19]);
    b[21] = st->gray_max;
    b[22] = drops;
}

static void packet_work_fn(struct k_work *work)
{
    ARG_UNUSED(work);
    s_ticks++;

    uint8_t *p = &s_mfr[2];

    k_spinlock_key_t key = k_spin_lock(&s_lock);
    bool text_waiting = s_text_resend || !ring_buf_is_empty(&s_text);
    if (!text_waiting || s_ticks % STATUS_EVERY_TICKS == 0u) {
        memset(p, 0, PAYLOAD_LEN);
        p[0] = KIND_STATUS;
        p[1] = s_id;
        sys_put_le16(++s_seq, &p[2]);
        pack_status(&p[4], &s_status, s_drops);
    } else if (s_text_resend) {
        memcpy(p, s_last_text, PAYLOAD_LEN);   /* same seq: a repeat */
        s_text_resend = false;
    } else {
        memset(p, 0, PAYLOAD_LEN);
        p[0] = KIND_TEXT;
        p[1] = s_id;
        sys_put_le16(++s_seq, &p[2]);
        p[4] = s_tseq++;
        ring_buf_get(&s_text, &p[5], TEXT_LEN);
        memcpy(s_last_text, p, PAYLOAD_LEN);
        s_text_resend = true;
    }
    k_spin_unlock(&s_lock, key);

    uint32_t t_set = k_uptime_get_32();
    int ret = bt_le_ext_adv_set_data(s_adv, s_ad, ARRAY_SIZE(s_ad), NULL, 0);
    diag_tick(k_uptime_get_32() - t_set, ret);
    if (ret != 0) {
        static bool warned;
        if (!warned) {
            warned = true;
            LOG_WRN("debug adv set_data failed: %d", ret);
        }
    }
    k_work_schedule(&s_packet_work, K_MSEC(PACKET_PERIOD_MS));
}
```

## src/ble_debug.h
```c
/*
 * ble_debug.h — wireless debug telemetry for untethered runs
 * (CONFIG_DEMO_BLE_DEBUG; build with -DEXTRA_CONF_FILE=ble_debug.conf).
 *
 * A second BLE advertising set, in LEGACY (31-byte) format so any BLE
 * scanner can hear it, including ones without LE Extended Advertising
 * support, to which the gossip set's extended PDUs are invisible.
 *
 * Every packet is one manufacturer-specific AD structure, 27 bytes after
 * the Tapestry company ID (0x08D7):
 *
 *   [0] kind   0x10 status / 0x11 text
 *   [1] id     element id (0xFF until negotiated)
 *   [2-3] seq  u16 LE, +1 per NEW packet (each is advertised ~2-3 times)
 *
 *   status [4..26]: ble_debug_status_t, packed as documented in
 *                   ble_debug.c's pack_status() (23 bytes)
 *   text   [4]:     tseq, u8, +1 per text chunk (the receiver's gap check)
 *          [5..26]: 22 bytes of a '\n'-separated log stream, 0-padded
 *
 * Robots ignore it for free: transceiver_ble.c drops any Tapestry AD
 * shorter than a full gossip frame (52 bytes) on its first length check.
 *
 * Packets go out from a system-workqueue item every 120 ms, independent
 * of main() — so a robot stuck in ID negotiation is still visible (as
 * id 0xFF, step -1).  The functions below may be called from any thread.
 */
#ifndef BLE_DEBUG_H
#define BLE_DEBUG_H

#include <stdbool.h>
#include <stdint.h>

typedef struct {
    int8_t  step;          /* choreo_script_step(), -1 before the script   */
    uint8_t track;
    uint8_t quorum;        /* scr_quorum_state_t (0 LOST .. 2 HEALTHY)     */
    uint8_t fresh_peers;
    bool    suspended;     /* Choreo frozen by quorum loss                 */
    bool    discovered;    /* own discovered bit                           */
    bool    point_valid;   /* discovery point latched (bse)                */
    bool    target_valid;  /* directive is MOVE_TO_POINT                   */
    float   x, y, heading; /* own estimate, world units / radians          */
    float   tx, ty;        /* directive target                             */
    float   px, py;        /* latched discovery point                      */
    uint8_t gray_max;      /* darkest line-sensor reading this tick        */
} ble_debug_status_t;

/* Create and start the advertising set.  Call after transport_init()
 * (which enables Bluetooth).  Returns 0 or a negative errno; on failure
 * every other call is a no-op. */
int  ble_debug_init(void);

void ble_debug_set_id(uint8_t id);

/* Append one line (a '\n' is added) to the text stream.  Lines that don't
 * fit the 2 KB queue are dropped and counted in the status packet. */
void ble_debug_printf(const char *fmt, ...);

/* Latest status; sent at ~2 Hz, more often while no text is queued. */
void ble_debug_set_status(const ble_debug_status_t *st);

#endif /* BLE_DEBUG_H */
```

## src/choreo_script.h
```c
/*
 * choreo_script.h — GENERATED from ring.choreo.toml — DO NOT EDIT.
 *
 * Choreo: "ring"
 * Regenerate after editing the script file:
 *   python3 tapestry/sdk/tools/choreoc.py tapestry/examples/cutebot-formation/ring.choreo.toml -o tapestry/examples/cutebot-formation/src/choreo_script.h
 *
 * Every step is time-bounded by construction (choreoc requires it): the
 * script cannot stall in flight, and CHOREO_SCRIPT_TOTAL_TIMEOUT_MS is a
 * hard upper bound on script runtime for mission-backstop math.
 */

#ifndef TAPESTRY_CHOREO_SCRIPT_H
#define TAPESTRY_CHOREO_SCRIPT_H

#include <tapestry/choreo.h>

#define CHOREO_NAME                    "ring"
#define CHOREO_SCRIPT_LEN              3u
#define CHOREO_SCRIPT_TOTAL_TIMEOUT_MS 600000u

/* Element departure policy — call choreo_set_departure_policy() (and,
 * for CHOREO_DEPARTURE_RECALL, choreo_set_departure_recall_point_fn())
 * before choreo_submit_script(). */
#define CHOREO_DEPARTURE_POLICY           CHOREO_DEPARTURE_CONTINUE
#define CHOREO_DEPARTURE_REASONS          CHOREO_DEPARTURE_REASONS_ALL
#define CHOREO_DEPARTURE_MIN_PARTICIPANTS 0u

static const choreo_step_t k_choreo_script[CHOREO_SCRIPT_LEN] = {
    { .goal = { .type = CHOREO_GOAL_HOLD,
                .required_caps = CHOREO_CAP_LOCOMOTION },
      .max_duration_ms = 5000u,
      .advance_on_achieved = false },

    { .goal = { .type = CHOREO_GOAL_FORM,
                .target = { 50.0f, 50.0f, 0.0f },
                .radius = 30.0f,
                .shape = TAPESTRY_BSE_SHAPE_CIRCLE,
                .required_caps = CHOREO_CAP_LOCOMOTION | CHOREO_CAP_ABS_POSITION,
                .achieve_eps = 3.0f,
                .achieve_hold_ms = 2000u },
      .max_duration_ms = 90000u,
      .advance_on_achieved = false, .on = { { .event = CHOREO_EVENT_ACHIEVED, .goto_step_idx = 2u } }, .n_transitions = 1u, .indicator = SUBSTRATE_SIGNAL_ACTIVE, .telemetry_tag = "ring" },

    { .goal = { .type = CHOREO_GOAL_HOLD,
                .required_caps = CHOREO_CAP_LOCOMOTION },
      .max_duration_ms = 300000u,
      .advance_on_achieved = false, .on = { { .event = CHOREO_EVENT_ELEMENT_LOST, .goto_step_idx = 1u }, { .event = CHOREO_EVENT_ELEMENT_JOINED, .goto_step_idx = 1u } }, .n_transitions = 2u },
};

#endif /* TAPESTRY_CHOREO_SCRIPT_H */
```

## src/leak_script_search.c
```c
/*
 * leak_script_search.c — leak.choreo.toml for CONFIG_DEMO_LEAK_DUAL (see
 * leak_scripts.h).  choreo_leak.h is generated:
 *
 *   python3 tapestry/sdk/tools/choreoc.py \
 *       tapestry/examples/cutebot-formation/leak.choreo.toml \
 *       -o tapestry/examples/cutebot-formation/src/choreo_leak.h
 */

#include "choreo_leak.h"

/* main.c is compiled once for both scripts: they must agree on every
 * switch it reads from a script header. */
#if !defined(CHOREO_USES_DISCOVERY) || !defined(CHOREO_USES_LANDMARKS)
#error "both leak scripts must read finds as shared facts (see leak_scripts.h)"
#endif
#include "leak_scripts.h"

#if !defined(CHOREO_SCRIPT_LEN) || defined(CHOREO_N_TRACKS)
#error "choreo_leak.h must be a [[steps]] script"
#endif

const demo_script_t demo_script_leak = {
    .name             = CHOREO_NAME,
    .steps            = k_choreo_script,
    .n_steps          = CHOREO_SCRIPT_LEN,
    .total_timeout_ms = CHOREO_SCRIPT_TOTAL_TIMEOUT_MS,
};
```

## src/leak_script_sensor.c
```c
/*
 * leak_script_sensor.c — leak-sensor.choreo.toml for CONFIG_DEMO_LEAK_DUAL
 * (see leak_scripts.h).  The header is the one examples/leak-sensor ships,
 * so the robots and the sensor can never run different copies.
 */

#include "../../leak-sensor/src/choreo_script.h"

/* main.c is compiled once for both scripts: they must agree on every
 * switch it reads from a script header. */
#if !defined(CHOREO_USES_DISCOVERY) || !defined(CHOREO_USES_LANDMARKS)
#error "both leak scripts must read finds as shared facts (see leak_scripts.h)"
#endif
#include "leak_scripts.h"

#ifndef CHOREO_N_TRACKS
#error "the leak-sensor script must be a [[tracks]] script"
#endif

const demo_script_t demo_script_leak_sensor = {
    .name             = CHOREO_NAME,
    .tracks           = k_choreo_tracks,
    .n_tracks         = CHOREO_N_TRACKS,
    .total_timeout_ms = CHOREO_SCRIPT_TOTAL_TIMEOUT_MS,
};
```

## src/leak_scripts.h
```c
/*
 * leak_scripts.h — both leak demos in one firmware (CONFIG_DEMO_LEAK_DUAL)
 *
 * The robots carry leak.choreo.toml (search the board for the printed
 * marker) and leak-sensor.choreo.toml (wait for the stationary sensor's
 * button) and pick one at boot: leak-sensor if a stationary element was
 * heard during the start barrier, leak otherwise.  Showing the other demo
 * takes a power cycle, not a reflash.
 *
 * Each script's generated header defines the same names, so each lives in
 * its own translation unit (leak_script_search.c, leak_script_sensor.c)
 * and is reached through a demo_script_t.  Every compile-time switch
 * main.c reads from a script header has the same value in both, which is
 * what lets one firmware run either: the two .c files #error if that ever
 * stops being true.
 */

#ifndef LEAK_SCRIPTS_H
#define LEAK_SCRIPTS_H

#include <stdint.h>
#include <tapestry/choreo.h>

typedef struct {
    const char           *name;
    const choreo_step_t  *steps;     /* [[steps]] script, else NULL */
    uint8_t               n_steps;
    const choreo_track_t *tracks;    /* [[tracks]] script, else NULL */
    uint8_t               n_tracks;
    uint32_t              total_timeout_ms;
} demo_script_t;

extern const demo_script_t demo_script_leak;          /* leak.choreo.toml */
extern const demo_script_t demo_script_leak_sensor;   /* leak-sensor.choreo.toml */

/* Both scripts: finds become shared facts, one finder (main.c). */
#define CHOREO_USES_DISCOVERY 1u
#define CHOREO_USES_LANDMARKS 1u

#endif /* LEAK_SCRIPTS_H */
```
