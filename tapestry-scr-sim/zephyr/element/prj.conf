## CMakeLists.txt
```
cmake_minimum_required(VERSION 3.20.0)
find_package(Zephyr REQUIRED HINTS $ENV{ZEPHYR_BASE})
project(scr_element)

set(TAPESTRY_OS_ROOT  ${CMAKE_CURRENT_SOURCE_DIR}/../../../tapestry-os)
set(TAPESTRY_OS_CSM   ${TAPESTRY_OS_ROOT}/subsys/csm)
set(TAPESTRY_OS_SCR   ${TAPESTRY_OS_ROOT}/subsys/scr)
set(TAPESTRY_OS_BSE    ${TAPESTRY_OS_ROOT}/subsys/bse)
set(TAPESTRY_OS_CHOREO ${TAPESTRY_OS_ROOT}/subsys/choreo)
set(TAPESTRY_SDK      ${CMAKE_CURRENT_SOURCE_DIR}/../../../sdk)
set(TAPESTRY_CSM_SIM  ${CMAKE_CURRENT_SOURCE_DIR}/../../../tapestry-csm-sim)
set(CSM_ELEM_SRC      ${TAPESTRY_CSM_SIM}/zephyr/element/src)

target_sources(app PRIVATE
    src/main.c
    src/comms_scr.c
    ${CSM_ELEM_SRC}/comms.c        # L4 UDP transport: reused verbatim
    ${CSM_ELEM_SRC}/movement.c     # random walk + repulsion: reused verbatim
    ${TAPESTRY_OS_CSM}/world_model.c
    ${TAPESTRY_OS_CSM}/facts.c
    ${TAPESTRY_OS_SCR}/scr.c
    ${TAPESTRY_OS_BSE}/bse.c
    ${TAPESTRY_OS_CHOREO}/choreo.c
)

target_include_directories(app PRIVATE
    ${TAPESTRY_OS_ROOT}/include    # <tapestry/scr.h>, <tapestry/bse.h>
    ${TAPESTRY_SDK}/include        # <tapestry/choreo.h>
    ${TAPESTRY_OS_CSM}             # world_model.c; types via <tapestry/csm.h>
    ${CSM_ELEM_SRC}                # comms.h, movement.h (from csm element)
    ${TAPESTRY_CSM_SIM}            # sim_protocol.h
    src/                           # comms_scr.h
)

# Do not link -lm here: zephyr.elf is built as a relocatable (-r), which
# forces static libm and pulls in glibc ifunc resolvers that reference
# _dl_x86_cpu_features from ld.so — unavailable in native_sim's final link.
# The native_sim Makefile's FINALLINK_FLAGS already supplies -lm as shared
# libm, where sinf/cosf resolve cleanly at runtime.
```

## prj.conf
```kconfig
# ── Stack / heap ─────────────────────────────────────────────────────────────
CONFIG_MAIN_STACK_SIZE=8192

# ── Logging ───────────────────────────────────────────────────────────────────
CONFIG_LOG=y
CONFIG_LOG_DEFAULT_LEVEL=3
CONFIG_PRINTK=y

# ── Networking ────────────────────────────────────────────────────────────────
CONFIG_NETWORKING=y
CONFIG_NET_DRIVERS=y
CONFIG_NET_SOCKETS=y
CONFIG_NET_SOCKETS_OFFLOAD=y
CONFIG_NET_NATIVE_OFFLOADED_SOCKETS=y
CONFIG_NET_UDP=y
CONFIG_NET_IPV4=y

# ── Disable unused network subsystems to keep binary small ───────────────────
CONFIG_NET_TCP=n
CONFIG_NET_STATISTICS=n
CONFIG_NET_LOG=n

# ── Floating point ────────────────────────────────────────────────────────────
CONFIG_FPU=y
```

## src/main.c
```c
/*
 * main.c — Tapestry SCR simulation element entry point
 *
 * Runs both L4 (CSM) and L5 (SCR) on a Zephyr native_sim process.
 *
 * Environment variables:
 *   ELEMENT_ID        integer element ID [0..MAX_ELEMENTS)  default 0
 *   ORCH_PORT         orchestrator UDP port                  default 5100
 *   CONSISTENCY_BIAS  L4 AP/CP dial [0.0–1.0]               default 0.0
 *   QUORUM_MIN        SCR minimum fresh peers for DEGRADED   default 1
 *   QUORUM_TARGET     SCR minimum fresh peers for HEALTHY    default 2
 *
 * Main loop (WM_CYCLE_MS per iteration):
 *   1. comms_drain_inbox  — gossip + control messages
 *   2. wm_tick            — age L4 entries, recompute consistency
 *   3. scr_tick           — recompute role and quorum from wm snapshot
 *   4. Movement           — random walk + repulsion (if active and not degraded)
 *   5. wm_update_self     — always; keeps logical clock advancing
 *   6. choreo_tick        — synthesise per-element directive against fresh own state
 *   7. Send L4 gossip     — every GOSSIP_INTERVAL_MS
 *   8. Send L4 metric     — every cycle
 *   9. Send L5 SCR metric — every cycle
 *  10. k_msleep           — rest of cycle
 */

#include <zephyr/kernel.h>
#include <zephyr/logging/log.h>
#include <tapestry/scr.h>
#include <tapestry/choreo.h>
#include "movement.h"
#include "comms.h"
#include "comms_scr.h"
#include "sim_protocol.h"

LOG_MODULE_REGISTER(element, LOG_LEVEL_INF);

extern char   *getenv(const char *name);
extern int     atoi(const char *s);
extern double  atof(const char *s);

/* ── Helpers ─────────────────────────────────────────────────────────────── */

static int env_int(const char *name, int default_val)
{
    const char *v = getenv(name);
    return (v != NULL) ? atoi(v) : default_val;
}

static float env_float(const char *name, float default_val)
{
    const char *v = getenv(name);
    return (v != NULL) ? (float)atof(v) : default_val;
}

/* ── Main ────────────────────────────────────────────────────────────────── */

int main(void)
{
    const int   element_id       = env_int("ELEMENT_ID",        0);
    const int   orch_port        = env_int("ORCH_PORT",         SIM_ORCH_PORT);
    const float consistency_bias = env_float("CONSISTENCY_BIAS", 0.0f);
    const int   quorum_min       = env_int("QUORUM_MIN",        1);
    const int   quorum_target    = env_int("QUORUM_TARGET",     2);

    /* ── Initialize own state ──────────────────────────────────────────── */
    element_state_t own_state = {0};
    own_state.id               = (element_id_t)element_id;
    own_state.orientation      = orientation_identity();  /* no attitude sensing in sim */
    own_state.partition_island = 0;
    own_state.logical_clock    = 0;
    own_state.update_seq       = 0;
    own_state.position.x       = 10.0f + (float)((element_id * 17) % 80);
    own_state.position.y       = 10.0f + (float)((element_id * 23) % 80);

    LOG_INF("element %d starting at (%.1f, %.1f) bias=%.2f qmin=%d qtgt=%d",
            element_id,
            (double)own_state.position.x,
            (double)own_state.position.y,
            (double)consistency_bias,
            quorum_min, quorum_target);

    /* ── Initialize L4 world model ──────────────────────────────────────── */
    world_model_t wm;
    wm_init(&wm, own_state.id, &own_state, consistency_bias);

    /* ── Initialize L5 SCR ──────────────────────────────────────────────── */
    scr_state_t scr;
    scr_init(&scr, own_state.id,
             (uint8_t)quorum_min,
             (uint8_t)quorum_target,
             SCR_CAP_NONE);

    /* ── Initialize L7 choreo ───────────────────────────────────────────── */
    choreo_init(own_state.id);
    {
        choreo_goal_t goal = {
            .type   = CHOREO_GOAL_FORM,
            .target = { .x = 50.0f, .y = 50.0f },
            .radius = 30.0f,
            .shape  = TAPESTRY_BSE_SHAPE_CIRCLE,
        };
        choreo_submit_goal(&goal);
    }

    /* ── Initialize comms ───────────────────────────────────────────────── */
    comms_t comms;
    if (comms_init(&comms, own_state.id, (uint16_t)orch_port) != 0) {
        LOG_ERR("comms_init failed — aborting");
        return -1;
    }

    /* ── Main loop ──────────────────────────────────────────────────────── */
    uint32_t     gossip_accum_ms = 0;
    uint32_t     election_count  = 0;
    element_id_t last_leader     = ELEMENT_ID_INVALID;

    while (!comms.shutdown) {

        /* 1. Process inbound messages */
        comms_drain_inbox(&comms, &wm, &own_state);

        /* 2. Age L4 entries and recompute consistency */
        wm_tick(&wm, WM_CYCLE_MS);

        /* 3. Recompute L5 role and quorum */
        scr_tick(&scr, &wm);

        /* Track leadership changes for election_count telemetry */
        if (scr.leader_id != last_leader) {
            if (last_leader != ELEMENT_ID_INVALID ||
                scr.leader_id != ELEMENT_ID_INVALID) {
                election_count++;
            }
            last_leader = scr.leader_id;
        }

        /* 4. Update position — only when active and L4 not frozen. */
        const wm_consistency_metric_t *metric = wm_get_metric(&wm);
        if (!metric->degraded) {
            movement_tick(&own_state, &wm);
        }
        wm_update_self(&wm, &own_state);

        /* 5. Choreo tick — synthesise per-element directive against fresh own state */
        choreo_tick(&wm, &scr);
        choreo_publish_state(&own_state);

        /* 6. Send gossip on interval */
        gossip_accum_ms += WM_CYCLE_MS;
        if (gossip_accum_ms >= GOSSIP_INTERVAL_MS) {
            comms_send_gossip(&comms, &own_state);
            gossip_accum_ms = 0;
        }

        /* 7. Send L4 consistency metric every cycle */
        comms_send_metric(&comms, &wm, own_state.id);

        /* 8. Send L5 SCR metric every cycle */
        comms_send_scr_metric(&comms, &scr, election_count);

        /* 9. Sleep for the rest of the cycle */
        k_msleep(WM_CYCLE_MS);
    }

    LOG_INF("element %d shutting down (leader was %d, elections: %u)",
            element_id, last_leader, election_count);
    return 0;
}
```

## src/comms_scr.c
```c
/*
 * comms_scr.c — SCR metric transmission (L5 extension to L4 comms)
 */

#include "comms_scr.h"

#include <string.h>
#include <zephyr/net/socket.h>
#include <zephyr/logging/log.h>

LOG_MODULE_DECLARE(element, LOG_LEVEL_INF);

/* Static TX buffer — single-threaded; no concurrency. */
static uint8_t scr_tx_buf[TAPESTRY_MSG_HEADER_SIZE + TAPESTRY_SCR_METRIC_FRAME_SIZE];

void comms_send_scr_metric(const comms_t *c,
                           const scr_state_t *scr,
                           uint32_t election_count)
{
    /* ── Header ──────────────────────────────────────────────────────────── */
    tapestry_msg_header_t *hdr = (tapestry_msg_header_t *)scr_tx_buf;
    hdr->version     = TAPESTRY_WIRE_VERSION;
    hdr->type        = (uint8_t)TAPESTRY_MSG_SCR_METRIC;
    hdr->src_id      = scr->own_id;
    hdr->payload_len = (uint16_t)TAPESTRY_SCR_METRIC_FRAME_SIZE;

    /* ── Payload ─────────────────────────────────────────────────────────── */
    tapestry_scr_metric_frame_t *p =
        (tapestry_scr_metric_frame_t *)(scr_tx_buf + TAPESTRY_MSG_HEADER_SIZE);

    p->element_id     = scr->own_id;
    p->role           = (uint8_t)scr->role;
    p->leader_id      = scr->leader_valid ? scr->leader_id : ELEMENT_ID_INVALID;
    p->quorum_state   = (uint8_t)scr->quorum_state;
    p->fresh_count    = scr->fresh_count;
    p->task_slot      = scr->task_slot;
    p->election_count = election_count;

    /* ── Send ────────────────────────────────────────────────────────────── */
    struct sockaddr_in dst = {
        .sin_family = AF_INET,
        .sin_port   = htons(c->orch_port),
    };
    zsock_inet_pton(AF_INET, SIM_LOOPBACK_ADDR, &dst.sin_addr);

    int sent = zsock_sendto(c->sock, scr_tx_buf,
                            sizeof(scr_tx_buf), 0,
                            (struct sockaddr *)&dst, sizeof(dst));
    if (sent < 0) {
        LOG_ERR("comms_send_scr_metric failed: %d", sent);
    }
}
```

## src/comms_scr.h
```c
/*
 * comms_scr.h — SCR metric transmission
 *
 * Thin extension to the L4 comms layer (comms.h from tapestry-csm-sim).
 * Adds one function that serializes the SCR state snapshot and sends it
 * to the orchestrator as a SIM_MSG_SCR_METRIC datagram.
 */

#ifndef TAPESTRY_COMMS_SCR_H
#define TAPESTRY_COMMS_SCR_H

#include <stdint.h>
#include "comms.h"           /* comms_t — resolves to csm-sim comms.h */
#include <tapestry/scr.h>    /* scr_state_t                            */
#include "sim_protocol.h"    /* SIM_LOOPBACK_ADDR                      */
#include <tapestry/wire.h>   /* tapestry_scr_metric_frame_t, TAPESTRY_MSG_SCR_METRIC */

/*
 * comms_send_scr_metric — Serialize scr_state and election_count as a
 * TAPESTRY_MSG_SCR_METRIC datagram and send to the orchestrator.
 */
void comms_send_scr_metric(const comms_t *c,
                           const scr_state_t *scr,
                           uint32_t election_count);

#endif /* TAPESTRY_COMMS_SCR_H */
```
