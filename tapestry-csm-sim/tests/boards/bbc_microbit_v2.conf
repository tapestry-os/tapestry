## tapestry-csm-sim/tests/boards/bbc_microbit_v2.conf
```kconfig
# Board overlay for BBC micro:bit V2 (nRF52833 / Cortex-M4F)
#
# The nRF52833 has an FPU but Zephyr does not enable it by default for this
# board.  world_model.c uses sqrtf/fabsf, so explicit enablement is required.
# FPU_SHARING is needed because the Zephyr scheduler must save/restore FPU
# registers on context switches when more than one thread uses the FPU.
# Stack sizes match the ESP32 overlay: world_model_t structs on the stack.

CONFIG_FPU=y
CONFIG_FPU_SHARING=y
CONFIG_ZTEST_STACK_SIZE=4096
CONFIG_MAIN_STACK_SIZE=4096
```

## tapestry-csm-sim/tests/boards/ek_ra8d1.conf
```kconfig
# Board overlay for Renesas EK-RA8D1 (Cortex-M85)
#
# The RA8D1 SoC Kconfig selects FPU automatically — no explicit
# CONFIG_FPU=y needed.  Stack sizes are bumped from the 1 KiB ztest
# default for the same reason as the ESP32 overlay: test functions
# allocate world_model_t structs on the stack.

CONFIG_ZTEST_STACK_SIZE=4096
CONFIG_MAIN_STACK_SIZE=4096
```

## tapestry-csm-sim/tests/boards/esp_wrover_kit_esp32_procpu.conf
```kconfig
# Board overlay for ESP-WROVER-KIT (ESP32 procpu)
#
# The ESP32 SoC selects CPU_HAS_FPU but does not auto-enable the FPU
# coprocessor — world_model.c uses sqrtf/fabsf so we must enable it.
# Stack sizes are bumped from the 1 KiB ztest default: test functions
# allocate one or two world_model_t structs on the stack (~500 bytes
# each) so 1 KiB overflows; 4 KiB gives comfortable headroom.

CONFIG_FPU=y
CONFIG_ZTEST_STACK_SIZE=4096
CONFIG_MAIN_STACK_SIZE=4096
CONFIG_ESP32_USE_UNSUPPORTED_REVISION=y
```

## tapestry-os/dts/bindings/tapestry-harvester.yaml
```yaml
# tapestry,harvester — Tapestry energy-harvester hardware descriptor
#
# To use this binding, expose its directory to the DTC by adding the
# following to the consuming application's CMakeLists.txt:
#
#   list(APPEND DTS_EXTRA_BINDINGS ${TAPESTRY_OS_ROOT}/dts/bindings)
#
# Board overlay example for a photovoltaic harvester:
#
#   / {
#       harvester0: harvester {
#           compatible = "tapestry,harvester";
#           harvest-source = "pv";
#           min-voltage-mv = <1800>;
#           threshold-gpios = <&gpio0 4 GPIO_ACTIVE_HIGH>;
#       };
#   };
#
#   /* The threshold pin must be a Zephyr wakeup source so the system
#    * can exit PM_STATE_SOFT_OFF when the harvester is charged. */
#   / {
#       aliases { wakeup0 = &harvest_wake; };
#       harvest_wake: harvest-wake {
#           compatible = "gpio-keys";
#           harvest-key { gpios = <&gpio0 4 GPIO_ACTIVE_HIGH>;
#                         zephyr,wakeup-source; };
#       };
#   };
#
# L1 substrate_set_power(SUBSTRATE_POWER_HARVEST) implementation sketch:
#
#   const struct gpio_dt_spec thr =
#       GPIO_DT_SPEC_GET(DT_NODELABEL(harvester0), threshold_gpios);
#   gpio_pin_configure_dt(&thr, GPIO_INPUT);
#   gpio_pin_interrupt_configure_dt(&thr, GPIO_INT_EDGE_RISING);
#   pm_state_force(0, &(struct pm_state_info){
#       .state = PM_STATE_SOFT_OFF });
#   /* Execution resumes here after reset on nRF52833 SOFT_OFF wake. */

description: |
  Tapestry energy-harvester hardware descriptor.

  Describes a passive energy source (photovoltaic, RF, or thermoelectric).
  The harvester is a power source, not a Zephyr PM device; it is NOT managed
  via pm_device_runtime_get/put (those are for power consumers, not sources).

  The threshold-gpios property references a GPIO driven by the charge
  controller's PGOOD or voltage-comparator output.  That GPIO must be
  configured as a Zephyr wakeup source in the board overlay so that the
  system can exit PM_STATE_SOFT_OFF when the harvested voltage crosses
  min-voltage-mv.

  The L1 substrate implementation (substrate_set_power) reads these
  properties to arm the wake source before entering PM_STATE_SOFT_OFF when
  SUBSTRATE_POWER_HARVEST is requested by L2.

compatible: "tapestry,harvester"

properties:
  harvest-source:
    type: string
    required: true
    enum:
      - "rf"
      - "pv"
      - "thermal"
    description: Energy source type (RF, photovoltaic, or thermoelectric).

  min-voltage-mv:
    type: int
    required: true
    description: |
      Minimum harvested voltage (mV) at which the element may resume
      operation.  The threshold-gpios output should assert at this level.

  threshold-gpios:
    type: phandle-array
    required: false
    description: |
      GPIO driven by the charge controller threshold or PGOOD output.
      Asserts when the harvested voltage has reached min-voltage-mv.
      This pin must also carry zephyr,wakeup-source in the board overlay
      so the system can exit PM_STATE_SOFT_OFF when harvest is ready.
```

## tapestry-os/subsys/runtime/Kconfig
```kconfig
# Kconfig — Tapestry L2 Element Runtime
#
# Source this from your application Kconfig with:
#   rsource "../tapestry-os/subsys/runtime/Kconfig"

config TAPESTRY_POWER_AUTO_POLICY
	bool "Automatic power stepping on quorum loss"
	default n
	help
	  When enabled, L2 automatically steps the element from ACTIVE to IDLE
	  after CONFIG_TAPESTRY_POWER_SLEEP_GRACE_CYCLES consecutive ticks with
	  SCR_QUORUM_LOST.  The element steps back to ACTIVE immediately when
	  quorum recovers to DEGRADED or HEALTHY.

config TAPESTRY_POWER_SLEEP_GRACE_CYCLES
	int "Cycles before auto-idle on quorum loss"
	depends on TAPESTRY_POWER_AUTO_POLICY
	default 50
	help
	  Number of consecutive SCR_QUORUM_LOST ticks before L2 steps the
	  element to IDLE power.  At WM_CYCLE_MS = 100 ms, the default of 50
	  equals 5 seconds of isolation before power is reduced.
```

## tapestry-scr-hw/boards/ek_ra8d1.conf
```kconfig
# Board overlay for Renesas EK-RA8D1 (RA8D1 / Cortex-M85)
# Element 1 in the Phase 2 swarm.
#
# FPU is auto-enabled by the RA8D1 SoC Kconfig.
# The Ethernet driver (ETH_RENESAS_RA) is auto-enabled by the board DTS.

# ── Networking ────────────────────────────────────────────────────────────────
CONFIG_NETWORKING=y
CONFIG_NET_SOCKETS=y
CONFIG_NET_UDP=y
CONFIG_NET_IPV4=y
CONFIG_NET_TCP=n
CONFIG_NET_STATISTICS=n
CONFIG_NET_LOG=n
CONFIG_NET_DHCPV4=y
CONFIG_NET_PKT_RX_COUNT=16
CONFIG_NET_PKT_TX_COUNT=16
CONFIG_NET_BUF_RX_COUNT=32
CONFIG_NET_BUF_TX_COUNT=32

# ── Ethernet L2 ───────────────────────────────────────────────────────────────
CONFIG_NET_L2_ETHERNET=y
CONFIG_NET_ARP=y

# ── Element identity ──────────────────────────────────────────────────────────
CONFIG_TAPESTRY_ELEMENT_ID=1
```

## west.yml
```yaml
manifest:
  # Tapestry lives at <workspace>/tapestry/ within a west workspace.
  # To initialise a fresh workspace:
  #
  #   west init -m https://github.com/<org>/tapestry --mr main tapestry-workspace
  #   cd tapestry-workspace
  #   west update
  #
  self:
    path: tapestry

  projects:
    - name: zephyr
      url: https://github.com/zephyrproject-rtos/zephyr
      revision: v4.4.0-rc1
      import: true   # pulls in Zephyr's own manifest (HAL modules, etc.)
```
