## tapestry-os/boards/crazyflie21br/Kconfig
```kconfig
# Kconfig — Crazyflie 2.1 brushless board module options
#
# Source from your application Kconfig (after "source Kconfig.zephyr"):
#   rsource "../tapestry-os/boards/crazyflie21br/Kconfig"

config CF21_STABILIZER
	bool "Cascaded attitude controller (rate loop + optional angle loop)"
	depends on BOARD_CRAZYFLIE21BR && FPU
	default n
	help
	  Enables cf21_stabilizer.c: a ~1 kHz PID stabilizer thread slaved to
	  the BMI088 INT3 data-ready interrupt.  substrate_move() becomes a
	  setpoint setter; the stabilizer drives motors independently.

	  Requires adding to CMakeLists.txt (inside if(CONFIG_PWM)):
	    if(CONFIG_CF21_STABILIZER)
	      target_sources(app PRIVATE
	        ${TAPESTRY_OS_BOARDS}/crazyflie21br/cf21_stabilizer.c
	        ${TAPESTRY_OS_BOARDS}/crazyflie21br/cf21_imu.c)
	    endif()

if CF21_STABILIZER

config CF21_ANGLE_MODE
	bool "Enable outer angle-error P loop (self-leveling)"
	default n
	help
	  Adds a P controller on roll/pitch angle error above the rate loop,
	  reading from the complementary filter (cf21_imu_filter_update).
	  substrate_move() angular.x/y become roll/pitch angle setpoints
	  (scaled to ±30 degrees) rather than rate setpoints.
	  angular.z remains a yaw rate setpoint in both modes.

endif # CF21_STABILIZER
```

## tapestry-os/dts/bindings/bitcraze,cf21-motors.yaml
```yaml
description: |
  Bitcraze Crazyflie 2.1 brushless motor PWM channels.

  Four PWM entries in order M1 (front-right CCW), M2 (back-right CCW),
  M3 (back-left CW), M4 (front-left CW).  All channels share one STM32
  TIM2 PWM device.  Period is 2 500 000 ns (400 Hz RC PWM).

compatible: "bitcraze,cf21-motors"

properties:
  pwms:
    type: phandle-array
    required: true
    description: Four PWM channels M1..M4 (one STM32 timer, channels 1-4).
```

## tapestry-scr-hw/boards/bitcraze/crazyflie21/board.yml
```yaml
board:
  name: crazyflie21
  full_name: Bitcraze Crazyflie 2.1 Brushless
  vendor: bitcraze
  socs:
    - name: stm32f405xx
```

## tapestry-scr-hw/boards/bitcraze/crazyflie21bl/board.yml
```yaml
board:
  name: crazyflie21bl
  full_name: Bitcraze Crazyflie 2.1 Brushless
  vendor: bitcraze
  socs:
    - name: stm32f405xx
```

## tapestry-scr-hw/boards/bitcraze/crazyflie21br/board.yml
```yaml
board:
  name: crazyflie21br
  full_name: Bitcraze Crazyflie 2.1 Brushless
  vendor: bitcraze
  socs:
    - name: stm32f405xx
```
