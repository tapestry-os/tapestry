## CMakeLists.txt
```
cmake_minimum_required(VERSION 3.20.0)
find_package(Zephyr REQUIRED HINTS $ENV{ZEPHYR_BASE})
project(tapestry_element)

set(TAPESTRY_OS_ROOT ${CMAKE_CURRENT_SOURCE_DIR}/../../../tapestry-os)
set(TAPESTRY_OS_CSM  ${TAPESTRY_OS_ROOT}/subsys/csm)

target_sources(app PRIVATE
    ${TAPESTRY_OS_CSM}/world_model.c
    ${TAPESTRY_OS_CSM}/facts.c
    src/movement.c
    src/comms.c
    src/main.c
)

target_include_directories(app PRIVATE
    ${TAPESTRY_OS_ROOT}/include   # <tapestry/csm.h>
    ${TAPESTRY_OS_CSM}            # world_model.c; types via <tapestry/csm.h>
    src                           # movement.h, comms.h
    ../..                         # sim_protocol.h
)

target_link_libraries(app PRIVATE m)
```

## prj.conf
```kconfig
# ── Stack / heap ─────────────────────────────────────────────────────────────
CONFIG_MAIN_STACK_SIZE=8192

# ── Logging ───────────────────────────────────────────────────────────────────
CONFIG_LOG=y
CONFIG_LOG_DEFAULT_LEVEL=3
CONFIG_PRINTK=y

# ── Networking ────────────────────────────────────────────────────────────────
# Uses CONFIG_NET_NATIVE_OFFLOADED_SOCKETS so that Zephyr's BSD socket calls
# map directly to host OS socket calls.  No TAP interface or root required.
# Notes for Zephyr 4.x:
#   - NET_SOCKETS_POSIX_NAMES was removed; POSIX names are implicit with NET_SOCKETS.
#   - NET_NATIVE_OFFLOADED_SOCKETS depends on NET_DRIVERS — must be set explicitly.
CONFIG_NETWORKING=y
CONFIG_NET_DRIVERS=y
CONFIG_NET_SOCKETS=y
CONFIG_NET_SOCKETS_OFFLOAD=y
CONFIG_NET_NATIVE_OFFLOADED_SOCKETS=y
CONFIG_NET_UDP=y
CONFIG_NET_IPV4=y

# ── Disable unused network subsystems to keep binary small ───────────────────
CONFIG_NET_TCP=n
CONFIG_NET_STATISTICS=n
CONFIG_NET_LOG=n

# ── Floating point ────────────────────────────────────────────────────────────
CONFIG_FPU=y
```

## src/main.c
```c
/*
 * main.c — Tapestry element entry point
 *
 * Reads configuration from environment variables (native_sim runs as a
 * Linux host process, so host libc getenv is available):
 *
 *   ELEMENT_ID    integer element ID [0..MAX_ELEMENTS)  default 0
 *   ORCH_PORT     orchestrator UDP port                  default SIM_ORCH_PORT
 *
 * The element port is always SIM_ELEMENT_BASE_PORT + ELEMENT_ID.
 *
 * Main loop (WM_CYCLE_MS per iteration):
 *   1. Drain inbox   — gossip + control messages from orchestrator
 *   2. wm_tick       — age entries, recompute consistency metric
 *   3. Movement      — random walk + repulsion (skipped if degraded)
 *   4. wm_update_self
 *   5. Send gossip   — every GOSSIP_INTERVAL_MS
 *   6. Send metric   — every cycle
 *   7. k_msleep      — rest of the cycle period
 */

#include <zephyr/kernel.h>
#include <zephyr/logging/log.h>
#include <tapestry/csm.h>
#include "movement.h"
#include "comms.h"
#include "sim_protocol.h"

LOG_MODULE_REGISTER(element, LOG_LEVEL_INF);

/* native_sim is a Linux process — host libc getenv is accessible */
extern char   *getenv(const char *name);
extern int     atoi(const char *s);
extern double  atof(const char *s);

/* ── Helpers ─────────────────────────────────────────────────────────────── */

static int env_int(const char *name, int default_val)
{
    const char *v = getenv(name);
    return (v != NULL) ? atoi(v) : default_val;
}

static float env_float(const char *name, float default_val)
{
    const char *v = getenv(name);
    return (v != NULL) ? (float)atof(v) : default_val;
}

/* ── Main ────────────────────────────────────────────────────────────────── */

int main(void)
{
    const int   element_id        = env_int("ELEMENT_ID",        0);
    const int   orch_port         = env_int("ORCH_PORT",         SIM_ORCH_PORT);
    const float consistency_bias  = env_float("CONSISTENCY_BIAS", 0.0f);

    /* ---- Initialize own state ------------------------------------------ */
    element_state_t own_state = {0};
    own_state.id               = (element_id_t)element_id;
    own_state.orientation      = orientation_identity();  /* no attitude sensing in sim */
    own_state.partition_island = 0;
    own_state.logical_clock    = 0;
    own_state.update_seq       = 0;

    /* Spread initial positions deterministically so elements don't start
     * on top of each other.  The multipliers are chosen to distribute
     * 20 elements reasonably across the 100×100 world. */
    own_state.position.x = 10.0f + (float)((element_id * 17) % 80);
    own_state.position.y = 10.0f + (float)((element_id * 23) % 80);

    LOG_INF("element %d starting at (%.1f, %.1f)",
            element_id,
            (double)own_state.position.x,
            (double)own_state.position.y);

    /* ---- Initialize world model --------------------------------------- */
    world_model_t wm;
    wm_init(&wm, own_state.id, &own_state, consistency_bias);

    /* ---- Initialize comms --------------------------------------------- */
    comms_t comms;
    if (comms_init(&comms, own_state.id, (uint16_t)orch_port) != 0) {
        LOG_ERR("comms_init failed — aborting");
        return -1;
    }

    /* ---- Main loop ---------------------------------------------------- */
    uint32_t gossip_accum_ms = 0;

    while (!comms.shutdown) {

        /* 1. Process any messages that arrived since the last cycle */
        comms_drain_inbox(&comms, &wm, &own_state);

        /* 2. Age world model entries and recompute consistency metric */
        wm_tick(&wm, WM_CYCLE_MS);

        /* 3. Update position (only when active and not CP-frozen) */
        const wm_consistency_metric_t *metric = wm_get_metric(&wm);

        if (!metric->degraded) {
            movement_tick(&own_state, &wm);
        }
        wm_update_self(&wm, &own_state);

        /* 4. Send gossip on interval */
        gossip_accum_ms += WM_CYCLE_MS;
        if (gossip_accum_ms >= GOSSIP_INTERVAL_MS) {
            comms_send_gossip(&comms, &own_state);
            gossip_accum_ms = 0;
        }

        /* 5. Send consistency metric every cycle */
        comms_send_metric(&comms, &wm, own_state.id);

        /* 6. Sleep for the rest of the cycle */
        k_msleep(WM_CYCLE_MS);
    }

    LOG_INF("element %d shutting down", element_id);
    return 0;
}
```

## src/comms.c
```c
/*
 * comms.c — UDP communication between element and orchestrator
 */

#include <errno.h>
#include <string.h>
#include <zephyr/net/socket.h>
#include <zephyr/net/net_ip.h>
#include <zephyr/logging/log.h>
#include "comms.h"
#include "sim_protocol.h"
#include <tapestry/wire.h>

LOG_MODULE_REGISTER(comms, LOG_LEVEL_INF);

/* Scratch buffers — single-threaded main loop, no concurrency concern */
static uint8_t tx_buf[TAPESTRY_MAX_MSG_SIZE];
static uint8_t rx_buf[TAPESTRY_MAX_MSG_SIZE];

/* ── Internal helpers ────────────────────────────────────────────────────── */

static void make_addr(struct sockaddr_in *addr, uint16_t port)
{
    memset(addr, 0, sizeof(*addr));
    addr->sin_family = AF_INET;
    addr->sin_port   = htons(port);
    zsock_inet_pton(AF_INET, SIM_LOOPBACK_ADDR, &addr->sin_addr);
}

/* ── API ─────────────────────────────────────────────────────────────────── */

int comms_init(comms_t *c, element_id_t element_id, uint16_t orch_port)
{
    c->own_port  = (uint16_t)(SIM_ELEMENT_BASE_PORT + element_id);
    c->orch_port = orch_port;
    c->shutdown  = false;

    c->sock = zsock_socket(AF_INET, SOCK_DGRAM, IPPROTO_UDP);
    if (c->sock < 0) {
        LOG_ERR("zsock_socket() failed: %d", errno);
        return -1;
    }

    struct sockaddr_in bind_addr;
    make_addr(&bind_addr, c->own_port);

    if (zsock_bind(c->sock, (struct sockaddr *)&bind_addr,
                   sizeof(bind_addr)) < 0) {
        LOG_ERR("zsock_bind() on port %u failed: %d", c->own_port, errno);
        zsock_close(c->sock);
        return -1;
    }

    LOG_INF("comms ready — own port %u, orch port %u",
            c->own_port, c->orch_port);
    return 0;
}

void comms_send_gossip(const comms_t *c, const element_state_t *own_state)
{
    tapestry_msg_header_t *hdr = (tapestry_msg_header_t *)tx_buf;
    hdr->version     = TAPESTRY_WIRE_VERSION;
    hdr->type        = TAPESTRY_MSG_GOSSIP;
    hdr->src_id      = own_state->id;
    hdr->payload_len = TAPESTRY_GOSSIP_FRAME_SIZE;

    tapestry_gossip_frame_t *p =
        (tapestry_gossip_frame_t *)(tx_buf + TAPESTRY_MSG_HEADER_SIZE);
    p->id            = own_state->id;
    p->x             = own_state->position.x;
    p->y             = own_state->position.y;
    p->z             = own_state->position.z;
    p->qw            = own_state->orientation.w;
    p->qx            = own_state->orientation.x;
    p->qy            = own_state->orientation.y;
    p->qz            = own_state->orientation.z;
    p->logical_clock = own_state->logical_clock;
    p->update_seq    = own_state->update_seq;
    p->energy_level  = own_state->energy_level;
    p->health_flags  = own_state->health_flags;
    p->relay_qos     = TAPESTRY_PACK_RELAY_QOS(0u, TAPESTRY_QOS_SOFT_RT);
                             /* hop_count=0: relay not used in sim */
    p->achieved      = own_state->goal_achieved ? 1u : 0u;
    p->version       = TAPESTRY_WIRE_VERSION;

    struct sockaddr_in orch_addr;
    make_addr(&orch_addr, c->orch_port);

    zsock_sendto(c->sock, tx_buf,
                 TAPESTRY_MSG_HEADER_SIZE + TAPESTRY_GOSSIP_FRAME_SIZE, 0,
                 (struct sockaddr *)&orch_addr, sizeof(orch_addr));
}

void comms_send_metric(const comms_t *c, const world_model_t *wm,
                       element_id_t element_id)
{
    const wm_consistency_metric_t *m = wm_get_metric(wm);

    /* ── Compute mean_age_ms and min_separation from world model ── */
    float    age_sum         = 0.0f;
    uint8_t  age_count       = 0;
    float    min_sep         = WORLD_SIZE * 2.0f;   /* sentinel > any real dist */
    bool     any_active_peer = false;

    const wm_entry_t *self_entry = wm_get_entry(wm, element_id);

    for (int i = 0; i < MAX_ELEMENTS; i++) {
        const wm_entry_t *e = &wm->entries[i];
        if (e->state.id == ELEMENT_ID_INVALID || e->is_self || !e->is_active) {
            continue;
        }
        age_sum += (float)e->age_ms;
        age_count++;
        any_active_peer = true;

        if (self_entry != NULL) {
            float d = position_distance(&self_entry->state.position,
                                        &e->state.position);
            if (d < min_sep) {
                min_sep = d;
            }
        }
    }

    float mean_age = (age_count > 0) ? (age_sum / (float)age_count) : 0.0f;
    /* Encode min_separation as uint16 at 0.01 unit resolution.
     * If no active peers exist keep sentinel value 0xFFFF so the
     * visualizer can distinguish "no peers" from "peers at distance 0". */
    uint16_t min_sep_enc = any_active_peer
                           ? (uint16_t)(min_sep * 100.0f)
                           : 0xFFFFu;

    /* ── Pack and send ── */
    tapestry_msg_header_t *hdr = (tapestry_msg_header_t *)tx_buf;
    hdr->version     = TAPESTRY_WIRE_VERSION;
    hdr->type        = TAPESTRY_MSG_METRIC;
    hdr->src_id      = element_id;
    hdr->payload_len = TAPESTRY_METRIC_FRAME_SIZE;

    tapestry_metric_frame_t *p =
        (tapestry_metric_frame_t *)(tx_buf + TAPESTRY_MSG_HEADER_SIZE);
    p->element_id           = element_id;
    p->active_total         = m->active_total;
    p->active_fresh         = m->active_fresh;
    p->active_stale         = m->active_stale;
    p->inactive_total       = m->inactive_total;
    p->collision_count      = m->collision_count;
    p->fresh_ratio          = m->fresh_ratio;
    p->quorum_held          = m->quorum_held ? 1u : 0u;
    p->degraded             = m->degraded    ? 1u : 0u;
    p->confidence           = m->confidence;
    p->cycle_count          = wm->cycle_count;
    p->mean_age_ms          = mean_age;
    p->mean_position_error  = 0.0f;   /* filled by orchestrator */
    p->min_separation_x100  = min_sep_enc;

    struct sockaddr_in orch_addr;
    make_addr(&orch_addr, c->orch_port);

    zsock_sendto(c->sock, tx_buf,
                 TAPESTRY_MSG_HEADER_SIZE + TAPESTRY_METRIC_FRAME_SIZE, 0,
                 (struct sockaddr *)&orch_addr, sizeof(orch_addr));
}

int comms_drain_inbox(comms_t *c, world_model_t *wm,
                      element_state_t *own_state)
{
    int processed = 0;

    for (;;) {
        ssize_t len = zsock_recv(c->sock, rx_buf, sizeof(rx_buf),
                                  ZSOCK_MSG_DONTWAIT);
        if (len < 0) {
            if (errno == EAGAIN || errno == EWOULDBLOCK) {
                break;   /* inbox empty */
            }
            LOG_WRN("recv error: %d", errno);
            break;
        }

        if (len < (ssize_t)TAPESTRY_MSG_HEADER_SIZE) {
            continue;   /* too short to be a valid message */
        }

        const tapestry_msg_header_t *hdr = (const tapestry_msg_header_t *)rx_buf;
        const uint8_t *payload           = rx_buf + TAPESTRY_MSG_HEADER_SIZE;

        if (hdr->version != TAPESTRY_WIRE_VERSION) {
            /* Reject rather than risk misinterpreting bytes laid out under
             * a different schema.  Rate-limited: a peer/orchestrator on the
             * wrong version stays wrong every cycle, not just once. */
            static uint32_t mismatch_count;
            if ((++mismatch_count % 20u) == 1u) {
                LOG_WRN("wire version mismatch: src=%u wire=%u (%u frames)",
                        hdr->src_id, hdr->version, mismatch_count);
            }
            continue;
        }

        switch ((sim_msg_type_t)hdr->type) {

        case SIM_MSG_GOSSIP: {
            if (len < (ssize_t)(TAPESTRY_MSG_HEADER_SIZE + TAPESTRY_GOSSIP_FRAME_SIZE)) {
                break;
            }
            const tapestry_gossip_frame_t *g =
                (const tapestry_gossip_frame_t *)payload;

            element_state_t received = {0};
            received.id            = g->id;
            received.position.x    = g->x;
            received.position.y    = g->y;
            received.logical_clock = g->logical_clock;
            received.update_seq    = g->update_seq;
            received.energy_level  = g->energy_level;
            received.health_flags  = g->health_flags;
            received.goal_achieved = (g->achieved != 0);

            wm_receive_gossip(wm, &received);
            break;
        }

        case SIM_MSG_CONTROL: {
            if (len < (ssize_t)(TAPESTRY_MSG_HEADER_SIZE + SIM_CTRL_SIZE)) {
                break;
            }
            const sim_ctrl_payload_t *ctrl =
                (const sim_ctrl_payload_t *)payload;

            switch ((sim_ctrl_type_t)ctrl->ctrl_type) {
            case SIM_CTRL_SET_PARTITION:
                own_state->partition_island = ctrl->value;
                LOG_INF("partition island → %u", ctrl->value);
                break;
            case SIM_CTRL_SET_POWER:
                LOG_INF("SIM_CTRL_SET_POWER ignored — power is now L2's concern");
                break;
            case SIM_CTRL_SHUTDOWN:
                LOG_INF("shutdown requested by orchestrator");
                c->shutdown = true;
                break;
            }
            break;
        }

        default:
            break;   /* ignore unknown types */
        }

        processed++;
    }

    return processed;
}
```

## src/comms.h
```c
/*
 * comms.h — UDP communication between element and orchestrator
 *
 * Each element owns one UDP socket:
 *   bind:  127.0.0.1 : (SIM_ELEMENT_BASE_PORT + element_id)
 *   send:  127.0.0.1 : SIM_ORCH_PORT   (gossip + metrics → orchestrator)
 *   recv:  own port                     (gossip routed back + control msgs)
 *
 * Uses Zephyr's BSD socket API with CONFIG_NET_NATIVE_OFFLOADED_SOCKETS,
 * which maps directly to host OS socket calls on native_sim — no TAP
 * interface or elevated privileges required.
 */

#ifndef TAPESTRY_COMMS_H
#define TAPESTRY_COMMS_H

#include <stdbool.h>
#include <stdint.h>
#include <tapestry/csm.h>

typedef struct {
    int      sock;        /* UDP socket fd                          */
    uint16_t own_port;    /* SIM_ELEMENT_BASE_PORT + element_id     */
    uint16_t orch_port;   /* orchestrator receive port              */
    bool     shutdown;    /* set by comms_drain_inbox on SIM_CTRL_SHUTDOWN */
} comms_t;

/*
 * comms_init — Create and bind the UDP socket.
 * Returns 0 on success, -1 on failure (logs the error).
 */
int comms_init(comms_t *c, element_id_t element_id, uint16_t orch_port);

/*
 * comms_send_gossip — Serialize own_state as SIM_MSG_GOSSIP and send to orch.
 */
void comms_send_gossip(const comms_t *c, const element_state_t *own_state);

/*
 * comms_send_metric — Serialize the world model's current metric as
 * SIM_MSG_METRIC and send to orch.
 */
void comms_send_metric(const comms_t *c, const world_model_t *wm,
                       element_id_t element_id);

/*
 * comms_drain_inbox — Non-blocking receive loop.
 * Processes all pending inbound datagrams:
 *   SIM_MSG_GOSSIP  → wm_receive_gossip(wm, …)
 *   SIM_MSG_CONTROL → update own_state (partition island) or set c->shutdown
 * Returns the number of messages processed.
 */
int comms_drain_inbox(comms_t *c, world_model_t *wm,
                      element_state_t *own_state);

#endif /* TAPESTRY_COMMS_H */
```

## src/movement.c
```c
/*
 * movement.c — Tapestry element position update
 */

#include <math.h>
#include <zephyr/random/random.h>
#include "movement.h"

/* ── Internal helpers ────────────────────────────────────────────────────── */

/*
 * rand_float_11 — Return a float in [-1.0, 1.0] using Zephyr's PRNG.
 * Uses the lower 16 bits of sys_rand32_get() for speed.
 */
static float rand_float_11(void)
{
    uint32_t r = sys_rand32_get() & 0xFFFF;
    return ((float)r / 32767.5f) - 1.0f;
}

/* ── API ─────────────────────────────────────────────────────────────────── */

void movement_tick(element_state_t *own_state, const world_model_t *wm)
{
    /* 1. Random walk: independent x/y deltas in [-WALK_STEP_MAX, WALK_STEP_MAX] */
    float dx = rand_float_11() * WALK_STEP_MAX;
    float dy = rand_float_11() * WALK_STEP_MAX;

    /* 2. Repulsion from peers within REPULSION_RADIUS */
    element_id_t near_ids[MAX_ELEMENTS];
    uint8_t near_count = wm_nearest_elements(wm,
                                              &own_state->position,
                                              REPULSION_RADIUS,
                                              near_ids,
                                              MAX_ELEMENTS);

    for (int i = 0; i < near_count; i++) {
        const wm_entry_t *e = wm_get_entry(wm, near_ids[i]);
        if (e == NULL) {
            continue;
        }

        float dist = position_distance(&own_state->position,
                                       &e->state.position);

        if (dist < 0.001f) {
            /* Exactly coincident (or indistinguishably close):
             * add a random kick so elements don't stay stuck */
            dx += rand_float_11() * REPULSION_RADIUS;
            dy += rand_float_11() * REPULSION_RADIUS;
            continue;
        }

        /* Unit vector pointing away from the peer */
        float ux = (own_state->position.x - e->state.position.x) / dist;
        float uy = (own_state->position.y - e->state.position.y) / dist;

        /* Force ∝ (1 − dist/REPULSION_RADIUS), scaled to REPULSION_RADIUS */
        float force = (REPULSION_RADIUS - dist) / REPULSION_RADIUS;
        dx += force * ux * REPULSION_RADIUS;
        dy += force * uy * REPULSION_RADIUS;
    }

    /* 3. Clamp net displacement magnitude to WALK_STEP_MAX */
    float magnitude = sqrtf(dx * dx + dy * dy);
    if (magnitude > WALK_STEP_MAX) {
        float scale = WALK_STEP_MAX / magnitude;
        dx *= scale;
        dy *= scale;
    }

    own_state->position.x += dx;
    own_state->position.y += dy;
    position_clamp(&own_state->position);
    own_state->update_seq++;
}
```

## src/movement.h
```c
/*
 * movement.h — Tapestry element position update
 *
 * Computes each element's next position every cycle using two forces:
 *
 *   Random walk — a small random displacement in any 2-D direction,
 *                 scaled to at most WALK_STEP_MAX per cycle.
 *
 *   Repulsion   — a push away from every active peer within
 *                 REPULSION_RADIUS, read from the local world model.
 *                 Force is proportional to (REPULSION_RADIUS − dist).
 *
 * The net displacement vector is clamped to WALK_STEP_MAX before being
 * applied, then the resulting position is clamped within [0, WORLD_SIZE].
 */

#ifndef TAPESTRY_MOVEMENT_H
#define TAPESTRY_MOVEMENT_H

#include <tapestry/csm.h>

/*
 * movement_tick — Apply one position update to own_state.
 *
 * Reads peer positions from wm (read-only).
 * Increments own_state->update_seq.
 * Does NOT call wm_update_self — the caller must do that afterwards.
 */
void movement_tick(element_state_t *own_state, const world_model_t *wm);

#endif /* TAPESTRY_MOVEMENT_H */
```
